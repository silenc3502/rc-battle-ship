## Doc/DeviceDriver/devicetree/bindings/phy/phy-bindings.txt
```
This document explains only the device tree data binding. For general
information about PHY subsystem refer to Documentation/phy.txt
이 문서에서는 장치 트리 데이터 바인딩 만 설명합니다. PHY 하위 시스템에 대한 일반 정보는 Documentation / phy.txt를 참조하십시오.

PHY device node
PHY 장치 노드
===============

Required Properties:
#phy-cells:	Number of cells in a PHY specifier;  The meaning of all those
		cells is defined by the binding for the phy node. The PHY
		provider can use the values in cells to find the appropriate
		PHY.

필수 등록 정보 :
# phy-cells : PHY specifier 에있는 셀의 수. 모든 셀의 의미는 phy 노드에 대한 바인딩에 의해 정의됩니다. PHY 제공 provider 는 셀의 값을 사용하여 적절한 PHY를 찾을 수 있습니다.

Optional Properties:
phy-supply:	Phandle to a regulator that provides power to the PHY. This
		regulator will be managed during the PHY power on/off sequence.

선택적 속성 :
phy-supply : PHY에 provides(공급,제공) power하는 regulator에 Phandle. 이 regulator는 PHY 전원 켜기 / 끄기 sequence 동안 관리됩니다.

For example:

phys: phy {
    compatible = "xxx";
    reg = <...>;
    .
    .
    #phy-cells = <1>;
    .
    .
};

That node describes an IP block (PHY provider) that implements 2 different PHYs.
In order to differentiate between these 2 PHYs, an additional specifier should be
given while trying to get a reference to it.
이 노드는 2 개의 서로 다른 PHY를 구현하는 IP 블록 (PHY provider)을 설명합니다.
이 2 개의 PHY를 구별하기 위해 reference를 얻으려는 동안 추가 specifier를 제공해야합니다.

PHY user node
=============

Required Properties:
phys : the phandle for the PHY device (used by the PHY subsystem)
phy-names : the names of the PHY corresponding to the PHYs present in the
	    *phys* phandle
필수 등록 정보 :
phys : PHY 장치의 phandle (PHY 하위 시스템에서 사용)
phy-names : * phys * phandle에있는 PHY에 해당하는 PHY의 이름


Example 1:
usb1: usb_otg_ss@xxx {
    compatible = "xxx";
    reg = <xxx>;
    .
    .
    phys = <&usb2_phy>, <&usb3_phy>;
    phy-names = "usb2phy", "usb3phy";
    .
    .
};

This node represents a controller that uses two PHYs, one for usb2 and one for
usb3.
이 노드는 usb2와 usb3에 각각 하나씩 두 개의 PHY를 사용하는 컨트롤러를 나타냅니다.

Example 2:
usb2: usb_otg_ss@xxx {
    compatible = "xxx";
    reg = <xxx>;
    .
    .
    phys = <&phys 1>;
    phy-names = "usbphy";
    .
    .
};

This node represents a controller that uses one of the PHYs of the PHY provider
device defined previously. Note that the phy handle has an additional specifier
"1" to differentiate between the two PHYs.
이 노드는 이전에 정의 된 PHY 제공자 장치의 PHY 중 하나를 사용하는 컨트롤러를 나타냅니다. phy 핸들에는 두 개의 PHY를 구분하는 추가 지정자 "1"이 있습니다.
```

## Doc/DeviceDriver/devicetree/bindings/phy/phy-lpc18xx-usb-otg.txt
```
NXP LPC18xx/43xx internal USB OTG PHY binding
---------------------------------------------

This file contains documentation for the internal USB OTG PHY found
in NXP LPC18xx and LPC43xx SoCs.

Required properties:
- compatible	: must be "nxp,lpc1850-usb-otg-phy"
- clocks	: must be exactly one entry
See: Documentation/devicetree/bindings/clock/clock-bindings.txt
- #phy-cells	: must be 0 for this phy
See: Documentation/devicetree/bindings/phy/phy-bindings.txt

The phy node must be a child of the creg syscon node.

이 파일에는 NXP LPC18xx 및 LPC43xx SoC에있는 내부 USB OTG PHY에 대한 설명서가 들어 있습니다.

필수 속성 :
- 호환 가능 : "nxp, lpc1850-usb-otg-phy"여야합니다.
- clocks : 정확히 하나의 항목이어야합니다. Documentation / devicetree / bindings / clock / clock-bindings.txt
- # phy-cells :이 phy에 대해 0이어야합니다.
참조 : Documentation / devicetree / bindings / phy / phy-bindings.txt

phy 노드는 creg syscon 노드의 하위 노드 여야합니다.


Example:
creg: syscon@40043000 {
	compatible = "nxp,lpc1850-creg", "syscon", "simple-mfd";
	reg = <0x40043000 0x1000>;

	usb0_otg_phy: phy@004 {
		compatible = "nxp,lpc1850-usb-otg-phy";
		clocks = <&ccu1 CLK_USB0>;
		#phy-cells = <0>;
	};
};
```

## Doc/DeviceDriver/devicetree/bindings/phy/phy-miphy28lp.txt
```
STMicroelectronics STi MIPHY28LP PHY binding
============================================

This binding describes a miphy device that is used to control PHY hardware
for SATA, PCIe or USB3.

Required properties (controller (parent) node):
- compatible	: Should be "st,miphy28lp-phy".
- st,syscfg	: Should be a phandle of the system configuration register group
		  which contain the SATA, PCIe or USB3 mode setting bits.

Required nodes	:  A sub-node is required for each channel the controller
		   provides. Address range information including the usual
		   'reg' and 'reg-names' properties are used inside these
		   nodes to describe the controller's topology. These nodes
		   are translated by the driver's .xlate() function.

이 바인딩은 SATA, PCIe 또는 USB3 용 PHY 하드웨어를 제어하는 데 사용되는 miphy device를 나타냅니다.

필수 속성 (컨트롤러 (부모) 노드) :
- compatible : "st, miphy28lp-phy"여야합니다.
- st, syscfg : SATA, PCIe 또는 USB3 모드 설정 비트를 포함하는 시스템 구성 레지스터 그룹의 패킷이어야합니다.

Required nodes : controller가 제공하는 각 채널마다 하위 노드가 필요합니다. 일반적인 'reg'및 'reg-names'속성을 포함한 주소 범위 정보는 컨트롤러의 topology를 설명하기 위해이 노드 내부에서 사용됩니다. 이 노드는 드라이버의 .xlate () 함수로 변환됩니다.

Required properties (port (child) node):
- #phy-cells	: Should be 1 (See second example)
		  Cell after port phandle is device type from:
			- PHY_TYPE_SATA
			- PHY_TYPE_PCI
			- PHY_TYPE_USB3
- reg		: Address and length of the register set for the device.
- reg-names	: The names of the register addresses corresponding to the registers
		  filled in "reg". It can also contain the offset of the system configuration
		  registers used as glue-logic to setup the device for SATA/PCIe or USB3
		  devices.
- st,syscfg	: Offset of the parent configuration register.
- resets	: phandle to the parent reset controller.
- reset-names	: Associated name must be "miphy-sw-rst".

필수 속성 (포트 (하위) 노드) :
- # phy-cells : 1이어야합니다 (두 번째 예 참조).
포트 phandle 이후의 셀은 다음과 같은 장치 유형입니다.
- PHY_TYPE_SATA
- PHY_TYPE_PCI
- PHY_TYPE_USB3
- reg : 장치에 설정된 레지스터의 주소와 길이.
- reg-names : "reg"로 채워진 레지스터에 해당하는 레지스터 주소의 이름. 또한 SATA / PCIe 또는 USB3 장치 용 장치를 설정하기위한 glue-logic으로 사용되는 시스템 구성 레지스터의 오프셋을 포함 할 수 있습니다.
- st, syscfg : 상위 구성 레지스터의 오프셋입니다.
- resets : parent reset controller 에 phandle
- reset-names : 관련 이름은 "miphy-sw-rst"여야합니다.


Optional properties (port (child) node):
- st,osc-rdy		: to check the MIPHY0_OSC_RDY status in the glue-logic. This
			  is not available in all the MiPHY. For example, for STiH407, only the
			  MiPHY0 has this bit.
- st,osc-force-ext	: to select the external oscillator. This can change from
			  different MiPHY inside the same SoC.
- st,sata_gen		: to select which SATA_SPDMODE has to be set in the SATA system config
			  register.
- st,px_rx_pol_inv	: to invert polarity of RXn/RXp (respectively negative line and positive
			  line).
- st,scc-on		: enable ssc to reduce effects of EMI (only for sata or PCIe).
- st,tx-impedance-comp	: to compensate tx impedance avoiding out of range values.

선택적 속성 (포트 (하위) 노드) :
- st, osc-rdy : 글루 로직에서 MIPHY0_OSC_RDY 상태를 확인합니다. 이것은 모든 MiPHY에서 사용할 수있는 것은 아닙니다. 예를 들어 STiH407의 경우 MiPHY0만이이 비트를 갖습니다.
- st, osc-force-ext : 외부 발진기를 선택합니다. 이는 동일한 SoC 내부의 다른 MiPHY에서 변경 될 수 있습니다.
- st, sata_gen : SATA 시스템 구성 레지스터에 설정할 SATA_SPDMODE를 선택합니다.
- st, px_rx_pol_inv : RXn / RXp (각각 음의 라인과 양의 라인)의 극성 반전.
- st, scc-on : ssc가 EMI의 영향을 줄이도록 합니다 (sata 또는 PCIe에만 해당).
- st, tx-impedance-comp : 범위 값을 벗어나는 tx 임피던스를 보상합니다.

example:

		miphy28lp_phy: miphy28lp@9b22000 {
			compatible = "st,miphy28lp-phy";
			st,syscfg = <&syscfg_core>;
			#address-cells	= <1>;
			#size-cells	= <1>;
			ranges;

			phy_port0: port@9b22000 {
				reg = <0x9b22000 0xff>,
				      <0x9b09000 0xff>,
				      <0x9b04000 0xff>;
				reg-names = "sata-up",
					    "pcie-up",
					    "pipew";

				st,syscfg = <0x114 0x818 0xe0 0xec>;
				#phy-cells = <1>;
				st,osc-rdy;
				reset-names = "miphy-sw-rst";
				resets = <&softreset STIH407_MIPHY0_SOFTRESET>;
			};

			phy_port1: port@9b2a000 {
				reg = <0x9b2a000 0xff>,
				      <0x9b19000 0xff>,
				      <0x9b14000 0xff>;
				reg-names = "sata-up",
					    "pcie-up",
					    "pipew";

				st,syscfg = <0x118 0x81c 0xe4 0xf0>;

				#phy-cells = <1>;
				st,osc-force-ext;
				reset-names = "miphy-sw-rst";
				resets = <&softreset STIH407_MIPHY1_SOFTRESET>;
			};

			phy_port2: port@8f95000 {
				reg = <0x8f95000 0xff>,
				      <0x8f90000 0xff>;
				reg-names = "pipew",
					    "usb3-up";

				st,syscfg = <0x11c 0x820>;

				#phy-cells = <1>;
				reset-names = "miphy-sw-rst";
				resets = <&softreset STIH407_MIPHY2_SOFTRESET>;
			};
		};


Specifying phy control of devices
=================================

Device nodes should specify the configuration required in their "phys"
property, containing a phandle to the miphy device node and an index
specifying which configuration to use, as described in phy-bindings.txt.

디바이스 노드는 phy-bindings.txt에 설명 된 것처럼, miphy 디바이스 노드에 대한 phandle과 사용할 구성을 지정하는 색인을 포함하는 "phys"등록 정보에 필요한 구성을 지정해야합니다.

example:
		sata0: sata@9b20000  {
			...
			phys		= <&phy_port0 PHY_TYPE_SATA>;
			...
		};

Macro definitions for the supported miphy configuration can be found in:
지원되는 miphy 구성에 대한 매크로 정의는 다음에서 찾을 수 있습니다.

include/dt-bindings/phy/phy.h
```

## Doc/DeviceDriver/devicetree/bindings/phy/phy-miphy365x.txt
```
STMicroelectronics STi MIPHY365x PHY binding
============================================

This binding describes a miphy device that is used to control PHY hardware
for SATA and PCIe.

Required properties (controller (parent) node):
- compatible    : Should be "st,miphy365x-phy"
- st,syscfg     : Phandle / integer array property. Phandle of sysconfig group
		  containing the miphy registers and integer array should contain
		  an entry for each port sub-node, specifying the control
		  register offset inside the sysconfig group.

Required nodes	:  A sub-node is required for each channel the controller
		   provides. Address range information including the usual
		   'reg' and 'reg-names' properties are used inside these
		   nodes to describe the controller's topology. These nodes
		   are translated by the driver's .xlate() function.

이 바인딩은 SATA 및 PCIe 용 PHY 하드웨어를 제어하는 데 사용되는 miphy 장치를 설명합니다.

필수 속성 (컨트롤러 (부모) 노드) :
- 호환 : "st, miphy365x-phy"여야합니다.
- st, syscfg : Phandle / 정수 배열 속성. miphy 레지스터와 정수 배열을 포함하는 sysconfig 그룹의 Phandle은 각 포트 하위 노드에 대한 항목을 포함해야하며 sysconfig 그룹 내의 제어 레지스터 오프셋을 지정해야합니다.

필수 노드 : 제어기가 제공하는 각 채널마다 하위 노드가 필요합니다. 일반적인 'reg'및 'reg-names'속성을 포함한 주소 범위 정보는 컨트롤러의 토폴로지를 설명하기 위해이 노드 내부에서 사용됩니다. 이 노드는 드라이버의 .xlate () 함수로 변환됩니다.


Required properties (port (child) node):
- #phy-cells 	: Should be 1 (See second example)
		  Cell after port phandle is device type from:
			- PHY_TYPE_SATA
			- PHY_TYPE_PCI
- reg        	: Address and length of register sets for each device in
		  "reg-names"
- reg-names     : The names of the register addresses corresponding to the
		  registers filled in "reg":
			- sata:   For SATA devices
			- pcie:   For PCIe devices

Optional properties (port (child) node):
- st,sata-gen	     :	Generation of locally attached SATA IP. Expected values
			are {1,2,3). If not supplied generation 1 hardware will
			be expected
- st,pcie-tx-pol-inv :	Bool property to invert the polarity PCIe Tx (Txn/Txp)
- st,sata-tx-pol-inv :	Bool property to invert the polarity SATA Tx (Txn/Txp)

필수 속성 (포트 (하위) 노드) :
- # phy-cells : 1이어야합니다 (두 번째 예 참조).
포트 phandle 이후의 셀은 다음과 같은 장치 유형입니다.
- PHY_TYPE_SATA
- PHY_TYPE_PCI
- reg : "reg-names"에있는 각 장치에 대한 레지스터 세트의 주소와 길이
- reg-names : "reg"로 채워진 레지스터에 해당하는 레지스터 주소의 이름 :
- SATA : SATA 장치의 경우
- pcie : PCIe 장치 용

선택적 속성 (포트 (하위) 노드) :
- st, sata-gen : 로컬로 연결된 SATA IP의 생성. 예상 값은 {1,2,3}입니다. 제공되지 않으면 1 세대 하드웨어가 예상됩니다.
- st, pcie-tx-pol-inv : 극성 반전을위한 Bool 속성 PCIe Tx (Txn / Txp)
- st, sata-tx-pol-inv : Bool 속성으로 극성 반전 SATA Tx (Txn / Txp)


Example:

	miphy365x_phy: miphy365x@fe382000 {
		compatible      = "st,miphy365x-phy";
		st,syscfg  	= <&syscfg_rear 0x824 0x828>;
		#address-cells	= <1>;
		#size-cells	= <1>;
		ranges;

		phy_port0: port@fe382000 {
			reg = <0xfe382000 0x100>, <0xfe394000 0x100>;
			reg-names = "sata", "pcie";
			#phy-cells = <1>;
			st,sata-gen = <3>;
		};

		phy_port1: port@fe38a000 {
			reg = <0xfe38a000 0x100>, <0xfe804000 0x100>;;
			reg-names = "sata", "pcie", "syscfg";
			#phy-cells = <1>;
			st,pcie-tx-pol-inv;
		};
	};

Specifying phy control of devices
장치의 phy 제어 지정
=================================

Device nodes should specify the configuration required in their "phys"
property, containing a phandle to the phy port node and a device type.

장치 노드는 phy 포트 노드와 장치 유형에 대한 phandle을 포함하는 "phys"속성에 필요한 구성을 지정해야합니다.

Example:

#include <dt-bindings/phy/phy.h>

	sata0: sata@fe380000 {
		...
		phys	  = <&phy_port0 PHY_TYPE_SATA>;
		...
	};
```

## Doc/DeviceDriver/devicetree/bindings/phy/phy-mt65xx-usb.txt
```
mt65xx USB3.0 PHY binding
--------------------------

This binding describes a usb3.0 phy for mt65xx platforms of Medaitek SoC.

Required properties (controller (parent) node):
 - compatible	: should be "mediatek,mt8173-u3phy"
 - reg		: offset and length of register for phy, exclude port's
		  register.
 - clocks	: a list of phandle + clock-specifier pairs, one for each
		  entry in clock-names
 - clock-names	: must contain
		  "u3phya_ref": for reference clock of usb3.0 analog phy.

이 바인딩은 Medaitek SoC의 mt65xx 플랫폼 용 usb3.0 phy를 설명합니다.

필수 속성 (컨트롤러 (부모) 노드) :
  - compatible : "mediatek, mt8173-u3phy"여야합니다.
  - reg : phy에 대한 레지스터의 오프셋 및 길이, 포트의 레지스터 제외
  - clocks : clock-names의 각 항목에 하나씩있는 phandle + clock-specifier 쌍의 목록
  - clock-names : usb3.0 analog phy의 reference clock 에는 "u3phya_ref"가 있어야합니다.



Required nodes	: a sub-node is required for each port the controller
		  provides. Address range information including the usual
		  'reg' property is used inside these nodes to describe
		  the controller's topology.
필수 노드 : 컨트롤러가 제공하는 각 포트에 하위 노드가 필요합니다. 일반적인 'reg'속성을 포함한 주소 범위 정보는 컨트롤러의 토폴로지를 설명하기 위해이 노드 내부에서 사용됩니다.

Required properties (port (child) node):
- reg		: address and length of the register set for the port.
- #phy-cells	: should be 1 (See second example)
		  cell after port phandle is phy type from:
			- PHY_TYPE_USB2
			- PHY_TYPE_USB3

필수 속성 (포트 (하위) 노드) :
- reg : 포트에 설정된 레지스터의 주소와 길이.
- # phy-cells : 1이어야합니다 (두 번째 예 참조).
포트 phandle 이후의 셀은 다음과 같은 phy 유형입니다.
- PHY_TYPE_USB2
- PHY_TYPE_USB3


Example:

u3phy: usb-phy@11290000 {
	compatible = "mediatek,mt8173-u3phy";
	reg = <0 0x11290000 0 0x800>;
	clocks = <&apmixedsys CLK_APMIXED_REF2USB_TX>;
	clock-names = "u3phya_ref";
	#address-cells = <2>;
	#size-cells = <2>;
	ranges;
	status = "okay";

	phy_port0: port@11290800 {
		reg = <0 0x11290800 0 0x800>;
		#phy-cells = <1>;
		status = "okay";
	};

	phy_port1: port@11291000 {
		reg = <0 0x11291000 0 0x800>;
		#phy-cells = <1>;
		status = "okay";
	};
};

Specifying phy control of devices
장치의 phy 제어 지정
---------------------------------

Device nodes should specify the configuration required in their "phys"
property, containing a phandle to the phy port node and a device type;
phy-names for each port are optional.

장치 노드는 phy 포트 노드와 장치 유형에 대한 phandle을 포함하는 "phys"속성에 필요한 구성을 지정해야합니다. 각 포트의 phy-name은 선택 사항입니다.

Example:

#include <dt-bindings/phy/phy.h>

usb30: usb@11270000 {
	...
	phys = <&phy_port0 PHY_TYPE_USB3>;
	phy-names = "usb3-0";
	...
};
```
