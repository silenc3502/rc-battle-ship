## Doc/DeviceDriver/devicetree/bindings/phy/sun4i-usb-phy.txt
```
Allwinner sun4i USB PHY
-----------------------

Required properties:
- compatible : should be one of
  * allwinner,sun4i-a10-usb-phy
  * allwinner,sun5i-a13-usb-phy
  * allwinner,sun6i-a31-usb-phy
  * allwinner,sun7i-a20-usb-phy
  * allwinner,sun8i-a23-usb-phy
  * allwinner,sun8i-a33-usb-phy
- reg : a list of offset + length pairs
- reg-names :
  * "phy_ctrl"
  * "pmu1"
  * "pmu2" for sun4i, sun6i or sun7i
- #phy-cells : from the generic phy bindings, must be 1
- clocks : phandle + clock specifier for the phy clocks
- clock-names :
  * "usb_phy" for sun4i, sun5i or sun7i
  * "usb0_phy", "usb1_phy" and "usb2_phy" for sun6i
  * "usb0_phy", "usb1_phy" for sun8i
- resets : a list of phandle + reset specifier pairs
- reset-names :
  * "usb0_reset"
  * "usb1_reset"
  * "usb2_reset" for sun4i, sun6i or sun7i

필수 속성 :
- 호환 가능 : 다음 중 하나 여야합니다.
   * allwinner, sun4i-a10-usb-phy
   * allwinner, sun5i-a13-usb-phy
   * allwinner, sun6i-a31-usb-phy
   * allwinner, sun7i-a20-usb-phy
   * allwinner, sun8i-a23-usb-phy
   * allwinner, sun8i-a33-usb-phy
- reg : a list of offset + length pairs
- reg-names :
   * "phy_ctrl"
   * "pmu1"
   * sun4i, sun6i 또는 sun7i의 경우 "pmu2"
- # phy-cells : 일반 phy 바인딩에서 1이어야합니다.
- clocks : phy clock에 대한 phandle + clock 지정자
- clock-names :
   * sun4i, sun5i 또는 sun7i의 경우 "usb_phy"
   * sun6i의 경우 "usb0_phy", "usb1_phy"및 "usb2_phy"
   * sun8i의 경우 "usb0_phy", "usb1_phy"
- resets : phandle + reset specifier pairs
- reset-names :
   * "usb0_reset"
   * "usb1_reset"
   * sun4i, sun6i 또는 sun7i의 경우 "usb2_reset"

Optional properties:
- usb0_id_det-gpios : gpio phandle for reading the otg id pin value
- usb0_vbus_det-gpios : gpio phandle for detecting the presence of usb0 vbus
- usb0_vbus_power-supply: power-supply phandle for usb0 vbus presence detect
- usb0_vbus-supply : regulator phandle for controller usb0 vbus
- usb1_vbus-supply : regulator phandle for controller usb1 vbus
- usb2_vbus-supply : regulator phandle for controller usb2 vbus

선택적 속성 :
- usb0_id_det-gpios : ogg id 핀 값을 읽는 gpio phandle
- usb0_vbus_det-gpios : usb0 vbus의 존재를 감지하는 gpio phandle
- usb0_vbus_power-supply : usb0 vbus 존재 감지를위한 전원 공급 장치 phandle
- usb0_vbus-supply : 컨트롤러 usb0 vbus 용  regulator phandle
- usb1_vbus-supply : 컨트롤러 usb1 vbus 용 regulator phandle
- usb2_vbus-supply : 컨트롤러 usb2 vbus 용 regulator phandle

Example:
	usbphy: phy@0x01c13400 {
		#phy-cells = <1>;
		compatible = "allwinner,sun4i-a10-usb-phy";
		/* phy base regs, phy1 pmu reg, phy2 pmu reg */
		/ * 기본 물리 REGS PHY1 PMU 등록 번호 등록 PHY2 PMU * /
		reg = <0x01c13400 0x10 0x01c14800 0x4 0x01c1c800 0x4>;
		reg-names = "phy_ctrl", "pmu1", "pmu2";
		clocks = <&usb_clk 8>;
		clock-names = "usb_phy";
		resets = <&usb_clk 0>, <&usb_clk 1>, <&usb_clk 2>;
		reset-names = "usb0_reset", "usb1_reset", "usb2_reset";
		pinctrl-names = "default";
		pinctrl-0 = <&usb0_id_detect_pin>, <&usb0_vbus_detect_pin>;
		usb0_id_det-gpios = <&pio 7 19 GPIO_ACTIVE_HIGH>; /* PH19 */
		usb0_vbus_det-gpios = <&pio 7 22 GPIO_ACTIVE_HIGH>; /* PH22 */
		usb0_vbus-supply = <&reg_usb0_vbus>;
		usb1_vbus-supply = <&reg_usb1_vbus>;
		usb2_vbus-supply = <&reg_usb2_vbus>;
	};
```

## Doc/DeviceDriver/devicetree/bindings/phy/sun9i-usb-phy.txt
```
Allwinner sun9i USB PHY
-----------------------

Required properties:
- compatible : should be one of
  * allwinner,sun9i-a80-usb-phy
- reg : a list of offset + length pairs
- #phy-cells : from the generic phy bindings, must be 0
- phy_type : "hsic" for HSIC usage;
	     other values or absence of this property indicates normal USB
- clocks : phandle + clock specifier for the phy clocks
- clock-names : depending on the "phy_type" property,
  * "phy" for normal USB
  * "hsic_480M", "hsic_12M" for HSIC
- resets : a list of phandle + reset specifier pairs
- reset-names : depending on the "phy_type" property,
  * "phy" for normal USB
  * "hsic" for HSIC

필수 속성 :
- compatible : * allwinner, sun9i-a80-usb-phy 중 하나 여야합니다.
- reg : offset + length 쌍의 목록
- # phy-cells : generic phy 바인딩에서 0이어야합니다.
- phy_type : HSIC 사용을위한 "hsic";
이 속성의 다른 값 또는 absence(부재)는 generic USB를 나타냅니다.
- clocks : phy clock에 대한 phandle + clock 지정자
- clock-names : "phy_type"속성에 따라,
   * generic USB 용 "phy"
   * HSIC 용 "hsic_480M", "hsic_12M"
- 재설정 : phandle + 재설정 지정자 쌍 목록
- 재설정 - 이름 : "phy_type"속성에 따라,
   * generic USB 용 "phy"
   HSIC를위한 "hsic"


Optional Properties:
- phy-supply : from the generic phy bindings, a phandle to a regulator that
	       provides power to VBUS.

It is recommended to list all clocks and resets available.
The driver will only use those matching the phy_type.

선택적 속성 :
- phy-supply : generic phy bindings에서 VBUS에 전원을 공급하는 regulator에 대한 phandle.

사용 가능한 모든 clocks 및 재설정을 나열하는 것이 좋습니다.
드라이버는 phy_type과 일치하는 드라이버 만 사용합니다.


Example:
	usbphy1: phy@00a01800 {
		compatible = "allwinner,sun9i-a80-usb-phy";
		reg = <0x00a01800 0x4>;
		clocks = <&usb_phy_clk 2>, <&usb_phy_clk 10>,
		       <&usb_phy_clk 3>;
		clock-names = "hsic_480M", "hsic_12M", "phy";
		resets = <&usb_phy_clk 18>, <&usb_phy_clk 19>;
		reset-names = "hsic", "phy";
		status = "disabled";
		#phy-cells = <0>;
	};
```
