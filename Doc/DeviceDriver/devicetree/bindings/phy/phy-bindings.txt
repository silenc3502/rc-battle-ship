## Doc/DeviceDriver/devicetree/bindings/phy/phy-mvebu.txt
```
* Marvell MVEBU SATA PHY

Power control for the SATA phy found on Marvell MVEBU SoCs.

This document extends the binding described in phy-bindings.txt

Required properties :

 - reg		   : Offset and length of the register set for the SATA device
 - compatible	   : Should be "marvell,mvebu-sata-phy"
 - clocks	   : phandle of clock and specifier that supplies the device
 - clock-names	   : Should be "sata"

Example:
		sata-phy@84000 {
			compatible = "marvell,mvebu-sata-phy";
			reg = <0x84000 0x0334>;
			clocks = <&gate_clk 15>;
			clock-names = "sata";
			#phy-cells = <0>;
			status = "ok";
		};

* Marvell MVEBU SATA PHY

Marvell MVEBU SoC에서 발견 된 SATA PHY의 전원 제어.

이 문서는 phy-bindings.txt에 설명 된 바인딩을 확장합니다.

필수 속성 :

  - reg : SATA 장치 용 레지스터 세트의 오프셋 및 길이
  - compatible : "marvell, mvebu-sata-phy"여야합니다.
  - clocks : 장치를 공급하는 clock과 specifier의 phandle
  - clock-names : "sata"여야합니다.



Armada 375 USB cluster
----------------------

Armada 375 comes with an USB2 host and device controller and an USB3
controller. The USB cluster control register allows to manage common
features of both USB controllers.

Required properties:

- compatible: "marvell,armada-375-usb-cluster"
- reg: Should contain usb cluster register location and length.
- #phy-cells : from the generic phy bindings, must be 1. Possible
values are 1 (USB2), 2 (USB3).

Armada 375에는 USB2 호스트 및 장치 컨트롤러와 USB3 컨트롤러가 함께 제공됩니다. USB 클러스터 제어 레지스터는 두 USB 컨트롤러의 공통 기능을 관리 할 수있게 해줍니다.

필수 속성 :

- 호환 : "marvell, armada-375-usb-cluster"
- reg : usb 클러스터 레지스터 위치와 길이를 포함해야합니다.
- # phy-cells : 일반 phy 바인딩에서 1이어야합니다. 가능한 값은 1 (USB2), 2 (USB3)입니다.

Example:
		usbcluster: usb-cluster@18400 {
			compatible = "marvell,armada-375-usb-cluster";
			reg = <0x18400 0x4>;
			#phy-cells = <1>
		};
```

## Doc/DeviceDriver/devicetree/bindings/phy/phy-stih407-usb.txt
```
ST STiH407 USB PHY controller

This file documents the dt bindings for the usb picoPHY driver which is the PHY for both USB2 and USB3
host controllers (when controlling usb2/1.1 devices) available on STiH407 SoC family from STMicroelectronics.

Required properties:
- compatible		: should be "st,stih407-usb2-phy"
- st,syscfg		: phandle of sysconfig bank plus integer array containing phyparam and phyctrl register offsets
- resets		: list of phandle and reset specifier pairs. There should be two entries, one
			  for the whole phy and one for the port
- reset-names		: list of reset signal names. Should be "global" and "port"
See: Documentation/devicetree/bindings/reset/st,sti-powerdown.txt
See: Documentation/devicetree/bindings/reset/reset.txt

이 파일에는 STMicroelectronics의 STiH407 SoC 제품군에서 사용할 수있는 USB2 및 USB3 호스트 컨트롤러 (usb2 / 1.1 디바이스 제어시) 용 PHY 인 usb picoPHY 드라이버의 dt 바인딩에 대한 문서가 있습니다.

필수 속성 :
- compatible : "st, stih407-usb2-phy"여야합니다.
- st, syscfg : sysconfig 뱅크의 phandle과 phyparam 및 phyctrl 레지스터 오프셋을 포함하는 정수 배열
- reset : phandle 및 reset 지정자 쌍 목록입니다. 두 개의 항목이 있어야합니다. 하나는 전체 phy이고 하나는 포트입니다.
- reset-names : 재설정 된 신호 이름 목록. "globa"및 "port"여야합니다.
참조 : Documentation / devicetree / bindings / reset / st, sti-powerdown.txt
참조 : Documentation / devicetree / bindings / reset / reset.txt


Example:

usb2_picophy0: usbpicophy@f8 {
	compatible	= "st,stih407-usb2-phy";
	#phy-cells	= <0>;
	st,syscfg	= <&syscfg_core 0x100 0xf4>;
	resets		= <&softreset STIH407_PICOPHY_SOFTRESET>,
			  <&picophyreset STIH407_PICOPHY0_RESET>;
	reset-names	= "global", "port";
};
```

## Doc/DeviceDriver/devicetree/bindings/phy/phy-stih41x-usb.txt
```
STMicroelectronics STiH41x USB PHY binding
------------------------------------------

This file contains documentation for the usb phy found in STiH415/6 SoCs from
STMicroelectronics.

Required properties:
- compatible	: should be "st,stih416-usb-phy" or "st,stih415-usb-phy"
- st,syscfg	: should be a phandle of the syscfg node
- clock-names	: must contain "osc_phy"
- clocks	: must contain an entry for each name in clock-names.
See: Documentation/devicetree/bindings/clock/clock-bindings.txt
- #phy-cells	: must be 0 for this phy
See: Documentation/devicetree/bindings/phy/phy-bindings.txt

이 파일에는 STMicroelectronics의 STiH415 / 6 SoC에있는 USB 케이블에 대한 설명서가 들어 있습니다.

필수 속성 :
- compatible : "st, stih416-usb-phy"또는 "st, stih415-usb-phy"이어야합니다.
- st, syscfg : syscfg 노드의 phandle이어야합니다.
- clock-names : "osc_phy"를 포함해야합니다.
- clocks : clock-names에 각 이름에 대한 항목을 포함해야합니다.
참조 : Documentation / devicetree / bindings / clock / clock-bindings.txt
- # phy-cells :이 phy에 대해 0이어야합니다.
참조 : Documentation / devicetree / bindings / phy / phy-bindings.txt


Example:

usb2_phy: usb2phy@0 {
	compatible	= "st,stih416-usb-phy";
	#phy-cell	= <0>;
	st,syscfg	= <&syscfg_rear>;
	clocks		= <&clk_sysin>;
	clock-names	= "osc_phy";
};
```

## Doc/DeviceDriver/devicetree/bindings/phy/pistachio-usb-phy.txt
```
IMG Pistachio USB PHY
=====================

Required properties:
--------------------
 - compatible: Must be "img,pistachio-usb-phy".
 - #phy-cells: Must be 0.  See ./phy-bindings.txt for details.
 - clocks: Must contain an entry for each entry in clock-names.
   See ../clock/clock-bindings.txt for details.
 - clock-names: Must include "usb_phy".
 - img,cr-top: Must constain a phandle to the CR_TOP syscon node.
 - img,refclk: Indicates the reference clock source for the USB PHY.
   See <dt-bindings/phy/phy-pistachio-usb.h> for a list of valid values.
필수 속성 :
--------------------
  - compatible : "img, pistachio-usb-phy"여야합니다.
  - # phy-cells : 0이어야합니다. 자세한 내용은 ./phy-bindings.txt를 참조하십시오.
  - clocks : clock-name의 각 항목에 대한 항목을 포함해야합니다.
    자세한 내용은 ../clock/clock-bindings.txt를 참조하십시오.
  - clock-names : "usb_phy"를 포함해야합니다.
  - img, cr-top : CR_TOP syscon 노드에 phandle을 지정해야합니다.
  - img, refclk : USB PHY의 기준 클럭 소스를 나타냅니다.
    유효한 값 목록은 <dt-bindings / phy / phy-pistachio-usb.h>를 참조하십시오.


Optional properties:
선택적 속성 :
--------------------
 - phy-supply: USB VBUS supply.  Must supply 5.0V.
 - phy-supply : USB VBUS 공급 장치. 5.0V를 공급해야합니다.
Example:
--------
usb_phy: usb-phy {
	compatible = "img,pistachio-usb-phy";
	clocks = <&clk_core CLK_USB_PHY>;
	clock-names = "usb_phy";
	phy-supply = <&usb_vbus>;
	img,refclk = <REFCLK_CLK_CORE>;
	img,cr-top = <&cr_top>;
	#phy-cells = <0>;
};
```

## Doc/DeviceDriver/devicetree/bindings/phy/pxa1928-usb-phy.txt
```
* Marvell PXA1928 USB and HSIC PHYs

Required properties:
- compatible: "marvell,pxa1928-usb-phy" or "marvell,pxa1928-hsic-phy"
- reg: base address and length of the registers
- clocks - A single clock. From common clock binding.
- #phys-cells: should be 0. From commmon phy binding.
- resets: reference to the reset controller
필수 속성 :
- compatible : "marvell, pxa1928-usb-phy"또는 "marvell, pxa1928-hsic-phy"
- reg : 레지스터의 기본 주소와 길이
- clocks -  A single clock. common clock binding에서.
- # phys-cells : 0이어야합니다. commmon phy 바인딩에서.
- resets : resets controller에 대한 참조


Example:

	usbphy: phy@7000 {
		compatible = "marvell,pxa1928-usb-phy";
		reg = <0x7000 0xe0>;
		clocks = <&apmu_clocks PXA1928_CLK_USB>;
		#phy-cells = <0>;
	};
```

## Doc/DeviceDriver/devicetree/bindings/phy/qcom,usb-8x16-phy.txt
```
Qualcomm's APQ8016/MSM8916 USB transceiver controller

- compatible:
    Usage: required
    Value type: <string>
    Definition: Should contain "qcom,usb-8x16-phy".
- compatible :
     사용법 : 필수
     값 유형 : <string>
     정의 : "qcom, usb-8x16-phy"를 포함해야합니다.

- reg:
    Usage: required
    Value type: <prop-encoded-array>
    Definition: USB PHY base address and length of the register map
- reg :
     사용법 : 필수
     값 유형 : <prop-encoded-array>
     정의 : USB PHY 기본 주소 및 등록 맵의 길이

- clocks:
    Usage: required
    Value type: <prop-encoded-array>
    Definition: See clock-bindings.txt section "consumers". List of
                two clock specifiers for interface and core controller
                clocks.
- clocks :
     사용법 : 필수
     값 유형 : <prop-encoded-array>
     정의 : clock-bindings.txt 섹션 "consumers"를 참조하십시오. 인터페이스 및 코어 컨트롤러 클럭에 대한 두 개의 clock specifiers 목록입니다.

- clock-names:
    Usage: required
    Value type: <string>
    Definition: Must contain "iface" and "core" strings.
- clock-names :
     사용법 : 필수
     값 유형 : <문자열>
     정의 : "iface"및 "core"문자열을 포함해야합니다.

- vddcx-supply:
    Usage: required
    Value type: <phandle>
    Definition: phandle to the regulator VDCCX supply node.
- vddcx-supply :
     사용법 : 필수
     값 유형 : <phandle>
     정의 : 레귤레이터 VDCCX 공급 노드에 대한 팬들.

- v1p8-supply:
    Usage: required
    Value type: <phandle>
    Definition: phandle to the regulator 1.8V supply node.
- v1p8-supply :
     사용법 : 필수
     값 유형 : <phandle>
     정의 : 레귤레이터 1.8V 전원 노드와의 결합.

- v3p3-supply:
    Usage: required
    Value type: <phandle>
    Definition: phandle to the regulator 3.3V supply node.
- v3p3-supply :
     사용법 : 필수
     값 유형 : <phandle>
     정의 : 레귤레이터 3.3V 공급 노드에 대한 phandle.

- resets:
    Usage: required
    Value type: <prop-encoded-array>
    Definition: See reset.txt section "consumers". PHY reset specifier.
- resets :
     사용법 : 필수
     값 유형 : <prop-encoded-array>
     정의 : reset.txt 섹션 "소비자"를 참조하십시오. PHY reset specifier.

- reset-names:
    Usage: required
    Value type: <string>
    Definition: Must contain "phy" string.
- reset-names :
     사용법 : 필수
     값 유형 : <문자열>
     정의 : "phy"문자열을 포함해야합니다.

- switch-gpio:
    Usage: optional
    Value type: <prop-encoded-array>
    Definition: Some boards are using Dual SPDT USB Switch, witch is
                controlled by GPIO to de/multiplex D+/D- USB lines
                between connectors.
- switch - gpio :
     사용법 : 선택 사항
     값 유형 : <prop-encoded-array>
     정의 : 일부 보드는 Dual SPDT USB Switch를 사용하고 있으며, 커넥터 사이의 D + / D-USB 선을  de(분리)/multiplex(다중화) 하기 위해 GPIO 제어되고 있습니다.


Example:
	usb_phy: phy@78d9000 {
		compatible = "qcom,usb-8x16-phy";
		reg = <0x78d9000 0x400>;

		vddcx-supply = <&pm8916_s1_corner>;
		v1p8-supply = <&pm8916_l7>;
		v3p3-supply = <&pm8916_l13>;

		clocks = <&gcc GCC_USB_HS_AHB_CLK>,
			     <&gcc GCC_USB_HS_SYSTEM_CLK>;
		clock-names = "iface", "core";

		resets = <&gcc GCC_USB2A_PHY_BCR>;
		reset-names = "phy";

		// D+/D- lines: 1 - Routed to HUB, 0 - Device connector
		switch-gpio = <&pm8916_gpios 4 GPIO_ACTIVE_HIGH>;
        // D + / D- lines : 1 - HUB에 연결, 0 - 장치 커넥터
        switch-gpio = <& pm8916_gpios 4 GPIO_ACTIVE_HIGH>;
	};
```

## Doc/DeviceDriver/devicetree/bindings/phy/qcom-apq8064-sata-phy.txt
```
Qualcomm APQ8064 SATA PHY Controller
------------------------------------

SATA PHY nodes are defined to describe on-chip SATA Physical layer controllers.
Each SATA PHY controller should have its own node.

Required properties:
- compatible: compatible list, contains "qcom,apq8064-sata-phy".
- reg: offset and length of the SATA PHY register set;
- #phy-cells: must be zero
- clocks: a list of phandles and clock-specifier pairs, one for each entry in
  clock-names.
- clock-names: must be "cfg" for phy config clock.

SATA PHY 노드는 온칩 SATA 물리 계층 컨트롤러를 설명하기 위해 정의됩니다.
각 SATA PHY 컨트롤러에는 자체 노드가 있어야합니다.

필수 속성 :
- compatible : 호환 가능한 목록으로 "qcom, apq8064-sata-phy"가 들어 있습니다.
- reg : SATA PHY 레지스터 세트의 오프셋 및 길이.
- # phy-cells : 0이어야합니다.
- clocks : clock-names 각 항목에 하나 인 phandles 및 clock-specifier 쌍의 목록입니다.
- clock-names : phy config clock의 경우 "cfg"여야합니다.

Example:
	sata_phy: sata-phy@1b400000 {
		compatible = "qcom,apq8064-sata-phy";
		reg = <0x1b400000 0x200>;

		clocks = <&gcc SATA_PHY_CFG_CLK>;
		clock-names = "cfg";

		#phy-cells = <0>;
	};
```

## Doc/DeviceDriver/devicetree/bindings/phy/qcom-dwc3-usb-phy.txt
```
Qualcomm DWC3 HS AND SS PHY CONTROLLER
--------------------------------------

DWC3 PHY nodes are defined to describe on-chip Synopsis Physical layer
controllers.  Each DWC3 PHY controller should have its own node.

Required properties:
- compatible: should contain one of the following:
	- "qcom,dwc3-hs-usb-phy" for High Speed Synopsis PHY controller
	- "qcom,dwc3-ss-usb-phy" for Super Speed Synopsis PHY controller
- reg: offset and length of the DWC3 PHY controller register set
- #phy-cells: must be zero
- clocks: a list of phandles and clock-specifier pairs, one for each entry in
  clock-names.
- clock-names: Should contain "ref" for the PHY reference clock

Optional clocks:
  "xo"		External reference clock

DDWC3 PHY 노드는  on-chip Synopsis Physical layer
controllers 를 설명하기 위해 정의됩니다. 각 DWC3 PHY 컨트롤러에는 자체 노드가 있어야합니다.

필수 속성 :
- compatible : 다음 중 하나를 포함해야합니다.
- High Speed Synopsis PHY 컨트롤러 용 "qcom, dwc3-hs-usb-phy"
- Super Speed Synopsis PHY 컨트롤러 용 "qcom, dwc3-ss-usb-phy"
- reg : DWC3 PHY 제어기 레지스터 세트의 오프셋 및 길이
- # phy-cells : 0이어야합니다.
- clocks : clock-names 각 항목에 하나 인 phandles 및 clock-specifier 쌍의 목록입니다.
- clock-names : PHY 기준 클럭에 대해 "ref"를 포함해야합니다.

선택 사양 클럭 :
   "xo"외부 기준 클럭



Example:
		phy@100f8800 {
			compatible = "qcom,dwc3-hs-usb-phy";
			reg = <0x100f8800 0x30>;
			clocks = <&gcc USB30_0_UTMI_CLK>;
			clock-names = "ref";
			#phy-cells = <0>;

			status = "ok";
		};

		phy@100f8830 {
			compatible = "qcom,dwc3-ss-usb-phy";
			reg = <0x100f8830 0x30>;
			clocks = <&gcc USB30_0_MASTER_CLK>;
			clock-names = "ref";
			#phy-cells = <0>;

			status = "ok";
		};
```

## Doc/DeviceDriver/devicetree/bindings/phy/qcom-ipq806x-sata-phy.txt
```
Qualcomm IPQ806x SATA PHY Controller
------------------------------------

SATA PHY nodes are defined to describe on-chip SATA Physical layer controllers.
Each SATA PHY controller should have its own node.

Required properties:
- compatible: compatible list, contains "qcom,ipq806x-sata-phy"
- reg: offset and length of the SATA PHY register set;
- #phy-cells: must be zero
- clocks: must be exactly one entry
- clock-names: must be "cfg"

SATA PHY 노드는  on-chip SATA 물리 계층 컨트롤러를 설명하기 위해 정의됩니다.
각 SATA PHY 컨트롤러에는 자체 노드가 있어야합니다.

필수 속성 :
- compatible : compatible list , "qcom, ipq806x-sata-phy"포함
- reg : SATA PHY 레지스터 세트의 오프셋 및 길이.
- # phy-cells : 0이어야합니다.
- clocks : 정확하게 하나의 항목이어야합니다.
- clock-names : "cfg"여야합니다.

Example:
	sata_phy: sata-phy@1b400000 {
		compatible = "qcom,ipq806x-sata-phy";
		reg = <0x1b400000 0x200>;

		clocks = <&gcc SATA_PHY_CFG_CLK>;
		clock-names = "cfg";

		#phy-cells = <0>;
	};
```
