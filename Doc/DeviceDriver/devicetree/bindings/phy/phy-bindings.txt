## Doc/DeviceDriver/devicetree/bindings/phy/rcar-gen2-phy.txt
```
* Renesas R-Car generation 2 USB PHY

This file provides information on what the device node for the R-Car generation
2 USB PHY contains.

Required properties:
- compatible: "renesas,usb-phy-r8a7790" if the device is a part of R8A7790 SoC.
	      "renesas,usb-phy-r8a7791" if the device is a part of R8A7791 SoC.
	      "renesas,usb-phy-r8a7794" if the device is a part of R8A7794 SoC.
- reg: offset and length of the register block.
- #address-cells: number of address cells for the USB channel subnodes, must
		  be <1>.
- #size-cells: number of size cells for the USB channel subnodes, must be <0>.
- clocks: clock phandle and specifier pair.
- clock-names: string, clock input name, must be "usbhs".

The USB PHY device tree node should have the subnodes corresponding to the USB
channels. These subnodes must contain the following properties:
- reg: the USB controller selector; see the table below for the values.
- #phy-cells: see phy-bindings.txt in the same directory, must be <1>.

The phandle's argument in the PHY specifier is the USB controller selector for
the USB channel; see the selector meanings below:

+-----------+---------------+---------------+
|\ Selector |               |               |
+ --------- +       0       |       1       |
| Channel  \|               |               |
+-----------+---------------+---------------+
| 0         | PCI EHCI/OHCI | HS-USB        |
| 2         | PCI EHCI/OHCI | xHCI          |
+-----------+---------------+---------------+

이 파일은 R-Car 세대 2 USB PHY의 장치 노드에 포함 된 정보를 제공합니다.

필수 속성 :
- compatible : 장치가 R8A7790 SoC의 일부인 경우 "renesas, usb-phy-r8a7790"
장치가 R8A7791 SoC의 일부인 경우 "renesas, usb-phy-r8a7791".
장치가 R8A7794 SoC의 일부인 경우 "renesas, usb-phy-r8a7794".
- reg : 레지스터 블록의 오프셋과 길이.
- # address-cells : USB 채널 하위 노드의 주소 셀 수는 <1>이어야합니다.
- # size-cells : USB 채널 하위 노드의 크기 셀 수는 <0>이어야합니다.
- clocks : clock phandle 및 specifier pair.
- clock-names : 문자열, clock input name은 "usbhs"여야합니다.

USB PHY 장치 트리 노드에는 USB 채널에 해당하는 하위 노드가 있어야합니다. 이러한 하위 노드에는 다음 속성이 포함되어야합니다.
- reg : USB 컨트롤러 선택기. 값은 아래 표를 참조하십시오.
- # phy-cells : 동일한 디렉토리에서 phy-bindings.txt를 참조하십시오. <1> 여야합니다.

PHY 지정자의 phandle 인수는 USB 채널 용 USB 컨트롤러 선택기입니다. 아래의 선택기 의미를 참조하십시오.

+-----------+---------------+---------------+
|\ Selector |               |               |
+ --------- +       0       |       1       |
| Channel  \|               |               |
+-----------+---------------+---------------+
| 0         | PCI EHCI/OHCI | HS-USB        |
| 2         | PCI EHCI/OHCI | xHCI          |
+-----------+---------------+---------------+

Example (Lager board):

	usb-phy@e6590100 {
		compatible = "renesas,usb-phy-r8a7790";
		reg = <0 0xe6590100 0 0x100>;
		#address-cells = <1>;
		#size-cells = <0>;
		clocks = <&mstp7_clks R8A7790_CLK_HSUSB>;
		clock-names = "usbhs";

		usb-channel@0 {
			reg = <0>;
			#phy-cells = <1>;
		};
		usb-channel@2 {
			reg = <2>;
			#phy-cells = <1>;
		};
	};
```

## Doc/DeviceDriver/devicetree/bindings/phy/rockchip-usb-phy.txt
```
ROCKCHIP USB2 PHY

Required properties:
 - compatible: rockchip,rk3288-usb-phy
 - rockchip,grf : phandle to the syscon managing the "general
   register files"
 - #address-cells: should be 1
 - #size-cells: should be 0

Sub-nodes:
Each PHY should be represented as a sub-node.

Sub-nodes
required properties:
- #phy-cells: should be 0
- reg: PHY configure reg address offset in GRF
		"0x320" - for PHY attach to OTG controller
		"0x334" - for PHY attach to HOST0 controller
		"0x348" - for PHY attach to HOST1 controller

Optional Properties:
- clocks : phandle + clock specifier for the phy clocks
- clock-names: string, clock name, must be "phyclk"

필수 속성 :
  - compatible : rockchip, rk3288-usb-phy
  - rockchip, grf : "general register files"을 관리하는 syscon에 대한 phandle
  - # address-cells : 1이어야합니다.
  - # size-cells : 0이어야합니다.

하위 노드 :
각 PHY는 하위 노드로 표시되어야합니다.

하위 노드
필수 속성 :
- # phy-cells : 0이어야합니다.
- reg : PHY는 GRF에서 reg 주소 오프셋을 구성합니다.
"0x320"- OTG 컨트롤러에 PHY 연결
"0x334"- HOST0 컨트롤러에 PHY 연결
"0x348"- HOST1 컨트롤러에 PHY 연결

선택적 속성 :
- clocks : phy clock에 대한 phandle + clock 지정자
- clock-names : 문자열,clock-names, "phyclk"여야합니다.


Example:

usbphy: phy {
	compatible = "rockchip,rk3288-usb-phy";
	rockchip,grf = <&grf>;
	#address-cells = <1>;
	#size-cells = <0>;

	usbphy0: usb-phy0 {
		#phy-cells = <0>;
		reg = <0x320>;
	};
};
```

## Doc/DeviceDriver/devicetree/bindings/phy/samsung-phy.txt
```
Samsung S5P/EXYNOS SoC series MIPI CSIS/DSIM DPHY
-------------------------------------------------

Required properties:
- compatible : should be "samsung,s5pv210-mipi-video-phy";
- #phy-cells : from the generic phy bindings, must be 1;
- syscon - phandle to the PMU system controller;

For "samsung,s5pv210-mipi-video-phy" compatible PHYs the second cell in
the PHY specifier identifies the PHY and its meaning is as follows:
  0 - MIPI CSIS 0,
  1 - MIPI DSIM 0,
  2 - MIPI CSIS 1,
  3 - MIPI DSIM 1.

필수 속성 :
- 호환 : "samsung, s5pv210-mipi-video-phy"여야합니다.
- # phy-cells : 일반 phy 바인딩에서 1이어야합니다.
- syscon - PMU 시스템 컨트롤러에 연결합니다.

"samsung, s5pv210-mipi-video-phy"호환 PHY의 경우 PHY 지정자의 두 번째 셀은 PHY를 식별하며 그 의미는 다음과 같습니다.
   0 - MIPI CSIS 0,
   1 - MIPI DSIM 0,
   2 - MIPI CSIS 1,
   3 - MIPI DSIM 1.


Samsung EXYNOS SoC series Display Port PHY
-------------------------------------------------

Required properties:
- compatible : should be one of the following supported values:
	 - "samsung,exynos5250-dp-video-phy"
	 - "samsung,exynos5420-dp-video-phy"
- samsung,pmu-syscon: phandle for PMU system controller interface, used to
		      control pmu registers for power isolation.
- #phy-cells : from the generic PHY bindings, must be 0;

필수 속성 :
- compatible : 다음 지원되는 값 중 하나 여야합니다.
- "samsung, exynos5250-dp-video-phy"
- "samsung, exynos5420-dp-video-phy"
- samsung, pmu-syscon : PMU 시스템 컨트롤러 인터페이스 용 phandle. 전원 분리를 위해 pmu 레지스터를 제어하는 데 사용됩니다.
- # phy-cells : generic PHY 바인딩에서 0이어야합니다.


Samsung S5P/EXYNOS SoC series USB PHY
-------------------------------------------------

Required properties:
- compatible : should be one of the listed compatibles:
	- "samsung,exynos3250-usb2-phy"
	- "samsung,exynos4210-usb2-phy"
	- "samsung,exynos4x12-usb2-phy"
	- "samsung,exynos5250-usb2-phy"
	- "samsung,s5pv210-usb2-phy"
- reg : a list of registers used by phy driver
	- first and obligatory is the location of phy modules registers
- samsung,sysreg-phandle - handle to syscon used to control the system registers
- samsung,pmureg-phandle - handle to syscon used to control PMU registers
- #phy-cells : from the generic phy bindings, must be 1;
- clocks and clock-names:
	- the "phy" clock is required by the phy module, used as a gate
	- the "ref" clock is used to get the rate of the clock provided to the
	  PHY module

필수 속성 :
- compatible : 나열된 compatibles 중 하나 여야합니다.
- "samsung, exynos3250-usb2-phy"
- "samsung, exynos4210-usb2-phy"
- "samsung, exynos4x12-usb2-phy"
- "samsung, exynos5250-usb2-phy"
- "samsung, s5pv210-usb2-phy"
- reg : phy 드라이버가 사용하는 레지스터 목록
- 첫 번째와 필수는 phy 모듈 레지스터의 위치입니다
- samsung, sysreg-phandle - 시스템 레지스터를 제어하는 데 사용되는 syscon 핸들
- samsung, pmureg-phandle - PMU 레지스터를 제어하는 데 사용되는 syscon 핸들
- # phy-cells : generic phy 바인딩에서 1이어야합니다.
- clocks and clock-names :
- "phy"clock은 phy 모듈에 필요하며 게이트로 사용됩니다.
- "ref"clock는  clock provided의 PHY 모듈 속도를 가져 오는 데 사용됩니다


Optional properties:
- vbus-supply: power-supply phandle for vbus power source

The first phandle argument in the PHY specifier identifies the PHY, its
meaning is compatible dependent. For the currently supported SoCs (Exynos 4210
and Exynos 4212) it is as follows:
  0 - USB device ("device"),
  1 - USB host ("host"),
  2 - HSIC0 ("hsic0"),
  3 - HSIC1 ("hsic1"),
Exynos3250 has only USB device phy available as phy 0.

Exynos 4210 and Exynos 4212 use mode switching and require that mode switch
register is supplied.

선택적 속성 :
- vbus-supply : power-supply phandle 위한 vbus power source

PHY 지정자의 첫 번째 phandle 인수는 PHY를 식별하며 그 의미는 호환 가능합니다. 현재 지원되는 SoC (Exynos 4210 및 Exynos 4212)의 경우 다음과 같습니다.
   0 - USB 장치 ( "장치"),
   1 - USB 호스트 ( "호스트"),
   2 - HSIC0 ( "hsic0"),
   3 - HSIC1 ( "hsic1"),
Exynos3250에는 USB 장치 phy만이 phy 0으로 사용 가능합니다.

Exynos 4210 및 Exynos 4212는 모드 전환을 사용하며 모드 전환 레지스터가 제공되어야합니다.

Example:

For Exynos 4412 (compatible with Exynos 4212):
Exynos 4412 (Exynos 4212와 호환) :

usbphy: phy@125b0000 {
	compatible = "samsung,exynos4x12-usb2-phy";
	reg = <0x125b0000 0x100>;
	clocks = <&clock 305>, <&clock 2>;
	clock-names = "phy", "ref";
	status = "okay";
	#phy-cells = <1>;
	samsung,sysreg-phandle = <&sys_reg>;
	samsung,pmureg-phandle = <&pmu_reg>;
};

Then the PHY can be used in other nodes such as:
그런 다음 PHY는 다음과 같은 다른 노드에서 사용될 수 있습니다.

phy-consumer@12340000 {
	phys = <&usbphy 2>;
	phy-names = "phy";
};

Refer to DT bindings documentation of particular PHY consumer devices for more
information about required PHYs and the way of specification.
required PHY 및 사양 방법에 대한 자세한 내용은 particular PHY consumer devices의 DT 바인딩 설명서를 참조하십시오.

Samsung SATA PHY Controller
---------------------------

SATA PHY nodes are defined to describe on-chip SATA Physical layer controllers.
Each SATA PHY controller should have its own node.

Required properties:
- compatible        : compatible list, contains "samsung,exynos5250-sata-phy"
- reg : offset and length of the SATA PHY register set;
- #phy-cells : must be zero
- clocks : must be exactly one entry
- clock-names : must be "sata_phyctrl"
- samsung,exynos-sataphy-i2c-phandle : a phandle to the I2C device, no arguments
- samsung,syscon-phandle : a phandle to the PMU system controller, no arguments

SATA PHY 노드는 온칩 SATA 물리 계층 컨트롤러를 설명하기 위해 정의됩니다.
각 SATA PHY 컨트롤러에는 자체 노드가 있어야합니다.

필수 속성 :
- compatible : 호환 가능한 목록, "samsung, exynos5250-sata-phy"포함
- reg : SATA PHY 레지스터 세트의 오프셋 및 길이.
- # phy-cells : 0이어야합니다.
- clocks : 정확하게 하나의 항목이어야합니다.
- clock-names : "sata_phyctrl"이어야합니다.
- samsung, exynos-sataphy-i2c-phandle : I2C 장치에 대한 phandle, 인수 없음
- samsung, syscon-phandle : PMU 시스템 컨트롤러에 대한 phandle, 인수 없음

Example:
	sata_phy: sata-phy@12170000 {
		compatible = "samsung,exynos5250-sata-phy";
		reg = <0x12170000 0x1ff>;
		clocks = <&clock 287>;
		clock-names = "sata_phyctrl";
		#phy-cells = <0>;
		samsung,exynos-sataphy-i2c-phandle = <&sata_phy_i2c>;
		samsung,syscon-phandle = <&pmu_syscon>;
	};

Device-Tree bindings for sataphy i2c client driver
--------------------------------------------------

Required properties:
compatible: Should be "samsung,exynos-sataphy-i2c"
- reg: I2C address of the sataphy i2c device.
필수 속성 :
호환 가능 : "samsung, exynos-sataphy-i2c"여야합니다.
- reg : sataphy i2c 장치의 I2C 주소입니다.

Example:

	sata_phy_i2c:sata-phy@38 {
		compatible = "samsung,exynos-sataphy-i2c";
		reg = <0x38>;
	};

Samsung Exynos5 SoC series USB DRD PHY controller
--------------------------------------------------

Required properties:
- compatible : Should be set to one of the following supported values:
	- "samsung,exynos5250-usbdrd-phy" - for exynos5250 SoC,
	- "samsung,exynos5420-usbdrd-phy" - for exynos5420 SoC.
	- "samsung,exynos5433-usbdrd-phy" - for exynos5433 SoC.
	- "samsung,exynos7-usbdrd-phy" - for exynos7 SoC.
- reg : Register offset and length of USB DRD PHY register set;
- clocks: Clock IDs array as required by the controller
- clock-names: names of clocks correseponding to IDs in the clock property;
	       Required clocks:
	- phy: main PHY clock (same as USB DRD controller i.e. DWC3 IP clock),
	       used for register access.
	- ref: PHY's reference clock (usually crystal clock), used for
	       PHY operations, associated by phy name. It is used to
	       determine bit values for clock settings register.
	       For Exynos5420 this is given as 'sclk_usbphy30' in CMU.
	- optional clocks: Exynos5433 & Exynos7 SoC has now following additional
			   gate clocks available:
			   - phy_pipe: for PIPE3 phy
			   - phy_utmi: for UTMI+ phy
			   - itp: for ITP generation
- samsung,pmu-syscon: phandle for PMU system controller interface, used to
		      control pmu registers for power isolation.
- #phy-cells : from the generic PHY bindings, must be 1;

For "samsung,exynos5250-usbdrd-phy" and "samsung,exynos5420-usbdrd-phy"
compatible PHYs, the second cell in the PHY specifier identifies the
PHY id, which is interpreted as follows:
  0 - UTMI+ type phy,
  1 - PIPE3 type phy,

Example:
	usbdrd_phy: usbphy@12100000 {
		compatible = "samsung,exynos5250-usbdrd-phy";
		reg = <0x12100000 0x100>;
		clocks = <&clock 286>, <&clock 1>;
		clock-names = "phy", "ref";
		samsung,pmu-syscon = <&pmu_system_controller>;
		#phy-cells = <1>;
	};

- aliases: For SoCs like Exynos5420 having multiple USB 3.0 DRD PHY controllers,
	   'usbdrd_phy' nodes should have numbered alias in the aliases node,
	   in the form of usbdrdphyN, N = 0, 1... (depending on number of
	   controllers).
Example:
	aliases {
		usbdrdphy0 = &usb3_phy0;
		usbdrdphy1 = &usb3_phy1;
	};


필수 속성 :
- 호환 : 다음 지원되는 값 중 하나를 설정해야합니다.
- "samsung, exynos5250-usbdrd-phy"- exynos5250 SoC의 경우,
- "samsung, exynos5420-usbdrd-phy"- exynos5420 SoC 용.
- "samsung, exynos5433-usbdrd-phy"- exynos5433 SoC 용.
- "samsung, exynos7-usbdrd-phy"- exynos7 SoC 용.
- reg : USB DRD PHY 레지스터 세트의 오프셋 및 길이를 등록합니다.	
- clocks : 컨트롤러에서 요구하는대로 clocks ID 배열
- clock-names : clock 속성의 ID와 일치하는 clock-names.
Required clocks:
- phy : 레지스터 액세스에 사용되는 기본 PHY 클록 (USB DRD 컨트롤러와 동일, 즉 DWC3 IP 클록과 동일).
- ref : PHY의 참조 클럭 (일반적으로 크리스털 클럭). PHY 작업에 사용되며 phy 이름과 연관됩니다. 클록 설정 레지스터의 비트 값을 결정하는 데 사용됩니다.
Exynos5420의 경우 CMU에서 'sclk_usbphy30'으로 표시됩니다.
- 선택 사양 클럭 : Exynos5433 & Exynos7 SoC는 이제 다음과 같은 추가 게이트 클럭을 사용할 수 있습니다.
- phy_pipe : PIPE3 phy 용
- phy_utmi : UTMI + phy 용
- itp : ITP 생성 용
- samsung, pmu-syscon : PMU 시스템 컨트롤러 인터페이스 용 phandle. 전원 분리를 위해 pmu 레지스터를 제어하는 데 사용됩니다.
- # phy-cells : 일반 PHY 바인딩에서 1이어야합니다.

"syn, exynos5250-usbdrd-phy"및 "samsung, exynos5420-usbdrd-phy"호환 PHY의 경우 PHY 지정자의 두 번째 셀은 다음과 같이 해석되는 PHY ID를 식별합니다.
   0 - UTMI + 유형 phy,
   1 - PIPE3 유형 phy,

Example:
	usbdrd_phy: usbphy@12100000 {
		compatible = "samsung,exynos5250-usbdrd-phy";
		reg = <0x12100000 0x100>;
		clocks = <&clock 286>, <&clock 1>;
		clock-names = "phy", "ref";
		samsung,pmu-syscon = <&pmu_system_controller>;
		#phy-cells = <1>;
	};

	- aliases(별칭) : 여러 USB 3.0 DRD PHY 컨트롤러가있는 Exynos5420와 같은 SoC의 경우 'usbdrd_phy'노드는 usbdrdphyN, N = 0, 1 ... (컨트롤러 수에 따라)의 형식으로 aliases 노드에 aliases이  지정되어야합니다.

	Example:
	aliases {
		usbdrdphy0 = &usb3_phy0;
		usbdrdphy1 = &usb3_phy1;
	};
```

## Doc/DeviceDriver/devicetree/bindings/phy/st-spear-miphy.txt
```
ST SPEAr miphy DT details
=========================

ST Microelectronics SPEAr miphy is a phy controller supporting PCIe and SATA.

Required properties:
- compatible : should be "st,spear1310-miphy" or "st,spear1340-miphy"
- reg : offset and length of the PHY register set.
- misc: phandle for the syscon node to access misc registers
- #phy-cells : from the generic PHY bindings, must be 1.
	- cell[1]: 0 if phy used for SATA, 1 for PCIe.

Optional properties:
- phy-id: Instance id of the phy. Only required when there are multiple phys
  present on a implementation.

  ST 마이크로 일렉트로닉스 SPEAr miphy는 PCIe와 SATA를 지원하는 phy 컨트롤러입니다.

필수 속성 :
- 호환 가능 : "st, spear1310-miphy"또는 "st, spear1340-miphy"이어야합니다.
- reg : PHY 레지스터 세트의 오프셋 및 길이.
- 기타 : syscon 노드가 기타 레지스터에 액세스 할 수 있도록하는 phandle
- # phy-cells : 일반 PHY 바인딩에서 1이어야합니다.
- cell [1] : SATA가 phy이면 0, PCIe는 1입니다.

선택적 속성 :
- phy-id : phy의 인스턴스 ID. 구현하는데 여러 개의 phys가있는 경우에만 필요합니다.
```
