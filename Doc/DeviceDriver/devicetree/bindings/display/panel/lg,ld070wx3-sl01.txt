## Doc/DeviceDriver/devicetree/bindings/display/panel/sharp,lq101r1sx01.txt
```
Sharp Microelectronics 10.1" WQXGA TFT LCD panel

This panel requires a dual-channel DSI host to operate. It supports two modes:
- left-right: each channel drives the left or right half of the screen
- even-odd: each channel drives the even or odd lines of the screen

Each of the DSI channels controls a separate DSI peripheral. The peripheral
driven by the first link (DSI-LINK1), left or even, is considered the primary
peripheral and controls the device. The 'link2' property contains a phandle
to the peripheral driven by the second link (DSI-LINK2, right or odd).

Note that in video mode the DSI-LINK1 interface always provides the left/even
pixels and DSI-LINK2 always provides the right/odd pixels. In command mode it
is possible to program either link to drive the left/even or right/odd pixels
but for the sake of consistency this binding assumes that the same assignment
is chosen as for video mode.

Required properties:
- compatible: should be "sharp,lq101r1sx01"
- reg: DSI virtual channel of the peripheral

Required properties (for DSI-LINK1 only):
- link2: phandle to the DSI peripheral on the secondary link. Note that the
  presence of this property marks the containing node as DSI-LINK1.
- power-supply: phandle of the regulator that provides the supply voltage

Optional properties (for DSI-LINK1 only):
- backlight: phandle of the backlight device attached to the panel

Example:

	dsi@54300000 {
		panel: panel@0 {
			compatible = "sharp,lq101r1sx01";
			reg = <0>;

			link2 = <&secondary>;

			power-supply = <...>;
			backlight = <...>;
		};
	};

	dsi@54400000 {
		secondary: panel@0 {
			compatible = "sharp,lq101r1sx01";
			reg = <0>;
		};
	};

/*
箕橇 付捞农肺 老泛飘肺葱胶 10.1 "WQXGA TFT LCD 菩澄

捞 菩澄阑 荤侩窍妨搁 捞吝 盲澄 DSI 龋胶飘啊 鞘夸钦聪促. 弊巴篮 滴 啊瘤 葛靛甫 瘤盔钦聪促 :
- 哭率 - 坷弗率 : 阿 盲澄篮 拳搁狼 哭率 肚绰 坷弗率 例馆阑 备悼钦聪促.
- even-odd : 阿 盲澄篮 拳搁狼 娄荐 肚绰 圈荐 扼牢阑 备悼钦聪促.

阿 DSI 盲澄篮 喊档狼 DSI 林函 厘摹甫 力绢钦聪促. 哭率 肚绰 坷弗率狼 霉 锅掳 傅农 (DSI-LINK1)俊 狼秦 备悼登绰 林函 厘摹绰 扁夯 林函 厘摹肺 埃林登绢 厘摹甫 力绢钦聪促. 

'link2'加己篮 滴 锅掳 傅农 (DSI-LINK2, 坷弗率 肚绰 圈荐)俊 狼秦 备悼登绰 林函 厘摹俊 措茄 phandle 器窃钦聪促.

厚叼坷 葛靛俊辑 DSI-LINK1 牢磐其捞胶绰 亲惑 哭率 / 娄荐 侨伎阑 力傍窍绊 DSI-LINK2绰 亲惑 坷弗率 / 圈荐 侨伎阑 力傍钦聪促. 疙飞 葛靛俊辑 哭率 / 坷弗率 肚绰 圈荐 侨伎阑 备悼窍绰 傅农甫 橇肺弊伐 且 荐 乐嚼聪促
老包己阑 困秦捞 官牢爹篮 厚叼坷 葛靛俊 措秦 悼老茄 且寸捞 急琶等促绊 啊沥钦聪促.

鞘荐 加己 :
- 龋券 啊瓷 : "sharp, lq101r1sx01"捞绢具钦聪促.
- reg : 林函 厘摹狼 DSI 啊惑 盲澄

鞘荐 加己 (DSI-LINK1俊父 秦寸) :
- link2 : 焊炼 傅农狼 DSI 林函 厘摹肺 楷搬钦聪促. 捞 殿废 沥焊啊 乐栏搁 器窃 畴靛甫 DSI-LINK1肺 钎矫钦聪促.
- 傈盔 傍鞭 厘摹 : 傍鞭 傈拘阑 力傍窍绰 炼例扁狼 phandle

急琶利 加己 (DSI-LINK1俊父 秦寸) :
- 归扼捞飘 : 菩澄俊 何馒 等 归扼捞飘 厘摹狼 phandle

Example:

	dsi@54300000 {
		panel: panel@0 {
			compatible = "sharp,lq101r1sx01";
			reg = <0>;

			link2 = <&secondary>;

			power-supply = <...>;
			backlight = <...>;
		};
	};

	dsi@54400000 {
		secondary: panel@0 {
			compatible = "sharp,lq101r1sx01";
			reg = <0>;
		};
	};

*/
```

## Doc/DeviceDriver/devicetree/bindings/display/panel/sharp,ls037v7dw01.txt
```
SHARP LS037V7DW01 TFT-LCD panel
===================================

Required properties:
- compatible: "sharp,ls037v7dw01"

Optional properties:
- label: a symbolic name for the panel
- enable-gpios: a GPIO spec for the optional enable pin.
  This pin is the INI pin as specified in the LS037V7DW01.pdf file.
- reset-gpios: a GPIO spec for the optional reset pin.
  This pin is the RESB pin as specified in the LS037V7DW01.pdf file.
- mode-gpios: a GPIO
  ordered MO, LR, and UD as specified in the LS037V7DW01.pdf file.

Required nodes:
- Video port for DPI input

This panel can have zero to five GPIOs to configure to change configuration
between QVGA and VGA mode and the scan direction. As these pins can be also
configured with external pulls, all the GPIOs are considered optional with holes
in the array.

Example
-------

Example when connected to a omap2+ based device:

lcd0: display {
	compatible = "sharp,ls037v7dw01";
	power-supply = <&lcd_3v3>;
	enable-gpios = <&gpio5 24 GPIO_ACTIVE_HIGH>;	/* gpio152, lcd INI */
	reset-gpios = <&gpio5 27 GPIO_ACTIVE_HIGH>;	/* gpio155, lcd RESB */
	mode-gpios = <&gpio5 26 GPIO_ACTIVE_HIGH	/* gpio154, lcd MO */
		      &gpio1 2 GPIO_ACTIVE_HIGH		/* gpio2, lcd LR */
		      &gpio1 3 GPIO_ACTIVE_HIGH>;	/* gpio3, lcd UD */

	port {
		lcd_in: endpoint {
			remote-endpoint = <&dpi_out>;
		};
	};
};

/*
SHARP LS037V7DW01 TFT-LCD 패널
=======================

필수 속성 :
- 호환 가능 : "sharp, ls037v7dw01"

선택적 속성 :
- label : 패널의 상징적 인 이름
- enable-gpios : 선택적인 인 에이블 핀을위한 GPIO 스펙.
  이 핀은 LS037V7DW01.pdf 파일에 지정된 INI 핀입니다.
- reset-gpios : 옵션 리셋 핀을위한 GPIO 스펙.
  이 핀은 LS037V7DW01.pdf 파일에 지정된 RESB 핀이다.
- mode-gpios : GPIO
  LS037V7DW01.pdf 파일에 지정된대로 MO, LR 및 UD로 주문합니다.

필수 노드 :
- DPI 입력 용 비디오 포트

이 패널은 QVGA와 VGA 모드 및 스캔 방향 사이에서 컨피규레이션을 변경하도록 구성 할 수있는 GPIO를 0-5 개까지 가질 수 있습니다.

 이 핀들은 외부 풀 (pull)로 구성 될 수 있기 때문에 모든 GPIO는 어레이의 구멍과 함께 옵션으로 간주됩니다.

Example
-------

Example when connected to a omap2+ based device:

lcd0: display {
	compatible = "sharp,ls037v7dw01";
	power-supply = <&lcd_3v3>;
	enable-gpios = <&gpio5 24 GPIO_ACTIVE_HIGH>;	/* gpio152, lcd INI */
	reset-gpios = <&gpio5 27 GPIO_ACTIVE_HIGH>;	/* gpio155, lcd RESB */
	mode-gpios = <&gpio5 26 GPIO_ACTIVE_HIGH	/* gpio154, lcd MO */
		      &gpio1 2 GPIO_ACTIVE_HIGH		/* gpio2, lcd LR */
		      &gpio1 3 GPIO_ACTIVE_HIGH>;	/* gpio3, lcd UD */

	port {
		lcd_in: endpoint {
			remote-endpoint = <&dpi_out>;
		};
	};
};

*/
```

## Doc/DeviceDriver/devicetree/bindings/display/panel/shelly,sca07010-bfn-lnn.txt
```
Shelly SCA07010-BFN-LNN 7.0" WVGA TFT LCD panel

Required properties:
- compatible: should be "shelly,sca07010-bfn-lnn"

This binding is compatible with the simple-panel binding, which is specified
in simple-panel.txt in this directory.

/*
夹府 SCA07010-BFN-LNN 7.0 "WVGA TFT LCD 菩澄

鞘荐 加己 :
- 龋券 啊瓷 : "shelly, sca07010-bfn-lnn"捞绢具钦聪促.

捞 官牢爹篮捞 叼泛配府狼 simple-panel.txt俊 瘤沥等 窜鉴 菩澄 官牢爹苞 龋券邓聪促.
*/
```

## Doc/DeviceDriver/devicetree/bindings/display/panel/simple-panel.txt
```
Simple display panel

Required properties:
- power-supply: regulator to provide the supply voltage

Optional properties:
- ddc-i2c-bus: phandle of an I2C controller used for DDC EDID probing
- enable-gpios: GPIO pin to enable or disable the panel
- backlight: phandle of the backlight device attached to the panel

Example:

	panel: panel {
		compatible = "cptt,claa101wb01";
		ddc-i2c-bus = <&panelddc>;

		power-supply = <&vdd_pnl_reg>;
		enable-gpios = <&gpio 90 0>;

		backlight = <&backlight>;
	};

/*
埃窜茄 叼胶敲饭捞 菩澄

鞘荐 加己 :
- 傈盔 傍鞭 厘摹 : 傍鞭 傈拘阑 力傍窍绰 炼沥扁

急琶利 加己 :
- ddc-i2c-bus : DDC EDID 橇肺葫俊 荤侩登绰 I2C 牧飘费矾狼 phandle
- enable-gpios : 菩澄阑 劝己拳 肚绰 厚劝己拳窍绰 GPIO 巧
- 归扼捞飘 : 菩澄俊 何馒 等 归扼捞飘 厘摹狼 phandle

Example:

	panel: panel {
		compatible = "cptt,claa101wb01";
		ddc-i2c-bus = <&panelddc>;

		power-supply = <&vdd_pnl_reg>;
		enable-gpios = <&gpio 90 0>;

		backlight = <&backlight>;
	};


*/
```

## Doc/DeviceDriver/devicetree/bindings/display/panel/sony,acx565akm.txt
```
Sony ACX565AKM SDI Panel
========================

Required properties:
- compatible: "sony,acx565akm"

Optional properties:
- label: a symbolic name for the panel
- reset-gpios: panel reset gpio

Required nodes:
- Video port for SDI input

Example
-------

acx565akm@2 {
	compatible = "sony,acx565akm";
	spi-max-frequency = <6000000>;
	reg = <2>;

	label = "lcd";
	reset-gpios = <&gpio3 26 GPIO_ACTIVE_HIGH>; /* 90 */

	port {
		lcd_in: endpoint {
			remote-endpoint = <&sdi_out>;
		};
	};
};


/*
家聪 ACX565AKM SDI 菩澄
============

鞘荐 加己 :
- 龋券 : "sony, acx565akm"

急琶利 加己 :
- label : 菩澄狼 惑隆利 牢 捞抚
- reset-gpios : 菩澄 犁汲沥 gpio

鞘荐 畴靛 :
- SDI 涝仿 侩 厚叼坷 器飘

Example
-------

acx565akm@2 {
	compatible = "sony,acx565akm";
	spi-max-frequency = <6000000>;
	reg = <2>;

	label = "lcd";
	reset-gpios = <&gpio3 26 GPIO_ACTIVE_HIGH>; /* 90 */

	port {
		lcd_in: endpoint {
			remote-endpoint = <&sdi_out>;
		};
	};
};


*/
```

## Doc/DeviceDriver/devicetree/bindings/display/panel/toppoly,td028ttec1.txt
```
Toppoly TD028TTEC1 Panel
========================

Required properties:
- compatible: "toppoly,td028ttec1"

Optional properties:
- label: a symbolic name for the panel

Required nodes:
- Video port for DPI input

Example
-------

lcd-panel: td028ttec1@0 {
	compatible = "toppoly,td028ttec1";
	reg = <0>;
	spi-max-frequency = <100000>;
	spi-cpol;
	spi-cpha;

	label = "lcd";
	port {
		lcd_in: endpoint {
			remote-endpoint = <&dpi_out>;
		};
	};
};


/*
Toppoly TD028TTEC1 菩澄
============

鞘荐 加己 :
- 龋券 : "toppoly, td028ttec1"

急琶利 加己 :
- label : 菩澄狼 惑隆利 牢 捞抚

鞘荐 畴靛 :
- DPI 涝仿 侩 厚叼坷 器飘

Example
-------

lcd-panel: td028ttec1@0 {
	compatible = "toppoly,td028ttec1";
	reg = <0>;
	spi-max-frequency = <100000>;
	spi-cpol;
	spi-cpha;

	label = "lcd";
	port {
		lcd_in: endpoint {
			remote-endpoint = <&dpi_out>;
		};
	};
};


*/
```

## Doc/DeviceDriver/devicetree/bindings/display/panel/tpo,td043mtea1.txt
```
TPO TD043MTEA1 Panel
====================

Required properties:
- compatible: "tpo,td043mtea1"
- reset-gpios: panel reset gpio

Optional properties:
- label: a symbolic name for the panel

Required nodes:
- Video port for DPI input

Example
-------

lcd-panel: panel@0 {
	compatible = "tpo,td043mtea1";
	reg = <0>;
	spi-max-frequency = <100000>;
	spi-cpol;
	spi-cpha;

	label = "lcd";

	reset-gpios = <&gpio7 7 0>;

	port {
		lcd_in: endpoint {
			remote-endpoint = <&dpi_out>;
		};
	};
};

/*
TPO TD043MTEA1 菩澄
================

鞘荐 加己 :
- 龋券 : "tpo, td043mtea1"
- reset-gpios : 菩澄 犁汲沥 gpio

急琶利 加己 :
- label : 菩澄狼 惑隆利 牢 捞抚

鞘荐 畴靛 :
- DPI 涝仿 侩 厚叼坷 器飘


Example
-------

lcd-panel: panel@0 {
	compatible = "tpo,td043mtea1";
	reg = <0>;
	spi-max-frequency = <100000>;
	spi-cpol;
	spi-cpha;

	label = "lcd";

	reset-gpios = <&gpio7 7 0>;

	port {
		lcd_in: endpoint {
			remote-endpoint = <&dpi_out>;
		};
	};
};


*/
```

## Doc/DeviceDriver/devicetree/bindings/display/rockchip/dw_hdmi-rockchip.txt
```
Rockchip specific extensions to the Synopsys Designware HDMI
================================

Required properties:
- compatible: "rockchip,rk3288-dw-hdmi";
- reg: Physical base address and length of the controller's registers.
- clocks: phandle to hdmi iahb and isfr clocks.
- clock-names: should be "iahb" "isfr"
- rockchip,grf: this soc should set GRF regs to mux vopl/vopb.
- interrupts: HDMI interrupt number
- ports: contain a port node with endpoint definitions as defined in
  Documentation/devicetree/bindings/media/video-interfaces.txt. For
  vopb,set the reg = <0> and set the reg = <1> for vopl.
- reg-io-width: the width of the reg:1,4, the value should be 4 on
  rk3288 platform

Optional properties
- ddc-i2c-bus: phandle of an I2C controller used for DDC EDID probing
- clocks, clock-names: phandle to the HDMI CEC clock, name should be "cec"

Example:
hdmi: hdmi@ff980000 {
	compatible = "rockchip,rk3288-dw-hdmi";
	reg = <0xff980000 0x20000>;
	reg-io-width = <4>;
	ddc-i2c-bus = <&i2c5>;
	rockchip,grf = <&grf>;
	interrupts = <GIC_SPI 103 IRQ_TYPE_LEVEL_HIGH>;
	clocks = <&cru  PCLK_HDMI_CTRL>, <&cru SCLK_HDMI_HDCP>;
	clock-names = "iahb", "isfr";
	status = "disabled";
	ports {
		hdmi_in: port {
			#address-cells = <1>;
			#size-cells = <0>;
			hdmi_in_vopb: endpoint@0 {
				reg = <0>;
				remote-endpoint = <&vopb_out_hdmi>;
			};
			hdmi_in_vopl: endpoint@1 {
				reg = <1>;
				remote-endpoint = <&vopl_out_hdmi>;
			};
		};
	};
};


/*
Synopsys Designware HDMI에 대한 Rockchip 전용 확장
==================

필수 속성 :
- 호환 : "rockchip, rk3288-dw-hdmi";
- reg : 컨트롤러의 레지스터의 물리적 인 기본 주소와 길이.
- 시계 : hdmi iahb 및 isfr 시계에 대한 phandle.
- 시계 이름 : "iahb"이어야합니다 "isfr"
- rockchip, grf :이 soc는 GRF 레지스터를 mux vop / vopb로 설정해야합니다.
- 인터럽트 : HDMI 인터럽트 번호
- 포트 : 정의 된 끝점 정의가있는 포트 노드를 포함합니다.
  Documentation / devicetree / bindings / media / video-interfaces.txt. vopb의 경우 reg = <0>을 설정하고 vop에 reg = <1>을 설정합니다.
- reg-io-width : reg의 너비 : 1,4, rk3288 플랫폼에서 값은 4 여야합니다.

선택적 속성
- ddc-i2c-bus : DDC EDID 프로빙에 사용되는 I2C 컨트롤러의 phandle
- 클럭, 클럭 이름 : HDMI CEC 클록에 대한 phandle, 이름은 "cec"여야합니다.

Example:
hdmi: hdmi@ff980000 {
	compatible = "rockchip,rk3288-dw-hdmi";
	reg = <0xff980000 0x20000>;
	reg-io-width = <4>;
	ddc-i2c-bus = <&i2c5>;
	rockchip,grf = <&grf>;
	interrupts = <GIC_SPI 103 IRQ_TYPE_LEVEL_HIGH>;
	clocks = <&cru  PCLK_HDMI_CTRL>, <&cru SCLK_HDMI_HDCP>;
	clock-names = "iahb", "isfr";
	status = "disabled";
	ports {
		hdmi_in: port {
			#address-cells = <1>;
			#size-cells = <0>;
			hdmi_in_vopb: endpoint@0 {
				reg = <0>;
				remote-endpoint = <&vopb_out_hdmi>;
			};
			hdmi_in_vopl: endpoint@1 {
				reg = <1>;
				remote-endpoint = <&vopl_out_hdmi>;
			};
		};
	};
};

*/
```

## Doc/DeviceDriver/devicetree/bindings/display/rockchip/rockchip-drm.txt
```
Rockchip DRM master device
================================

The Rockchip DRM master device is a virtual device needed to list all
vop devices or other display interface nodes that comprise the
graphics subsystem.

Required properties:
- compatible: Should be "rockchip,display-subsystem"
- ports: Should contain a list of phandles pointing to display interface port
  of vop devices. vop definitions as defined in
  Documentation/devicetree/bindings/display/rockchip/rockchip-vop.txt

example:

display-subsystem {
	compatible = "rockchip,display-subsystem";
	ports = <&vopl_out>, <&vopb_out>;
};

/*
Rockchip DRM 付胶磐 厘摹
==================

Rockchip DRM 付胶磐 厘摹绰 弊贰侨 厘摹甫 备己窍绰 葛电 vop 厘摹 肚绰 扁鸥 叼胶敲饭捞 牢磐其捞胶 畴靛甫 唱凯窍绰 单 鞘夸茄 啊惑 厘摹涝聪促.

鞘荐 加己 :
- 龋券 : "rockchip, display-subsystem"捞绢具 窃
- 器飘 : vop 厘摹狼 叼胶敲饭捞 牢磐其捞胶 器飘甫 啊府虐绰 phandles 格废阑 器窃秦具钦聪促.

vop definitions as defined in
  Documentation/devicetree/bindings/display/rockchip/rockchip-vop.txt

example:

display-subsystem {
	compatible = "rockchip,display-subsystem";
	ports = <&vopl_out>, <&vopb_out>;
};

*/
```
