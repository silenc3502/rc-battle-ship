## Doc/DeviceDriver/devicetree/bindings/display/panel/lg,ld070wx3-sl01.txt
```
LG Corporation 7" WXGA TFT LCD panel

Required properties:
- compatible: should be "lg,ld070wx3-sl01"

This binding is compatible with the simple-panel binding, which is specified
in simple-panel.txt in this directory.
/*
LG 傈磊 7 "WXGA TFT LCD 菩澄

鞘荐 加己 :
- 龋券 啊瓷 : "lg, ld070wx3-sl01"捞绢具钦聪促.

捞 官牢爹篮捞 叼泛配府狼 simple-panel.txt俊 瘤沥等 窜鉴 菩澄 官牢爹苞 龋券邓聪促.
*/
```

## Doc/DeviceDriver/devicetree/bindings/display/panel/lg,lg4573.txt
```
LG LG4573 TFT Liquid Crystal Display with SPI control bus

Required properties:
  - compatible: "lg,lg4573"
  - reg: address of the panel on the SPI bus

The panel must obey rules for SPI slave device specified in document [1].

[1]: Documentation/devicetree/bindings/spi/spi-bus.txt

Example:

	lcd_panel: display@0 {
		#address-cells = <1>;
		#size-cells = <1>;
		compatible = "lg,lg4573";
		spi-max-frequency = <10000000>;
		reg = <0>;
	};

/*
LG 전자 LG4573 TFT 액정 디스플레이 SPI 컨트롤 버스

필수 속성 :
   - 호환 : "lg, lg4573"
   - reg : SPI 버스의 패널 주소

패널은 문서 [1]에 명시된 SPI 슬레이브 장치에 대한 규칙을 따라야합니다.

[1]: Documentation/devicetree/bindings/spi/spi-bus.txt

Example:

	lcd_panel: display@0 {
		#address-cells = <1>;
		#size-cells = <1>;
		compatible = "lg,lg4573";
		spi-max-frequency = <10000000>;
		reg = <0>;
	};

*/
```

## Doc/DeviceDriver/devicetree/bindings/display/panel/lg,lh500wx1-sd03.txt
```
LG Corporation 5" HD TFT LCD panel

Required properties:
- compatible: should be "lg,lh500wx1-sd03"

This binding is compatible with the simple-panel binding, which is specified
in simple-panel.txt in this directory.

/*
LG 傈磊 5 "HD TFT LCD 菩澄

鞘荐 加己 :
- 龋券 啊瓷 : "lg, lh500wx1-sd03"捞绢具钦聪促.

捞 官牢爹篮捞 叼泛配府狼 simple-panel.txt俊 瘤沥等 窜鉴 菩澄 官牢爹苞 龋券邓聪促.
*/
```

## Doc/DeviceDriver/devicetree/bindings/display/panel/lg,lp129qe.txt
```
LG 12.9" (2560x1700 pixels) TFT LCD panel

Required properties:
- compatible: should be "lg,lp129qe"

This binding is compatible with the simple-panel binding, which is specified
in simple-panel.txt in this directory.

/*
LG 12.9 牢摹 (2560x1700 侨伎) TFT LCD 菩澄

鞘荐 加己 :
- 龋券 啊瓷 : "lg, lp129qe"咯具钦聪促.

捞 官牢爹篮捞 叼泛配府狼 simple-panel.txt俊 瘤沥等 窜鉴 菩澄 官牢爹苞 龋券邓聪促.
*/
```

## Doc/DeviceDriver/devicetree/bindings/display/panel/lgphilips,lb035q02.txt
```
LG.Philips LB035Q02 Panel
=========================

Required properties:
- compatible: "lgphilips,lb035q02"
- enable-gpios: panel enable gpio

Optional properties:
- label: a symbolic name for the panel

Required nodes:
- Video port for DPI input

Example
-------

lcd-panel: panel@0 {
	compatible = "lgphilips,lb035q02";
	reg = <0>;
	spi-max-frequency = <100000>;
	spi-cpol;
	spi-cpha;

	label = "lcd";

	enable-gpios = <&gpio7 7 0>;

	port {
		lcd_in: endpoint {
			remote-endpoint = <&dpi_out>;
		};
	};
};

/*
LG.Philips LB035Q02 菩澄
=============

鞘荐 加己 :
- 龋券 : "lgphilips, lb035q02"
- enable-gpios : 菩澄 荤侩 啊瓷 gpio

急琶利 加己 :
- label : 菩澄狼 惑隆利 牢 捞抚

鞘荐 畴靛 :
- DPI 涝仿 侩 厚叼坷 器飘

Example
-------

lcd-panel: panel@0 {
	compatible = "lgphilips,lb035q02";
	reg = <0>;
	spi-max-frequency = <100000>;
	spi-cpol;
	spi-cpha;

	label = "lcd";

	enable-gpios = <&gpio7 7 0>;

	port {
		lcd_in: endpoint {
			remote-endpoint = <&dpi_out>;
		};
	};
};

*/
```

## Doc/DeviceDriver/devicetree/bindings/display/panel/nec,nl4827hc19-05b.txt
```
NEC LCD Technologies,Ltd. WQVGA TFT LCD panel

Required properties:
- compatible: should be "nec,nl4827hc19-05b"

This binding is compatible with the simple-panel binding, which is specified
in simple-panel.txt in this directory.

/*
NEC LCD Technologies, Ltd. WQVGA TFT LCD 菩澄

鞘荐 加己 :
- 龋券 啊瓷 : "nec, nl4827hc19-05b"咯具钦聪促.

捞 官牢爹篮捞 叼泛配府狼 simple-panel.txt俊 瘤沥等 窜鉴 菩澄 官牢爹苞 龋券邓聪促.
*/
```

## Doc/DeviceDriver/devicetree/bindings/display/panel/okaya,rs800480t-7x0gp.txt
```
OKAYA Electric America, Inc. RS800480T-7X0GP 7" WVGA LCD panel

Required properties:
- compatible: should be "okaya,rs800480t-7x0gp"

This binding is compatible with the simple-panel binding, which is specified
in simple-panel.txt in this directory.

/*
OKAYA Electric America, Inc. RS800480T-7X0GP 7 "WVGA LCD 菩澄

鞘荐 加己 :
- 龋券 : "okaya, rs800480t-7x0gp"捞绢具钦聪促.

捞 官牢爹篮捞 叼泛配府狼 simple-panel.txt俊 瘤沥等 窜鉴 菩澄 官牢爹苞 龋券邓聪促.
*/
```

## Doc/DeviceDriver/devicetree/bindings/display/panel/ortustech,com43h4m85ulc.txt
```
OrtusTech COM43H4M85ULC Blanview 3.7" TFT-LCD panel

Required properties:
- compatible: should be "ortustech,com43h4m85ulc"

This binding is compatible with the simple-panel binding, which is specified
in simple-panel.txt in this directory.

/*
OrtusTech COM43H4M85ULC Blanview 3.7 "TFT-LCD 菩澄

鞘荐 加己 :
- 龋券 啊瓷 : "ortustech, com43h4m85ulc"咯具钦聪促.

捞 官牢爹篮捞 叼泛配府狼 simple-panel.txt俊 瘤沥等 窜鉴 菩澄 官牢爹苞 龋券邓聪促.
*/
```

## Doc/DeviceDriver/devicetree/bindings/display/panel/panasonic,vvx10f004b00.txt
```
Panasonic Corporation 10.1" WUXGA TFT LCD panel

Required properties:
- compatible: should be "panasonic,vvx10f004b00"

This binding is compatible with the simple-panel binding, which is specified
in simple-panel.txt in this directory.

/*
Panasonic Corporation 10.1 "WUXGA TFT LCD 菩澄

鞘荐 加己 :
- 龋券 啊瓷 : "panasonic, vvx10f004b00"捞绢具钦聪促.

捞 官牢爹篮捞 叼泛配府狼 simple-panel.txt俊 瘤沥等 窜鉴 菩澄 官牢爹苞 龋券邓聪促.
*/
```

## Doc/DeviceDriver/devicetree/bindings/display/panel/panel-dpi.txt
```
Generic MIPI DPI Panel
======================

Required properties:
- compatible: "panel-dpi"

Optional properties:
- label: a symbolic name for the panel
- enable-gpios: panel enable gpio
- backlight: phandle of the backlight device attached to the panel

Required nodes:
- "panel-timing" containing video timings
  (Documentation/devicetree/bindings/display/display-timing.txt)
- Video port for DPI input

Example
-------

lcd0: display@0 {
        compatible = "samsung,lte430wq-f0c", "panel-dpi";
        label = "lcd";

        port {
            lcd_in: endpoint {
                    remote-endpoint = <&dpi_out>;
            };
        };

        panel-timing {
                clock-frequency = <9200000>;
                hactive = <480>;
                vactive = <272>;
                hfront-porch = <8>;
                hback-porch = <4>;
                hsync-len = <41>;
                vback-porch = <2>;
                vfront-porch = <4>;
                vsync-len = <10>;

                hsync-active = <0>;
                vsync-active = <0>;
                de-active = <1>;
                pixelclk-active = <1>;
        };
};

/*
일반 MIPI DPI 패널
==========

필수 속성 :
- 호환 : "panel-dpi"

선택적 속성 :
- label : 패널의 상징적 인 이름
- enable-gpios : 패널 사용 가능 gpio
- 백라이트 : 패널에 부착 된 백라이트 장치의 phandle

필수 노드 :
- 비디오 타이밍이 포함 된 "패널 타이밍"
  (Documentation / devicetree / bindings / display / display-timing.txt)
- DPI 입력 용 비디오 포트

Example
-------

lcd0: display@0 {
        compatible = "samsung,lte430wq-f0c", "panel-dpi";
        label = "lcd";

        port {
            lcd_in: endpoint {
                    remote-endpoint = <&dpi_out>;
            };
        };

        panel-timing {
                clock-frequency = <9200000>;
                hactive = <480>;
                vactive = <272>;
                hfront-porch = <8>;
                hback-porch = <4>;
                hsync-len = <41>;
                vback-porch = <2>;
                vfront-porch = <4>;
                vsync-len = <10>;

                hsync-active = <0>;
                vsync-active = <0>;
                de-active = <1>;
                pixelclk-active = <1>;
        };
};

*/
```

## Doc/DeviceDriver/devicetree/bindings/display/panel/panel-dsi-cm.txt
```
Generic MIPI DSI Command Mode Panel
===================================

Required properties:
- compatible: "panel-dsi-cm"

Optional properties:
- label: a symbolic name for the panel
- reset-gpios: panel reset gpio
- te-gpios: panel TE gpio

Required nodes:
- Video port for DSI input

Example
-------

lcd0: display {
	compatible = "tpo,taal", "panel-dsi-cm";
	label = "lcd0";

	reset-gpios = <&gpio4 6 GPIO_ACTIVE_HIGH>;

	port {
		lcd0_in: endpoint {
			remote-endpoint = <&dsi1_out_ep>;
		};
	};
};


/*
老馆 MIPI DSI 疙飞 葛靛 菩澄
=======================

鞘荐 加己 :
- 龋券 : "panel-dsi-cm"

急琶利 加己 :
- label : 菩澄狼 惑隆利 牢 捞抚
- reset-gpios : 菩澄 犁汲沥 gpio
- te-gpios : 菩澄 TE gpio

鞘荐 畴靛 :
- DSI 涝仿 侩 厚叼坷 器飘

Example
-------

lcd0: display {
	compatible = "tpo,taal", "panel-dsi-cm";
	label = "lcd0";

	reset-gpios = <&gpio4 6 GPIO_ACTIVE_HIGH>;

	port {
		lcd0_in: endpoint {
			remote-endpoint = <&dsi1_out_ep>;
		};
	};
};

*/
```

## Doc/DeviceDriver/devicetree/bindings/display/panel/samsung,ld9040.txt
```
Samsung LD9040 AMOLED LCD parallel RGB panel with SPI control bus

Required properties:
  - compatible: "samsung,ld9040"
  - reg: address of the panel on SPI bus
  - vdd3-supply: core voltage supply
  - vci-supply: voltage supply for analog circuits
  - reset-gpios: a GPIO spec for the reset pin
  - display-timings: timings for the connected panel according to [1]

The panel must obey rules for SPI slave device specified in document [2].

Optional properties:
  - power-on-delay: delay after turning regulators on [ms]
  - reset-delay: delay after reset sequence [ms]
  - panel-width-mm: physical panel width [mm]
  - panel-height-mm: physical panel height [mm]

The device node can contain one 'port' child node with one child
'endpoint' node, according to the bindings defined in [3]. This
node should describe panel's video bus.

[1]: Documentation/devicetree/bindings/display/display-timing.txt
[2]: Documentation/devicetree/bindings/spi/spi-bus.txt
[3]: Documentation/devicetree/bindings/media/video-interfaces.txt

Example:

	lcd@0 {
		compatible = "samsung,ld9040";
		reg = <0>;
		vdd3-supply = <&ldo7_reg>;
		vci-supply = <&ldo17_reg>;
		reset-gpios = <&gpy4 5 0>;
		spi-max-frequency = <1200000>;
		spi-cpol;
		spi-cpha;
		power-on-delay = <10>;
		reset-delay = <10>;
		panel-width-mm = <90>;
		panel-height-mm = <154>;

		display-timings {
			timing {
				clock-frequency = <23492370>;
				hactive = <480>;
				vactive = <800>;
				hback-porch = <16>;
				hfront-porch = <16>;
				vback-porch = <2>;
				vfront-porch = <28>;
				hsync-len = <2>;
				vsync-len = <1>;
				hsync-active = <0>;
				vsync-active = <0>;
				de-active = <0>;
				pixelclk-active = <0>;
			};
		};

		port {
			lcd_ep: endpoint {
				remote-endpoint = <&fimd_dpi_ep>;
			};
		};
	};

/*
삼성 LD9040 AMOLED LCD 병렬 RGB 패널 (SPI 제어 버스 포함)

필수 속성 :
  - 호환 : "samsung, ld9040"
  - reg : SPI 버스의 패널 주소
  - vdd3 공급 : 코어 전압 공급
  - vci-supply : 아날로그 회로 용 전압 공급 장치
  - reset-gpios : 리셋 핀을위한 GPIO 스펙
  - 디스플레이 타이밍 : [1]에 따라 연결된 패널의 타이밍

패널은 문서 [2]에 명시된 SPI 슬레이브 장치에 대한 규칙을 따라야합니다.

선택적 속성 :
  - 파워 온 지연 : [ms]에서 레귤레이터를 돌린 후 지연
  - 리셋 지연 : 리셋 시퀀스 후의 지연 [ms]
  - panel-width-mm : 실제 패널 너비 [mm]
  - panel-height-mm : 물리적 패널 높이 [mm]

디바이스 노드는 [3]에서 정의 된 바인딩에 따라 하나의 자식 '엔드 포인트'노드가있는 하나의 '포트'자식 노드를 포함 할 수 있습니다. 

이 노드는 패널의 비디오 버스를 설명해야합니다.

[1]: Documentation/devicetree/bindings/display/display-timing.txt
[2]: Documentation/devicetree/bindings/spi/spi-bus.txt
[3]: Documentation/devicetree/bindings/media/video-interfaces.txt

Example:

	lcd@0 {
		compatible = "samsung,ld9040";
		reg = <0>;
		vdd3-supply = <&ldo7_reg>;
		vci-supply = <&ldo17_reg>;
		reset-gpios = <&gpy4 5 0>;
		spi-max-frequency = <1200000>;
		spi-cpol;
		spi-cpha;
		power-on-delay = <10>;
		reset-delay = <10>;
		panel-width-mm = <90>;
		panel-height-mm = <154>;

		display-timings {
			timing {
				clock-frequency = <23492370>;
				hactive = <480>;
				vactive = <800>;
				hback-porch = <16>;
				hfront-porch = <16>;
				vback-porch = <2>;
				vfront-porch = <28>;
				hsync-len = <2>;
				vsync-len = <1>;
				hsync-active = <0>;
				vsync-active = <0>;
				de-active = <0>;
				pixelclk-active = <0>;
			};
		};

		port {
			lcd_ep: endpoint {
				remote-endpoint = <&fimd_dpi_ep>;
			};
		};
	};

*/
```

## Doc/DeviceDriver/devicetree/bindings/display/panel/samsung,ltn101nt05.txt
```
Samsung Electronics 10.1" WSVGA TFT LCD panel

Required properties:
- compatible: should be "samsung,ltn101nt05"

This binding is compatible with the simple-panel binding, which is specified
in simple-panel.txt in this directory.

/*
伙己 傈磊 10.1 牢摹 WSVGA TFT LCD 菩澄

鞘荐 加己 :
- 龋券 啊瓷 : "samsung, ltn101nt05"咯具钦聪促.

捞 官牢爹篮捞 叼泛配府狼 simple-panel.txt俊 瘤沥等 窜鉴 菩澄 官牢爹苞 龋券邓聪促.
*/
```

## Doc/DeviceDriver/devicetree/bindings/display/panel/samsung,ltn140at29-301.txt
```
Samsung Electronics 14" WXGA (1366x768) TFT LCD panel

Required properties:
- compatible: should be "samsung,ltn140at29-301"

This binding is compatible with the simple-panel binding, which is specified
in simple-panel.txt in this directory.

/*
伙己 傈磊 14 "WXGA (1366x768) TFT LCD 菩澄

鞘荐 加己 :
- 龋券 啊瓷 : "samsung, ltn140at29-301"捞绢具钦聪促.

捞 官牢爹篮捞 叼泛配府狼 simple-panel.txt俊 瘤沥等 窜鉴 菩澄 官牢爹苞 龋券邓聪促.
*/
```

## Doc/DeviceDriver/devicetree/bindings/display/panel/samsung,s6e8aa0.txt
```
Samsung S6E8AA0 AMOLED LCD 5.3 inch panel

Required properties:
  - compatible: "samsung,s6e8aa0"
  - reg: the virtual channel number of a DSI peripheral
  - vdd3-supply: core voltage supply
  - vci-supply: voltage supply for analog circuits
  - reset-gpios: a GPIO spec for the reset pin
  - display-timings: timings for the connected panel as described by [1]

Optional properties:
  - power-on-delay: delay after turning regulators on [ms]
  - reset-delay: delay after reset sequence [ms]
  - init-delay: delay after initialization sequence [ms]
  - panel-width-mm: physical panel width [mm]
  - panel-height-mm: physical panel height [mm]
  - flip-horizontal: boolean to flip image horizontally
  - flip-vertical: boolean to flip image vertically

The device node can contain one 'port' child node with one child
'endpoint' node, according to the bindings defined in [2]. This
node should describe panel's video bus.

[1]: Documentation/devicetree/bindings/display/display-timing.txt
[2]: Documentation/devicetree/bindings/media/video-interfaces.txt

Example:

	panel {
		compatible = "samsung,s6e8aa0";
		reg = <0>;
		vdd3-supply = <&vcclcd_reg>;
		vci-supply = <&vlcd_reg>;
		reset-gpios = <&gpy4 5 0>;
		power-on-delay= <50>;
		reset-delay = <100>;
		init-delay = <100>;
		panel-width-mm = <58>;
		panel-height-mm = <103>;
		flip-horizontal;
		flip-vertical;

		display-timings {
			timing0: timing-0 {
				clock-frequency = <57153600>;
				hactive = <720>;
				vactive = <1280>;
				hfront-porch = <5>;
				hback-porch = <5>;
				hsync-len = <5>;
				vfront-porch = <13>;
				vback-porch = <1>;
				vsync-len = <2>;
			};
		};
	};

/*
삼성 S6E8AA0 AMOLED LCD 5.3 인치 패널

필수 속성 :
  - 호환 : "samsung, s6e8aa0"
  - reg : DSI 주변 장치의 가상 채널 번호
  - vdd3 공급 : 코어 전압 공급
  - vci-supply : 아날로그 회로 용 전압 공급 장치
  - reset-gpios : 리셋 핀을위한 GPIO 스펙
  - 디스플레이 타이밍 : [1]에 설명 된 바와 같이 연결된 패널의 타이밍

선택적 속성 :
  - 파워 온 지연 : [ms]에서 레귤레이터를 돌린 후 지연
  - 리셋 지연 : 리셋 시퀀스 후의 지연 [ms]
  - 초기화 지연 : 초기화 시퀀스 후의 지연 [ms]
  - panel-width-mm : 실제 패널 너비 [mm]
  - panel-height-mm : 물리적 패널 높이 [mm]
  - flip-horizontal : 이미지를 수평으로 뒤집기위한 부울
  - flip-vertical : 이미지를 수직으로 뒤집기위한 부울

디바이스 노드는 [2]에서 정의 된 바인딩에 따라 하나의 자식 '엔드 포인트'노드가있는 하나의 '포트'자식 노드를 포함 할 수 있습니다. 

이 노드는 패널의 비디오 버스를 설명해야합니다.


[1]: Documentation/devicetree/bindings/display/display-timing.txt
[2]: Documentation/devicetree/bindings/media/video-interfaces.txt

Example:

	panel {
		compatible = "samsung,s6e8aa0";
		reg = <0>;
		vdd3-supply = <&vcclcd_reg>;
		vci-supply = <&vlcd_reg>;
		reset-gpios = <&gpy4 5 0>;
		power-on-delay= <50>;
		reset-delay = <100>;
		init-delay = <100>;
		panel-width-mm = <58>;
		panel-height-mm = <103>;
		flip-horizontal;
		flip-vertical;

		display-timings {
			timing0: timing-0 {
				clock-frequency = <57153600>;
				hactive = <720>;
				vactive = <1280>;
				hfront-porch = <5>;
				hback-porch = <5>;
				hsync-len = <5>;
				vfront-porch = <13>;
				vback-porch = <1>;
				vsync-len = <2>;
			};
		};
	};

*/
```
