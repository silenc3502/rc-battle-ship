## Doc/DeviceDriver/devicetree/bindings/dma/arm-pl330.txt
```
* ARM PrimeCell PL330 DMA Controller

The ARM PrimeCell PL330 DMA controller can move blocks of memory contents
between memory and peripherals or memory to memory.

Required properties:
  - compatible: should include both "arm,pl330" and "arm,primecell".
  - reg: physical base address of the controller and length of memory mapped
    region.
  - interrupts: interrupt number to the cpu.

Optional properties:
  - dma-coherent      : Present if dma operations are coherent
  - #dma-cells: must be <1>. used to represent the number of integer
    cells in the dmas property of client device.
  - dma-channels: contains the total number of DMA channels supported by the DMAC
  - dma-requests: contains the total number of DMA requests supported by the DMAC

Example:

	pdma0: pdma@12680000 {
		compatible = "arm,pl330", "arm,primecell";
		reg = <0x12680000 0x1000>;
		interrupts = <99>;
		#dma-cells = <1>;
		#dma-channels = <8>;
		#dma-requests = <32>;
	};

Client drivers (device nodes requiring dma transfers from dev-to-mem or
mem-to-dev) should specify the DMA channel numbers and dma channel names
as shown below.

  [property name]  = <[phandle of the dma controller] [dma request id]>;
  [property name]  = <[dma channel name]>

      where 'dma request id' is the dma request number which is connected
      to the client controller. The 'property name' 'dmas' and 'dma-names'
      as required by the generic dma device tree binding helpers. The dma
      names correspond 1:1 with the dma request ids in the dmas property.

  Example:  dmas = <&pdma0 12
		    &pdma1 11>;
	    dma-names = "tx", "rx";


/*
* ARM PrimeCell PL330 DMA 컨트롤러

ARM PrimeCell PL330 DMA 컨트롤러는 메모리 내용 블록을 이동할 수 있습니다
메모리와 주변 장치 또는 메모리와 메모리 사이.

필수 속성 :
  - compatible : "arm, pl330"및 "arm, primecell"을 모두 포함해야합니다.
  - reg : 컨트롤러의 물리적 기본 주소와 매핑 된 메모리의 길이
    부위.
  - interrupts : CPU에 대한 인터럽트 번호.

선택적 속성 :
  - dma-coherent : dma 작업이 일관성이 있다면 제시하십시오.
  - # dma-cells : <1>이어야합니다. 정수의 수를 나타내는 데 사용됩니다.
    클라이언트 장치의 dmas 속성에있는 셀
  - dma-channels : DMAC에서 지원하는 총 DMA 채널 수를 포함합니다.
  - dma-requests : DMAC에서 지원하는 총 DMA 요청 수를 포함합니다.

예:

pdma0 : pdma @ 12680000 {
compatible = "arm, pl330", "arm, primecell";
reg = <0x12680000 0x1000>;
인터럽트 = <99>;
# dma-cells = <1>;
# dma-channels = <8>;
# dma-requests = <32>;
};

클라이언트 드라이버 (dev-to-mem 또는 dma에서 dma 전송을 필요로하는 장치 노드
mem-to-dev)는 DMA 채널 번호와 dma 채널 이름을 지정해야합니다
아래 그림과 같이.

  [속성 이름] = <[DMA 컨트롤러의 phandle드] [dma request id]>;
  [속성 이름] = <[DMA 채널 이름]>

      여기서 'dma request id'는 연결된 dma 요청 번호입니다.
      클라이언트 컨트롤러에. '속성 이름' 'dmas'및 'dma-names'
      일반 dma 장치 트리 바인딩 도우미에서 필요에 따라 DMA
      이름은 dmas 속성의 dma 요청 ids와 1 : 1에 해당합니다.

  Example:  dmas = <&pdma0 12
		    &pdma1 11>;
	    dma-names = "tx", "rx";

*/
```

## Doc/DeviceDriver/devicetree/bindings/dma/atmel-dma.txt
```
* Atmel Direct Memory Access Controller (DMA)

Required properties:
- compatible: Should be "atmel,<chip>-dma".
- reg: Should contain DMA registers location and length.
- interrupts: Should contain DMA interrupt.
- #dma-cells: Must be <2>, used to represent the number of integer cells in
the dmas property of client devices.

Example:

dma0: dma@ffffec00 {
	compatible = "atmel,at91sam9g45-dma";
	reg = <0xffffec00 0x200>;
	interrupts = <21>;
	#dma-cells = <2>;
};

DMA clients connected to the Atmel DMA controller must use the format
described in the dma.txt file, using a three-cell specifier for each channel:
a phandle plus two integer cells.
The three cells in order are:

1. A phandle pointing to the DMA controller.
2. The memory interface (16 most significant bits), the peripheral interface
(16 less significant bits).
3. Parameters for the at91 DMA configuration register which are device
dependent:
  - bit 7-0: peripheral identifier for the hardware handshaking interface. The
  identifier can be different for tx and rx.
  - bit 11-8: FIFO configuration. 0 for half FIFO, 1 for ALAP, 2 for ASAP.

Example:

i2c0@i2c@f8010000 {
	compatible = "atmel,at91sam9x5-i2c";
	reg = <0xf8010000 0x100>;
	interrupts = <9 4 6>;
	dmas = <&dma0 1 7>,
	       <&dma0 1 8>;
	dma-names = "tx", "rx";
};

/*
Atmel 직접 메모리 액세스 컨트롤러 (DMA)

필수 속성 :
- 호환 : "atmel, <chip> -dma"여야합니다.
- reg : DMA 레지스터 위치와 길이를 포함해야합니다.
- interrupts : DMA 인터럽트를 포함해야합니다.
- # dma-cells : <2> 여야하며 클라이언트 장치의 dmas 등록 정보에있는 정수 셀 수를 나타냅니다.


Example:

dma0: dma@ffffec00 {
	compatible = "atmel,at91sam9g45-dma";
	reg = <0xffffec00 0x200>;
	interrupts = <21>;
	#dma-cells = <2>;
};

Atmel DMA 컨트롤러에 연결된 DMA 클라이언트는 각 채널에 3 셀 지정자를 사용하여 dma.txt 파일에 설명 된 형식을 사용해야합니다.
phandle과 2 개의 정수 셀.
세 개의 셀은 순서대로 있습니다.

1. DMA 컨트롤러를 가리키는 phandle.
2. 메모리 인터페이스 (16 개의 최상위 비트), 주변 장치 인터페이스
(16 개의 하위 비트).
3. 장치 인 at91 DMA 구성 레지스터의 매개 변수
매달린:
  - 비트 7-0 : 하드웨어 핸드 쉐이킹 인터페이스의 주변 장치 식별자. 식별자는 tx와 rx에서 다를 수 있습니다.
  - 비트 11-8 : FIFO 구성. 절반 FIFO의 경우 0, ALAP의 경우 1, ASAP의 경우 2.

Example:

i2c0@i2c@f8010000 {
	compatible = "atmel,at91sam9x5-i2c";
	reg = <0xf8010000 0x100>;
	interrupts = <9 4 6>;
	dmas = <&dma0 1 7>,
	       <&dma0 1 8>;
	dma-names = "tx", "rx";
};


*/
```

## Doc/DeviceDriver/devicetree/bindings/dma/atmel-xdma.txt
```
* Atmel Extensible Direct Memory Access Controller (XDMAC)

* XDMA Controller
Required properties:
- compatible: Should be "atmel,<chip>-dma".
  <chip> compatible description:
  - sama5d4: first SoC adding the XDMAC
- reg: Should contain DMA registers location and length.
- interrupts: Should contain DMA interrupt.
- #dma-cells: Must be <1>, used to represent the number of integer cells in
the dmas property of client devices.
  - The 1st cell specifies the channel configuration register:
    - bit 13: SIF, source interface identifier, used to get the memory
    interface identifier,
    - bit 14: DIF, destination interface identifier, used to get the peripheral
    interface identifier,
    - bit 30-24: PERID, peripheral identifier.

Example:

dma1: dma-controller@f0004000 {
	compatible = "atmel,sama5d4-dma";
	reg = <0xf0004000 0x200>;
	interrupts = <50 4 0>;
	#dma-cells = <1>;
};


* DMA clients
DMA clients connected to the Atmel XDMA controller must use the format
described in the dma.txt file, using a one-cell specifier for each channel.
The two cells in order are:
1. A phandle pointing to the DMA controller.
2. Channel configuration register. Configurable fields are:
    - bit 13: SIF, source interface identifier, used to get the memory
    interface identifier,
    - bit 14: DIF, destination interface identifier, used to get the peripheral
    interface identifier,
  - bit 30-24: PERID, peripheral identifier.

Example:

i2c2: i2c@f8024000 {
	compatible = "atmel,at91sam9x5-i2c";
	reg = <0xf8024000 0x4000>;
	interrupts = <34 4 6>;
	dmas = <&dma1
		(AT91_XDMAC_DT_MEM_IF(0) | AT91_XDMAC_DT_PER_IF(1)
		 | AT91_XDMAC_DT_PERID(6))>,
	       <&dma1
		(AT91_XDMAC_DT_MEM_IF(0) | AT91_XDMAC_DT_PER_IF(1)
		| AT91_XDMAC_DT_PERID(7))>;
	dma-names = "tx", "rx";
};

/*
Atmel XDMAC (Extensible Direct Memory Access Controller)

* XDMA 컨트롤러
필수 속성 :
- 호환 : "atmel, <chip> -dma"여야합니다.
  <chip> 호환 설명 :
  - sama5d4 : 최초의 SoC, XDMAC 추가
- reg : DMA 레지스터 위치와 길이를 포함해야합니다.
- interrupts : DMA 인터럽트를 포함해야합니다.
- # dma-cells : <1>이어야하며 클라이언트 장치의 dmas 등록 정보에있는 정수 셀 수를 나타냅니다.
  - 첫 번째 셀은 채널 구성 레지스터를 지정합니다.
    - 비트 13 : SIF, 메모리 인터페이스 식별자를 얻기 위해 사용되는 소스 인터페이스 식별자,
    - 비트 14 : 주변 인터페이스 식별자를 얻기 위해 사용되는 DIF, 목적지 인터페이스 식별자,
    - 비트 30-24 : PERID, 주변 장치 식별자.


Example:

dma1: dma-controller@f0004000 {
	compatible = "atmel,sama5d4-dma";
	reg = <0xf0004000 0x200>;
	interrupts = <50 4 0>;
	#dma-cells = <1>;
};


* DMA 클라이언트
Atmel XDMA 컨트롤러에 연결된 DMA 클라이언트는 각 채널에 대해 1 셀 지정자를 사용하여 dma.txt 파일에 설명 된 형식을 사용해야합니다.
두 개의 셀은 순서대로 있습니다.
1. DMA 컨트롤러를 가리키는 phandle.
2. 채널 구성 레지스터. 구성 가능한 필드는 다음과 같습니다.
    - 비트 13 : SIF, 메모리 인터페이스 식별자를 얻기 위해 사용되는 소스 인터페이스 식별자,
    - 비트 14 : 주변 인터페이스 식별자를 얻기 위해 사용되는 DIF, 목적지 인터페이스 식별자,
  - 비트 30-24 : PERID, 주변 장치 식별자.

Example:

i2c2: i2c@f8024000 {
	compatible = "atmel,at91sam9x5-i2c";
	reg = <0xf8024000 0x4000>;
	interrupts = <34 4 6>;
	dmas = <&dma1
		(AT91_XDMAC_DT_MEM_IF(0) | AT91_XDMAC_DT_PER_IF(1)
		 | AT91_XDMAC_DT_PERID(6))>,
	       <&dma1
		(AT91_XDMAC_DT_MEM_IF(0) | AT91_XDMAC_DT_PER_IF(1)
		| AT91_XDMAC_DT_PERID(7))>;
	dma-names = "tx", "rx";
};

*/
```

## Doc/DeviceDriver/devicetree/bindings/dma/brcm,bcm2835-dma.txt
```
* BCM2835 DMA controller

The BCM2835 DMA controller has 16 channels in total.
Only the lower 13 channels have an associated IRQ.
Some arbitrary channels are used by the firmware
(1,3,6,7 in the current firmware version).
The channels 0,2 and 3 have special functionality
and should not be used by the driver.

Required properties:
- compatible: Should be "brcm,bcm2835-dma".
- reg: Should contain DMA registers location and length.
- interrupts: Should contain the DMA interrupts associated
		to the DMA channels in ascending order.
- #dma-cells: Must be <1>, the cell in the dmas property of the
		client device represents the DREQ number.
- brcm,dma-channel-mask: Bit mask representing the channels
			 not used by the firmware in ascending order,
			 i.e. first channel corresponds to LSB.

Example:

dma: dma@7e007000 {
	compatible = "brcm,bcm2835-dma";
	reg = <0x7e007000 0xf00>;
	interrupts = <1 16>,
		     <1 17>,
		     <1 18>,
		     <1 19>,
		     <1 20>,
		     <1 21>,
		     <1 22>,
		     <1 23>,
		     <1 24>,
		     <1 25>,
		     <1 26>,
		     <1 27>,
		     <1 28>;

	#dma-cells = <1>;
	brcm,dma-channel-mask = <0x7f35>;
};

DMA clients connected to the BCM2835 DMA controller must use the format
described in the dma.txt file, using a two-cell specifier for each channel.

Example:

bcm2835_i2s: i2s@7e203000 {
	compatible = "brcm,bcm2835-i2s";
	reg = <	0x7e203000 0x20>,
	      < 0x7e101098 0x02>;

	dmas = <&dma 2>,
	       <&dma 3>;
	dma-names = "tx", "rx";
};


/*
* BCM2835 DMA 컨트롤러

BCM2835 DMA 컨트롤러에는 총 16 개의 채널이 있습니다.
하위 13 개 채널에만 관련 IRQ가 있습니다.
일부 임의 채널은 펌웨어 (현재 펌웨어 버전의 1,3,6,7)에서 사용됩니다.
채널 0,2 및 3은 특수 기능을 가지므로 드라이버에서 사용하면 안됩니다.

필수 속성 :
- 호환 : "brcm, bcm2835-dma"여야합니다.
- reg : DMA 레지스터 위치와 길이를 포함해야합니다.
- 인터럽트 : DMA 채널과 연관된 DMA 인터럽트를 오름차순으로 포함해야합니다.
- # dma-cells : <1>이어야하며, 클라이언트 장치의 dmas 등록 정보에있는 셀은 DREQ 번호를 나타냅니다.
- brcm, dma-channel-mask : 펌웨어에서 사용하지 않는 채널을 오름차순으로 나타내는 비트 마스크입니다. 즉, 첫 번째 채널은 LSB에 해당합니다.

Example:

dma: dma@7e007000 {
	compatible = "brcm,bcm2835-dma";
	reg = <0x7e007000 0xf00>;
	interrupts = <1 16>,
		     <1 17>,
		     <1 18>,
		     <1 19>,
		     <1 20>,
		     <1 21>,
		     <1 22>,
		     <1 23>,
		     <1 24>,
		     <1 25>,
		     <1 26>,
		     <1 27>,
		     <1 28>;

	#dma-cells = <1>;
	brcm,dma-channel-mask = <0x7f35>;
};

DMA clients connected to the BCM2835 DMA controller must use the format
described in the dma.txt file, using a two-cell specifier for each channel.

Example:

bcm2835_i2s: i2s@7e203000 {
	compatible = "brcm,bcm2835-i2s";
	reg = <	0x7e203000 0x20>,
	      < 0x7e101098 0x02>;

	dmas = <&dma 2>,
	       <&dma 3>;
	dma-names = "tx", "rx";
};

*/
```
