## Doc/DeviceDriver/devicetree/bindings/display/tegra/nvidia,tegra20-host1x.txt
```
NVIDIA Tegra host1x

Required properties:
- compatible: "nvidia,tegra<chip>-host1x"
- reg: Physical base address and length of the controller's registers.
- interrupts: The interrupt outputs from the controller.
- #address-cells: The number of cells used to represent physical base addresses
  in the host1x address space. Should be 1.
- #size-cells: The number of cells used to represent the size of an address
  range in the host1x address space. Should be 1.
- ranges: The mapping of the host1x address space to the CPU address space.
- clocks: Must contain one entry, for the module clock.
  See ../clocks/clock-bindings.txt for details.
- resets: Must contain an entry for each entry in reset-names.
  See ../reset/reset.txt for details.
- reset-names: Must include the following entries:
  - host1x

The host1x top-level node defines a number of children, each representing one
of the following host1x client modules:

- mpe: video encoder

  Required properties:
  - compatible: "nvidia,tegra<chip>-mpe"
  - reg: Physical base address and length of the controller's registers.
  - interrupts: The interrupt outputs from the controller.
  - clocks: Must contain one entry, for the module clock.
    See ../clocks/clock-bindings.txt for details.
  - resets: Must contain an entry for each entry in reset-names.
    See ../reset/reset.txt for details.
  - reset-names: Must include the following entries:
    - mpe

- vi: video input

  Required properties:
  - compatible: "nvidia,tegra<chip>-vi"
  - reg: Physical base address and length of the controller's registers.
  - interrupts: The interrupt outputs from the controller.
  - clocks: Must contain one entry, for the module clock.
    See ../clocks/clock-bindings.txt for details.
  - resets: Must contain an entry for each entry in reset-names.
    See ../reset/reset.txt for details.
  - reset-names: Must include the following entries:
    - vi

- epp: encoder pre-processor

  Required properties:
  - compatible: "nvidia,tegra<chip>-epp"
  - reg: Physical base address and length of the controller's registers.
  - interrupts: The interrupt outputs from the controller.
  - clocks: Must contain one entry, for the module clock.
    See ../clocks/clock-bindings.txt for details.
  - resets: Must contain an entry for each entry in reset-names.
    See ../reset/reset.txt for details.
  - reset-names: Must include the following entries:
    - epp

- isp: image signal processor

  Required properties:
  - compatible: "nvidia,tegra<chip>-isp"
  - reg: Physical base address and length of the controller's registers.
  - interrupts: The interrupt outputs from the controller.
  - clocks: Must contain one entry, for the module clock.
    See ../clocks/clock-bindings.txt for details.
  - resets: Must contain an entry for each entry in reset-names.
    See ../reset/reset.txt for details.
  - reset-names: Must include the following entries:
    - isp

- gr2d: 2D graphics engine

  Required properties:
  - compatible: "nvidia,tegra<chip>-gr2d"
  - reg: Physical base address and length of the controller's registers.
  - interrupts: The interrupt outputs from the controller.
  - clocks: Must contain one entry, for the module clock.
    See ../clocks/clock-bindings.txt for details.
  - resets: Must contain an entry for each entry in reset-names.
    See ../reset/reset.txt for details.
  - reset-names: Must include the following entries:
    - 2d

- gr3d: 3D graphics engine

  Required properties:
  - compatible: "nvidia,tegra<chip>-gr3d"
  - reg: Physical base address and length of the controller's registers.
  - clocks: Must contain an entry for each entry in clock-names.
    See ../clocks/clock-bindings.txt for details.
  - clock-names: Must include the following entries:
    (This property may be omitted if the only clock in the list is "3d")
    - 3d
      This MUST be the first entry.
    - 3d2 (Only required on SoCs with two 3D clocks)
  - resets: Must contain an entry for each entry in reset-names.
    See ../reset/reset.txt for details.
  - reset-names: Must include the following entries:
    - 3d
    - 3d2 (Only required on SoCs with two 3D clocks)

- dc: display controller

  Required properties:
  - compatible: "nvidia,tegra<chip>-dc"
  - reg: Physical base address and length of the controller's registers.
  - interrupts: The interrupt outputs from the controller.
  - clocks: Must contain an entry for each entry in clock-names.
    See ../clocks/clock-bindings.txt for details.
  - clock-names: Must include the following entries:
    - dc
      This MUST be the first entry.
    - parent
  - resets: Must contain an entry for each entry in reset-names.
    See ../reset/reset.txt for details.
  - reset-names: Must include the following entries:
    - dc
  - nvidia,head: The number of the display controller head. This is used to
    setup the various types of output to receive video data from the given
    head.

  Each display controller node has a child node, named "rgb", that represents
  the RGB output associated with the controller. It can take the following
  optional properties:
  - nvidia,ddc-i2c-bus: phandle of an I2C controller used for DDC EDID probing
  - nvidia,hpd-gpio: specifies a GPIO used for hotplug detection
  - nvidia,edid: supplies a binary EDID blob
  - nvidia,panel: phandle of a display panel

- hdmi: High Definition Multimedia Interface

  Required properties:
  - compatible: "nvidia,tegra<chip>-hdmi"
  - reg: Physical base address and length of the controller's registers.
  - interrupts: The interrupt outputs from the controller.
  - hdmi-supply: supply for the +5V HDMI connector pin
  - vdd-supply: regulator for supply voltage
  - pll-supply: regulator for PLL
  - clocks: Must contain an entry for each entry in clock-names.
    See ../clocks/clock-bindings.txt for details.
  - clock-names: Must include the following entries:
    - hdmi
      This MUST be the first entry.
    - parent
  - resets: Must contain an entry for each entry in reset-names.
    See ../reset/reset.txt for details.
  - reset-names: Must include the following entries:
    - hdmi

  Optional properties:
  - nvidia,ddc-i2c-bus: phandle of an I2C controller used for DDC EDID probing
  - nvidia,hpd-gpio: specifies a GPIO used for hotplug detection
  - nvidia,edid: supplies a binary EDID blob
  - nvidia,panel: phandle of a display panel

- tvo: TV encoder output

  Required properties:
  - compatible: "nvidia,tegra<chip>-tvo"
  - reg: Physical base address and length of the controller's registers.
  - interrupts: The interrupt outputs from the controller.
  - clocks: Must contain one entry, for the module clock.
    See ../clocks/clock-bindings.txt for details.

- dsi: display serial interface

  Required properties:
  - compatible: "nvidia,tegra<chip>-dsi"
  - reg: Physical base address and length of the controller's registers.
  - clocks: Must contain an entry for each entry in clock-names.
    See ../clocks/clock-bindings.txt for details.
  - clock-names: Must include the following entries:
    - dsi
      This MUST be the first entry.
    - lp
    - parent
  - resets: Must contain an entry for each entry in reset-names.
    See ../reset/reset.txt for details.
  - reset-names: Must include the following entries:
    - dsi
  - avdd-dsi-supply: phandle of a supply that powers the DSI controller
  - nvidia,mipi-calibrate: Should contain a phandle and a specifier specifying
    which pads are used by this DSI output and need to be calibrated. See also
    ../display/tegra/nvidia,tegra114-mipi.txt.

  Optional properties:
  - nvidia,ddc-i2c-bus: phandle of an I2C controller used for DDC EDID probing
  - nvidia,hpd-gpio: specifies a GPIO used for hotplug detection
  - nvidia,edid: supplies a binary EDID blob
  - nvidia,panel: phandle of a display panel
  - nvidia,ganged-mode: contains a phandle to a second DSI controller to gang
    up with in order to support up to 8 data lanes

- sor: serial output resource

  Required properties:
  - compatible: Should be:
    - "nvidia,tegra124-sor": for Tegra124 and Tegra132
    - "nvidia,tegra132-sor": for Tegra132
    - "nvidia,tegra210-sor": for Tegra210
    - "nvidia,tegra210-sor1": for Tegra210
  - reg: Physical base address and length of the controller's registers.
  - interrupts: The interrupt outputs from the controller.
  - clocks: Must contain an entry for each entry in clock-names.
    See ../clocks/clock-bindings.txt for details.
  - clock-names: Must include the following entries:
    - sor: clock input for the SOR hardware
    - parent: input for the pixel clock
    - dp: reference clock for the SOR clock
    - safe: safe reference for the SOR clock during power up
  - resets: Must contain an entry for each entry in reset-names.
    See ../reset/reset.txt for details.
  - reset-names: Must include the following entries:
    - sor

  Optional properties:
  - nvidia,ddc-i2c-bus: phandle of an I2C controller used for DDC EDID probing
  - nvidia,hpd-gpio: specifies a GPIO used for hotplug detection
  - nvidia,edid: supplies a binary EDID blob
  - nvidia,panel: phandle of a display panel

  Optional properties when driving an eDP output:
  - nvidia,dpaux: phandle to a DispayPort AUX interface

- dpaux: DisplayPort AUX interface
  - compatible: For Tegra124, must contain "nvidia,tegra124-dpaux".  Otherwise,
    must contain '"nvidia,<chip>-dpaux", "nvidia,tegra124-dpaux"', where
    <chip> is tegra132.
  - reg: Physical base address and length of the controller's registers.
  - interrupts: The interrupt outputs from the controller.
  - clocks: Must contain an entry for each entry in clock-names.
    See ../clocks/clock-bindings.txt for details.
  - clock-names: Must include the following entries:
    - dpaux: clock input for the DPAUX hardware
    - parent: reference clock
  - resets: Must contain an entry for each entry in reset-names.
    See ../reset/reset.txt for details.
  - reset-names: Must include the following entries:
    - dpaux
  - vdd-supply: phandle of a supply that powers the DisplayPort link

Example:

/ {
	...

	host1x {
		compatible = "nvidia,tegra20-host1x", "simple-bus";
		reg = <0x50000000 0x00024000>;
		interrupts = <0 65 0x04   /* mpcore syncpt */
			      0 67 0x04>; /* mpcore general */
		clocks = <&tegra_car TEGRA20_CLK_HOST1X>;
		resets = <&tegra_car 28>;
		reset-names = "host1x";

		#address-cells = <1>;
		#size-cells = <1>;

		ranges = <0x54000000 0x54000000 0x04000000>;

		mpe {
			compatible = "nvidia,tegra20-mpe";
			reg = <0x54040000 0x00040000>;
			interrupts = <0 68 0x04>;
			clocks = <&tegra_car TEGRA20_CLK_MPE>;
			resets = <&tegra_car 60>;
			reset-names = "mpe";
		};

		vi {
			compatible = "nvidia,tegra20-vi";
			reg = <0x54080000 0x00040000>;
			interrupts = <0 69 0x04>;
			clocks = <&tegra_car TEGRA20_CLK_VI>;
			resets = <&tegra_car 100>;
			reset-names = "vi";
		};

		epp {
			compatible = "nvidia,tegra20-epp";
			reg = <0x540c0000 0x00040000>;
			interrupts = <0 70 0x04>;
			clocks = <&tegra_car TEGRA20_CLK_EPP>;
			resets = <&tegra_car 19>;
			reset-names = "epp";
		};

		isp {
			compatible = "nvidia,tegra20-isp";
			reg = <0x54100000 0x00040000>;
			interrupts = <0 71 0x04>;
			clocks = <&tegra_car TEGRA20_CLK_ISP>;
			resets = <&tegra_car 23>;
			reset-names = "isp";
		};

		gr2d {
			compatible = "nvidia,tegra20-gr2d";
			reg = <0x54140000 0x00040000>;
			interrupts = <0 72 0x04>;
			clocks = <&tegra_car TEGRA20_CLK_GR2D>;
			resets = <&tegra_car 21>;
			reset-names = "2d";
		};

		gr3d {
			compatible = "nvidia,tegra20-gr3d";
			reg = <0x54180000 0x00040000>;
			clocks = <&tegra_car TEGRA20_CLK_GR3D>;
			resets = <&tegra_car 24>;
			reset-names = "3d";
		};

		dc@54200000 {
			compatible = "nvidia,tegra20-dc";
			reg = <0x54200000 0x00040000>;
			interrupts = <0 73 0x04>;
			clocks = <&tegra_car TEGRA20_CLK_DISP1>,
				 <&tegra_car TEGRA20_CLK_PLL_P>;
			clock-names = "dc", "parent";
			resets = <&tegra_car 27>;
			reset-names = "dc";

			rgb {
				status = "disabled";
			};
		};

		dc@54240000 {
			compatible = "nvidia,tegra20-dc";
			reg = <0x54240000 0x00040000>;
			interrupts = <0 74 0x04>;
			clocks = <&tegra_car TEGRA20_CLK_DISP2>,
				 <&tegra_car TEGRA20_CLK_PLL_P>;
			clock-names = "dc", "parent";
			resets = <&tegra_car 26>;
			reset-names = "dc";

			rgb {
				status = "disabled";
			};
		};

		hdmi {
			compatible = "nvidia,tegra20-hdmi";
			reg = <0x54280000 0x00040000>;
			interrupts = <0 75 0x04>;
			clocks = <&tegra_car TEGRA20_CLK_HDMI>,
				 <&tegra_car TEGRA20_CLK_PLL_D_OUT0>;
			clock-names = "hdmi", "parent";
			resets = <&tegra_car 51>;
			reset-names = "hdmi";
			status = "disabled";
		};

		tvo {
			compatible = "nvidia,tegra20-tvo";
			reg = <0x542c0000 0x00040000>;
			interrupts = <0 76 0x04>;
			clocks = <&tegra_car TEGRA20_CLK_TVO>;
			status = "disabled";
		};

		dsi {
			compatible = "nvidia,tegra20-dsi";
			reg = <0x54300000 0x00040000>;
			clocks = <&tegra_car TEGRA20_CLK_DSI>,
				 <&tegra_car TEGRA20_CLK_PLL_D_OUT0>;
			clock-names = "dsi", "parent";
			resets = <&tegra_car 48>;
			reset-names = "dsi";
			status = "disabled";
		};
	};

	...
};


/*

NVIDIA Tegra host1x

필수 속성 :
- 호환 : "nvidia, tegra <chip> -host1x"
- reg : 컨트롤러의 레지스터의 물리적 인 기본 주소와 길이.
- interrupts (인터럽트) : 컨트롤러의 인터럽트 출력입니다.
- # address-cells : host1x 주소 공간에서 물리적 기본 주소를 나타내는 데 사용되는 셀 수. 1이어야합니다.
- # size-cells : host1x 주소 공간에서 주소 범위의 크기를 나타내는 데 사용되는 셀 수. 1이어야합니다.
- ranges : host1x 주소 공간을 CPU 주소 공간에 매핑합니다.
- clocks : 모듈 클럭에 대해 하나의 항목을 포함해야합니다.
  자세한 내용은 ../clocks/clock-bindings.txt를 참조하십시오.
- reset : reset-names의 각 항목에 대한 항목을 포함해야합니다.
  자세한 내용은 ../reset/reset.txt를 참조하십시오.
- reset-names : 다음 항목을 포함해야합니다.
  - host1x

host1x 최상위 노드는 다음과 같은 host1x 클라이언트 모듈 중 하나를 나타내는 많은 자식을 정의합니다.

- mpe : 비디오 인코더

  필수 속성 :
  - 호환 : "nvidia, tegra <chip> -mpe"
  - reg : 컨트롤러의 레지스터의 물리적 인 기본 주소와 길이.
  - interrupts (인터럽트) : 컨트롤러의 인터럽트 출력입니다.
  - clocks : 모듈 클럭에 대해 하나의 항목을 포함해야합니다.
    자세한 내용은 ../clocks/clock-bindings.txt를 참조하십시오.
  - reset : reset-names의 각 항목에 대한 항목을 포함해야합니다.
    자세한 내용은 ../reset/reset.txt를 참조하십시오.
  - reset-names : 다음 항목을 포함해야합니다.
    - mpe

- vi : 비디오 입력

  필수 속성 :
  - 호환 : "nvidia, tegra <chip> -vi"
  - reg : 컨트롤러의 레지스터의 물리적 인 기본 주소와 길이.
  - interrupts (인터럽트) : 컨트롤러의 인터럽트 출력입니다.
  - clocks : 모듈 클럭에 대해 하나의 항목을 포함해야합니다.
    자세한 내용은 ../clocks/clock-bindings.txt를 참조하십시오.
  - reset : reset-names의 각 항목에 대한 항목을 포함해야합니다.
    자세한 내용은 ../reset/reset.txt를 참조하십시오.
  - reset-names : 다음 항목을 포함해야합니다.
    - vi

- epp : 인코더 전처리 기

  필수 속성 :
  - 호환 : "nvidia, tegra <chip> -epp"
  - reg : 컨트롤러의 레지스터의 물리적 인 기본 주소와 길이.
  - interrupts (인터럽트) : 컨트롤러의 인터럽트 출력입니다.
  - clocks : 모듈 클럭에 대해 하나의 항목을 포함해야합니다.
    자세한 내용은 ../clocks/clock-bindings.txt를 참조하십시오.
  - reset : reset-names의 각 항목에 대한 항목을 포함해야합니다.
    자세한 내용은 ../reset/reset.txt를 참조하십시오.
  - reset-names : 다음 항목을 포함해야합니다.
    - epp

- isp : 이미지 신호 처리기

  필수 속성 :
  - 호환 : "nvidia, tegra <chip> -isp"
  - reg : 컨트롤러의 레지스터의 물리적 인 기본 주소와 길이.
  - interrupts (인터럽트) : 컨트롤러의 인터럽트 출력입니다.
  - clocks : 모듈 클럭에 대해 하나의 항목을 포함해야합니다.
    자세한 내용은 ../clocks/clock-bindings.txt를 참조하십시오.
  - reset : reset-names의 각 항목에 대한 항목을 포함해야합니다.
    자세한 내용은 ../reset/reset.txt를 참조하십시오.
  - reset-names : 다음 항목을 포함해야합니다.
    - isp

- gr2d : 2D 그래픽 엔진

  필수 속성 :
  - 호환 : "nvidia, tegra <chip> -gr2d"
  - reg : 컨트롤러의 레지스터의 물리적 인 기본 주소와 길이.
  - interrupts (인터럽트) : 컨트롤러의 인터럽트 출력입니다.
  - clocks : 모듈 클럭에 대해 하나의 항목을 포함해야합니다.
    자세한 내용은 ../clocks/clock-bindings.txt를 참조하십시오.
  - reset : reset-names의 각 항목에 대한 항목을 포함해야합니다.
    자세한 내용은 ../reset/reset.txt를 참조하십시오.
  - reset-names : 다음 항목을 포함해야합니다.
    - 2d

- gr3d : 3D 그래픽 엔진

  필수 속성 :
  - 호환 : "nvidia, tegra <chip> -gr3d"
  - reg : 컨트롤러의 레지스터의 물리적 인 기본 주소와 길이.
  - clocks : clock-name의 각 항목에 대한 항목을 포함해야합니다.
    자세한 내용은 ../clocks/clock-bindings.txt를 참조하십시오.
  - clock-names : 다음 항목을 포함해야합니다.
    (목록의 유일한 clock가 "3d"이면이 속성을 생략 할 수 있습니다)
    - 3 차원
      이것은 반드시 첫 번째 항목이어야합니다.
    - 3d2 (두 개의 3D 클럭으로 SoC에만 필요함)
  - reset : reset-names의 각 항목에 대한 항목을 포함해야합니다.
    자세한 내용은 ../reset/reset.txt를 참조하십시오.
  - reset-names : 다음 항목을 포함해야합니다.
    - 3 차원
    - 3d2 (두 개의 3D 클럭으로 SoC에만 필요함)

- dc : 디스플레이 컨트롤러

  필수 속성 :
  - 호환 : "nvidia, tegra <chip> -dc"
  - reg : 컨트롤러의 레지스터의 물리적 인 기본 주소와 길이.
  - interrupts (인터럽트) : 컨트롤러의 인터럽트 출력입니다.
  - clocks : clock-name의 각 항목에 대한 항목을 포함해야합니다.
    자세한 내용은 ../clocks/clock-bindings.txt를 참조하십시오.
  - clock-names : 다음 항목을 포함해야합니다.
    - 직류
      이것은 반드시 첫 번째 항목이어야합니다.
    - 부모의
  - reset : reset-names의 각 항목에 대한 항목을 포함해야합니다.
    자세한 내용은 ../reset/reset.txt를 참조하십시오.
  - reset-names : 다음 항목을 포함해야합니다.
    - 직류
  - nvidia, head : 디스플레이 컨트롤러 헤드의 번호. 이것은 주어진 헤드에서 비디오 데이터를 수신하기 위해 다양한 유형의 출력을 설정하는 데 사용됩니다.

  각 디스플레이 컨트롤러 노드에는 "rgb"라는 이름의 자식 노드가 있습니다.
컨트롤러와 연관된 RGB 출력. 다음과 같은 선택적 속성을 사용할 수 있습니다.
  - nvidia, ddc-i2c-bus : DDC EDID 프로빙에 사용되는 I2C 컨트롤러의 phandle
  - nvidia, hpd-gpio : 핫 플러그 ​​감지에 사용되는 GPIO 지정
  - nvidia, edid : 이진 EDID BLOB를 제공합니다.
  - nvidia, panel : 디스플레이 패널의 phandle

- hdmi : 고화질 멀티미디어 인터페이스

  필수 속성 :
  - 호환 : "nvidia, tegra <chip> -hdmi"
  - reg : 컨트롤러의 레지스터의 물리적 인 기본 주소와 길이.
  - interrupts (인터럽트) : 컨트롤러의 인터럽트 출력입니다.
  - hdmi-supply : + 5V HDMI 커넥터 핀 공급
  - vdd-supply : 전원 전압 레귤레이터
  - PLL을위한 레귤레이터
  - clocks : clock-name의 각 항목에 대한 항목을 포함해야합니다.
    자세한 내용은 ../clocks/clock-bindings.txt를 참조하십시오.
  - clock-names : 다음 항목을 포함해야합니다.
    - hdmi
      이것은 반드시 첫 번째 항목이어야합니다.
    - 부모의
  - reset : reset-names의 각 항목에 대한 항목을 포함해야합니다.
    자세한 내용은 ../reset/reset.txt를 참조하십시오.
  - reset-names : 다음 항목을 포함해야합니다.
    - hdmi

  선택적 속성 :
  - nvidia, ddc-i2c-bus : DDC EDID 프로빙에 사용되는 I2C 컨트롤러의 phandle
  - nvidia, hpd-gpio : 핫 플러그 ​​감지에 사용되는 GPIO 지정
  - nvidia, edid : 이진 EDID BLOB를 제공합니다.
  - nvidia, panel : 디스플레이 패널의 phandle

- tvo : TV 엔코더 출력

  필수 속성 :
  - 호환 : "nvidia, tegra <chip> -tvo"
  - reg : 컨트롤러의 레지스터의 물리적 인 기본 주소와 길이.
  - interrupts (인터럽트) : 컨트롤러의 인터럽트 출력입니다.
  - clocks : 모듈 클럭에 대해 하나의 항목을 포함해야합니다.
    자세한 내용은 ../clocks/clock-bindings.txt를 참조하십시오.

- dsi : 직렬 인터페이스 표시

  필수 속성 :
  - 호환 : "nvidia, tegra <chip> -dsi"
  - reg : 컨트롤러의 레지스터의 물리적 인 기본 주소와 길이.
  - clocks : clock-name의 각 항목에 대한 항목을 포함해야합니다.
    자세한 내용은 ../clocks/clock-bindings.txt를 참조하십시오.
  - clock-names : 다음 항목을 포함해야합니다.
    - dsi
      이것은 반드시 첫 번째 항목이어야합니다.
    - lp
    - 부모의
  - reset : reset-names의 각 항목에 대한 항목을 포함해야합니다.
    자세한 내용은 ../reset/reset.txt를 참조하십시오.
  - reset-names : 다음 항목을 포함해야합니다.
    - dsi
  - avdd-dsi-supply : DSI 컨트롤러에 전원을 공급하는 전원 공급 장치
  - nvidia, mipi-calibrate : phandle과 지정자를 지정해야합니다.
    이 패드는이 DSI 출력에 사용되며 보정이 필요합니다. 또한보십시오
    ../display/tegra/nvidia,tegra114-mipi.txt.

  선택적 속성 :
  - nvidia, ddc-i2c-bus : DDC EDID 프로빙에 사용되는 I2C 컨트롤러의 phandle
  - nvidia, hpd-gpio : 핫 플러그 ​​감지에 사용되는 GPIO 지정
  - nvidia, edid : 이진 EDID BLOB를 제공합니다.
  - nvidia, panel : 디스플레이 패널의 phandle
  - nvidia, ganged-mode : 최대 8 개의 데이터 레인을 지원하기 위해 두 번째 DSI 컨트롤러에 연결된 phandle을 포함합니다

- sor : 직렬 출력 자원

  필수 속성 :
  - 호환 : 다음과 같아야합니다.
    - "nvidia, tegra124-sor": Tegra124 및 Tegra132 용
    - "nvidia, tegra132-sor": Tegra132 용
    - "nvidia, tegra210-sor": Tegra210 용
    - "nvidia, tegra210-sor1": Tegra210 용
  - reg : 컨트롤러의 레지스터의 물리적 인 기본 주소와 길이.
  - interrupts (인터럽트) : 컨트롤러의 인터럽트 출력입니다.
  - clocks : clock-name의 각 항목에 대한 항목을 포함해야합니다.
    자세한 내용은 ../clocks/clock-bindings.txt를 참조하십시오.
  - clock-names : 다음 항목을 포함해야합니다.
    - sor : SOR 하드웨어의 클럭 입력
    - parent : 픽셀 클럭을위한 입력
    - dp : SOR 클럭을위한 기준 클럭
    - safe : 전원을 켤 때 SOR 클럭에 대한 안전한 참조
  - reset : reset-names의 각 항목에 대한 항목을 포함해야합니다.
    자세한 내용은 ../reset/reset.txt를 참조하십시오.
  - reset-names : 다음 항목을 포함해야합니다.
    - sor

  선택적 속성 :
  - nvidia, ddc-i2c-bus : DDC EDID 프로빙에 사용되는 I2C 컨트롤러의 phandle
  - nvidia, hpd-gpio : 핫 플러그 ​​감지에 사용되는 GPIO 지정
  - nvidia, edid : 이진 EDID BLOB를 제공합니다.
  - nvidia, panel : 디스플레이 패널의 phandle

  eDP 출력을 구동 할 때 선택 사항 :
  - nvidia, dpaux : DispayPort AUX 인터페이스로 연결

- dpaux : DisplayPort AUX 인터페이스
  - compatible : Tegra124의 경우 "nvidia, tegra124-dpaux"를 포함해야합니다. 그렇지 않으면 nvidia, <chip> -dpaux ","nvidia, tegra124-dpaux " '가 있어야합니다. 여기서 <chip>은 tegra132입니다.
  - reg : 컨트롤러의 레지스터의 물리적 인 기본 주소와 길이.
  - interrupts (인터럽트) : 컨트롤러의 인터럽트 출력입니다.
  - clocks : clock-name의 각 항목에 대한 항목을 포함해야합니다.
    자세한 내용은 ../clocks/clock-bindings.txt를 참조하십시오.
  - clock-names : 다음 항목을 포함해야합니다.
    - dpaux : DPAUX 하드웨어의 클럭 입력
    - parent : 기준 클럭
  - reset : reset-names의 각 항목에 대한 항목을 포함해야합니다.
    자세한 내용은 ../reset/reset.txt를 참조하십시오.
  - reset-names : 다음 항목을 포함해야합니다.
    - dpaux

- vdd-supply : DisplayPort 링크에 전원을 공급하는 전원 공급 장치

Example:

/ {
	...

	host1x {
		compatible = "nvidia,tegra20-host1x", "simple-bus";
		reg = <0x50000000 0x00024000>;
		interrupts = <0 65 0x04   /* mpcore syncpt */
			      0 67 0x04>; /* mpcore general */
		clocks = <&tegra_car TEGRA20_CLK_HOST1X>;
		resets = <&tegra_car 28>;
		reset-names = "host1x";

		#address-cells = <1>;
		#size-cells = <1>;

		ranges = <0x54000000 0x54000000 0x04000000>;

		mpe {
			compatible = "nvidia,tegra20-mpe";
			reg = <0x54040000 0x00040000>;
			interrupts = <0 68 0x04>;
			clocks = <&tegra_car TEGRA20_CLK_MPE>;
			resets = <&tegra_car 60>;
			reset-names = "mpe";
		};

		vi {
			compatible = "nvidia,tegra20-vi";
			reg = <0x54080000 0x00040000>;
			interrupts = <0 69 0x04>;
			clocks = <&tegra_car TEGRA20_CLK_VI>;
			resets = <&tegra_car 100>;
			reset-names = "vi";
		};

		epp {
			compatible = "nvidia,tegra20-epp";
			reg = <0x540c0000 0x00040000>;
			interrupts = <0 70 0x04>;
			clocks = <&tegra_car TEGRA20_CLK_EPP>;
			resets = <&tegra_car 19>;
			reset-names = "epp";
		};

		isp {
			compatible = "nvidia,tegra20-isp";
			reg = <0x54100000 0x00040000>;
			interrupts = <0 71 0x04>;
			clocks = <&tegra_car TEGRA20_CLK_ISP>;
			resets = <&tegra_car 23>;
			reset-names = "isp";
		};

		gr2d {
			compatible = "nvidia,tegra20-gr2d";
			reg = <0x54140000 0x00040000>;
			interrupts = <0 72 0x04>;
			clocks = <&tegra_car TEGRA20_CLK_GR2D>;
			resets = <&tegra_car 21>;
			reset-names = "2d";
		};

		gr3d {
			compatible = "nvidia,tegra20-gr3d";
			reg = <0x54180000 0x00040000>;
			clocks = <&tegra_car TEGRA20_CLK_GR3D>;
			resets = <&tegra_car 24>;
			reset-names = "3d";
		};

		dc@54200000 {
			compatible = "nvidia,tegra20-dc";
			reg = <0x54200000 0x00040000>;
			interrupts = <0 73 0x04>;
			clocks = <&tegra_car TEGRA20_CLK_DISP1>,
				 <&tegra_car TEGRA20_CLK_PLL_P>;
			clock-names = "dc", "parent";
			resets = <&tegra_car 27>;
			reset-names = "dc";

			rgb {
				status = "disabled";
			};
		};

		dc@54240000 {
			compatible = "nvidia,tegra20-dc";
			reg = <0x54240000 0x00040000>;
			interrupts = <0 74 0x04>;
			clocks = <&tegra_car TEGRA20_CLK_DISP2>,
				 <&tegra_car TEGRA20_CLK_PLL_P>;
			clock-names = "dc", "parent";
			resets = <&tegra_car 26>;
			reset-names = "dc";

			rgb {
				status = "disabled";
			};
		};

		hdmi {
			compatible = "nvidia,tegra20-hdmi";
			reg = <0x54280000 0x00040000>;
			interrupts = <0 75 0x04>;
			clocks = <&tegra_car TEGRA20_CLK_HDMI>,
				 <&tegra_car TEGRA20_CLK_PLL_D_OUT0>;
			clock-names = "hdmi", "parent";
			resets = <&tegra_car 51>;
			reset-names = "hdmi";
			status = "disabled";
		};

		tvo {
			compatible = "nvidia,tegra20-tvo";
			reg = <0x542c0000 0x00040000>;
			interrupts = <0 76 0x04>;
			clocks = <&tegra_car TEGRA20_CLK_TVO>;
			status = "disabled";
		};

		dsi {
			compatible = "nvidia,tegra20-dsi";
			reg = <0x54300000 0x00040000>;
			clocks = <&tegra_car TEGRA20_CLK_DSI>,
				 <&tegra_car TEGRA20_CLK_PLL_D_OUT0>;
			clock-names = "dsi", "parent";
			resets = <&tegra_car 48>;
			reset-names = "dsi";
			status = "disabled";
		};
	};

	...
};

*/
```
