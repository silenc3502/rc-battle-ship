## Doc/DeviceDriver/devicetree/bindings/dma/dma.txt
```
* Generic DMA Controller and DMA request bindings

Generic binding to provide a way for a driver using DMA Engine to retrieve the
DMA request or channel information that goes from a hardware device to a DMA
controller.


* DMA controller

Required property:
- #dma-cells: 		Must be at least 1. Used to provide DMA controller
			specific information. See DMA client binding below for
			more details.

Optional properties:
- dma-channels: 	Number of DMA channels supported by the controller.
- dma-requests: 	Number of DMA request signals supported by the
			controller.

Example:

	dma: dma@48000000 {
		compatible = "ti,omap-sdma";
		reg = <0x48000000 0x1000>;
		interrupts = <0 12 0x4
			      0 13 0x4
			      0 14 0x4
			      0 15 0x4>;
		#dma-cells = <1>;
		dma-channels = <32>;
		dma-requests = <127>;
	};

* DMA router

DMA routers are transparent IP blocks used to route DMA request lines from
devices to the DMA controller. Some SoCs (like TI DRA7x) have more peripherals
integrated with DMA requests than what the DMA controller can handle directly.

Required property:
- dma-masters:		phandle of the DMA controller or list of phandles for
			the DMA controllers the router can direct the signal to.
- #dma-cells: 		Must be at least 1. Used to provide DMA router specific
			information. See DMA client binding below for more
			details.

Optional properties:
- dma-requests: 	Number of incoming request lines the router can handle.
- In the node pointed by the dma-masters:
	- dma-requests:	The router driver might need to look for this in order
			to configure the routing.

Example:
	sdma_xbar: dma-router@4a002b78 {
		compatible = "ti,dra7-dma-crossbar";
		reg = <0x4a002b78 0xfc>;
		#dma-cells = <1>;
		dma-requests = <205>;
		ti,dma-safe-map = <0>;
		dma-masters = <&sdma>;
	};

* DMA client

Client drivers should specify the DMA property using a phandle to the controller
followed by DMA controller specific data.

Required property:
- dmas:			List of one or more DMA specifiers, each consisting of
			- A phandle pointing to DMA controller node
			- A number of integer cells, as determined by the
			  #dma-cells property in the node referenced by phandle
			  containing DMA controller specific information. This
			  typically contains a DMA request line number or a
			  channel number, but can contain any data that is
			  required for configuring a channel.
- dma-names: 		Contains one identifier string for each DMA specifier in
			the dmas property. The specific strings that can be used
			are defined in the binding of the DMA client device.
			Multiple DMA specifiers can be used to represent
			alternatives and in this case the dma-names for those
			DMA specifiers must be identical (see examples).

Examples:

1. A device with one DMA read channel, one DMA write channel:

	i2c1: i2c@1 {
		...
		dmas = <&dma 2		/* read channel */
			&dma 3>;	/* write channel */
		dma-names = "rx", "tx";
		...
	};

2. A single read-write channel with three alternative DMA controllers:

	dmas = <&dma1 5
		&dma2 7
		&dma3 2>;
	dma-names = "rx-tx", "rx-tx", "rx-tx";

3. A device with three channels, one of which has two alternatives:

	dmas = <&dma1 2			/* read channel */
		&dma1 3			/* write channel */
		&dma2 0			/* error read */
		&dma3 0>;		/* alternative error read */
	dma-names = "rx", "tx", "error", "error";



/*
* 일반적인 DMA 컨트롤러 및 DMA 요청 바인딩

DMA 엔진을 사용하는 드라이버가 하드웨어 장치에서 DMA 컨트롤러로 이동하는 DMA 요청 또는 채널 정보를 검색하는 방법을 제공하는 일반 바인딩.


* DMA 컨트롤러

필수 속성 :
- # dma-cells : 적어도 1이어야합니다. DMA 컨트롤러 관련 정보를 제공하는 데 사용됩니다.
자세한 내용은 아래의 DMA 클라이언트 바인딩을 참조하십시오.

선택적 속성 :
- dma-channels : 컨트롤러가 지원하는 DMA 채널 수입니다.
- dma-requests : 컨트롤러가 지원하는 DMA 요청 신호 수.


Example:

	dma: dma@48000000 {
		compatible = "ti,omap-sdma";
		reg = <0x48000000 0x1000>;
		interrupts = <0 12 0x4
			      0 13 0x4
			      0 14 0x4
			      0 15 0x4>;
		#dma-cells = <1>;
		dma-channels = <32>;
		dma-requests = <127>;
	};


* DMA 라우터

DMA 라우터는 장치에서 DMA 컨트롤러로 DMA 요청 라인을 라우팅하는 데 사용되는 투명한 IP 블록입니다. TI DRA7x와 같은 일부 SoC는 DMA 컨트롤러가 직접 처리 할 수있는 것보다 많은 수의 주변 장치를 DMA 요청과 통합합니다.

필수 속성 :
- dma-masters : DMA 컨트롤러의 phandle 또는 라우터가 신호를 보낼 수있는 DMA 컨트롤러의 phandles 목록.
- # dma-cells : 적어도 1이어야합니다. DMA 라우터 관련 정보를 제공하는 데 사용됩니다.
자세한 내용은 아래의 DMA 클라이언트 바인딩을 참조하십시오.

선택적 속성 :
- dma-requests : 라우터가 처리 할 수있는 들어오는 요청 줄 수입니다.
- dma-masters가 지적한 노드에서 :
- dma-requests : 라우터 드라이버가 라우팅을 구성하기 위해이를 찾아야 할 수도 있습니다.

Example:
	sdma_xbar: dma-router@4a002b78 {
		compatible = "ti,dra7-dma-crossbar";
		reg = <0x4a002b78 0xfc>;
		#dma-cells = <1>;
		dma-requests = <205>;
		ti,dma-safe-map = <0>;
		dma-masters = <&sdma>;
	};


* DMA 클라이언트

클라이언트 드라이버는 컨트롤러에 대한 phandle과 DMA 컨트롤러 특정 데이터를 사용하여 DMA 속성을 지정해야합니다.

필수 속성 :
- dmas : 각각 하나 이상의 DMA 지정자 목록
- DMA 컨트롤러 노드를 가리키는 phandle
- phandle이 참조하는 노드의 # dma-cells 속성에 의해 결정되는 여러 정수 셀 (DMA 컨트롤러 관련 정보 포함). 이것은 일반적으로 DMA 요청 행 번호 또는 채널 번호를 포함하지만 채널 구성에 필요한 모든 데이터를 포함 할 수 있습니다.
- dma-names : dmas 속성의 각 DMA 지정자에 대한 하나의 식별자 문자열을 포함합니다. 사용할 수있는 특정 문자열은 DMA 클라이언트 장치의 바인딩에 정의됩니다.
여러 DMA 지정자를 사용하여 대안을 나타낼 수 있으며이 경우 해당 DMA 지정자의 dma-name은 동일해야합니다 (예 참조).

Examples:

1. 하나의 DMA 읽기 채널, 하나의 DMA 쓰기 채널이있는 장치 :

	i2c1: i2c@1 {
		...
		dmas = <&dma 2		/* read channel */
			&dma 3>;	/* write channel */
		dma-names = "rx", "tx";
		...
	};

2. 3 개의 대체 DMA 컨트롤러가있는 단일 읽기 - 쓰기 채널 :

	dmas = <&dma1 5
		&dma2 7
		&dma3 2>;
	dma-names = "rx-tx", "rx-tx", "rx-tx";

3. 세 개의 채널을 가진 장치 중 하나에는 두 가지 대안이 있습니다.

	dmas = <&dma1 2			/* read channel */
		&dma1 3			/* write channel */
		&dma2 0			/* error read */
		&dma3 0>;		/* alternative error read */
	dma-names = "rx", "tx", "error", "error";


*/
```

## Doc/DeviceDriver/devicetree/bindings/dma/fsl-edma.txt
```
* Freescale enhanced Direct Memory Access(eDMA) Controller

  The eDMA channels have multiplex capability by programmble memory-mapped
registers. channels are split into two groups, called DMAMUX0 and DMAMUX1,
specific DMA request source can only be multiplexed by any channel of certain
group, DMAMUX0 or DMAMUX1, but not both.

* eDMA Controller
Required properties:
- compatible :
	- "fsl,vf610-edma" for eDMA used similar to that on Vybrid vf610 SoC
- reg : Specifies base physical address(s) and size of the eDMA registers.
	The 1st region is eDMA control register's address and size.
	The 2nd and the 3rd regions are programmable channel multiplexing
	control register's address and size.
- interrupts : A list of interrupt-specifiers, one for each entry in
	interrupt-names.
- interrupt-names : Should contain:
	"edma-tx" - the transmission interrupt
	"edma-err" - the error interrupt
- #dma-cells : Must be <2>.
	The 1st cell specifies the DMAMUX(0 for DMAMUX0 and 1 for DMAMUX1).
	Specific request source can only be multiplexed by specific channels
	group called DMAMUX.
	The 2nd cell specifies the request source(slot) ID.
	See the SoC's reference manual for all the supported request sources.
- dma-channels : Number of channels supported by the controller
- clock-names : A list of channel group clock names. Should contain:
	"dmamux0" - clock name of mux0 group
	"dmamux1" - clock name of mux1 group
- clocks : A list of phandle and clock-specifier pairs, one for each entry in
	clock-names.

Optional properties:
- big-endian: If present registers and hardware scatter/gather descriptors
	of the eDMA are implemented in big endian mode, otherwise in little
	mode.


Examples:

edma0: dma-controller@40018000 {
	#dma-cells = <2>;
	compatible = "fsl,vf610-edma";
	reg = <0x40018000 0x2000>,
		<0x40024000 0x1000>,
		<0x40025000 0x1000>;
	interrupts = <0 8 IRQ_TYPE_LEVEL_HIGH>,
		<0 9 IRQ_TYPE_LEVEL_HIGH>;
	interrupt-names = "edma-tx", "edma-err";
	dma-channels = <32>;
	clock-names = "dmamux0", "dmamux1";
	clocks = <&clks VF610_CLK_DMAMUX0>,
		<&clks VF610_CLK_DMAMUX1>;
};


* DMA clients
DMA client drivers that uses the DMA function must use the format described
in the dma.txt file, using a two-cell specifier for each channel: the 1st
specifies the channel group(DMAMUX) in which this request can be multiplexed,
and the 2nd specifies the request source.

Examples:

sai2: sai@40031000 {
	compatible = "fsl,vf610-sai";
	reg = <0x40031000 0x1000>;
	interrupts = <0 86 IRQ_TYPE_LEVEL_HIGH>;
	clock-names = "sai";
	clocks = <&clks VF610_CLK_SAI2>;
	dma-names = "tx", "rx";
	dmas = <&edma0 0 21>,
		<&edma0 0 20>;
	status = "disabled";
};






================================================================================================


/*
프리 스케일, 직접 메모리 액세스 (eDMA) 컨트롤러 강화

  eDMA 채널은 프로그래머 블 메모리 매핑 레지스터에 의한 다중화 기능을 가지고있다. 채널은 DMAMUX0 및 DMAMUX1이라고하는 두 개의 그룹으로 나뉘어지며, 특정 DMA 요청 소스는 특정 그룹 인 DMAMUX0 또는 DMAMUX1의 어느 채널에 의해서만 다중화 될 수 있지만 둘 다 다중화 될 수는 없습니다.

* eDMA 컨트롤러
필수 속성 :
- 호환 가능 :
- eDMA 용 "fsl, vf610-edma"는 Vybrid vf610 SoC와 유사합니다.
- reg : 기본 물리적 주소와 eDMA 레지스터의 크기를 지정합니다.
제 1 영역은 eDMA 제어 레지스터의 어드레스 및 크기이다.
제 2 및 제 3 영역은 프로그램 가능한 채널 멀티플렉싱 제어 레지스터의 어드레스 및 크기이다.
- interrupts : 인터럽트 명에있는 각 엔트리를위한 인터럽트 지정자의 목록.
- interrupt-names : 다음을 포함해야합니다 :
"edma-tx"- 전송 인터럽트
"edma-err"- 오류 인터럽트
- # dma-cells : <2> 여야합니다.
첫 번째 셀은 DMAMUX를 지정합니다 (DMAMUX0에는 0, DMAMUX1에는 1).
특정 요청 소스는 DMAMUX라고하는 특정 채널 그룹으로 만 다중화 될 수 있습니다.
두 번째 셀은 요청 소스 (슬롯) ID를 지정합니다.
지원되는 모든 요청 소스에 대해서는 SoC의 참조 설명서를 참조하십시오.
- dma-channels : 컨트롤러가 지원하는 채널 수
- clock-names : 채널 그룹 clock 이름 목록입니다. 다음을 포함해야합니다 :
"dmamux0"- mux0 그룹의 clock 이름
"dmamux1"- mux1 그룹의 clock 이름
- clocks : clock-names의 각 항목에 하나씩있는 phandle 및 clock-specifier 쌍의 목록입니다.

선택적 속성 :
- 빅 엔디안 : 현재 레지스터 및 eDMA의 하드웨어 분산 / 수집 디스크립터는 빅 엔디안 모드로 구현되며, 그렇지 않은 경우 작은 모드로 구현됩니다.

Examples:

edma0: dma-controller@40018000 {
	#dma-cells = <2>;
	compatible = "fsl,vf610-edma";
	reg = <0x40018000 0x2000>,
		<0x40024000 0x1000>,
		<0x40025000 0x1000>;
	interrupts = <0 8 IRQ_TYPE_LEVEL_HIGH>,
		<0 9 IRQ_TYPE_LEVEL_HIGH>;
	interrupt-names = "edma-tx", "edma-err";
	dma-channels = <32>;
	clock-names = "dmamux0", "dmamux1";
	clocks = <&clks VF610_CLK_DMAMUX0>,
		<&clks VF610_CLK_DMAMUX1>;
};

* DMA 클라이언트
DMA 기능을 사용하는 DMA 클라이언트 드라이버는 각 채널에 대해 2 셀 지정자를 사용하여 dma.txt 파일에 설명 된 형식을 사용해야합니다. 첫 번째는이 요청을 다중화 할 수있는 채널 그룹 (DMAMUX)을 지정하고 두 번째 요청 소스를 지정합니다.

Examples:

sai2: sai@40031000 {
	compatible = "fsl,vf610-sai";
	reg = <0x40031000 0x1000>;
	interrupts = <0 86 IRQ_TYPE_LEVEL_HIGH>;
	clock-names = "sai";
	clocks = <&clks VF610_CLK_SAI2>;
	dma-names = "tx", "rx";
	dmas = <&edma0 0 21>,
		<&edma0 0 20>;
	status = "disabled";
};

*/
```

## Doc/DeviceDriver/devicetree/bindings/dma/fsl-imx-dma.txt
```
* Freescale Direct Memory Access (DMA) Controller for i.MX

This document will only describe differences to the generic DMA Controller and
DMA request bindings as described in dma/dma.txt .

* DMA controller

Required properties:
- compatible : Should be "fsl,<chip>-dma". chip can be imx1, imx21 or imx27
- reg : Should contain DMA registers location and length
- interrupts : First item should be DMA interrupt, second one is optional and
    should contain DMA Error interrupt
- #dma-cells : Has to be 1. imx-dma does not support anything else.

Optional properties:
- #dma-channels : Number of DMA channels supported. Should be 16.
- #dma-requests : Number of DMA requests supported.

Example:

	dma: dma@10001000 {
		compatible = "fsl,imx27-dma";
		reg = <0x10001000 0x1000>;
		interrupts = <32 33>;
		#dma-cells = <1>;
		#dma-channels = <16>;
	};


* DMA client

Clients have to specify the DMA requests with phandles in a list.

Required properties:
- dmas: List of one or more DMA request specifiers. One DMA request specifier
    consists of a phandle to the DMA controller followed by the integer
    specifying the request line.
- dma-names: List of string identifiers for the DMA requests. For the correct
    names, have a look at the specific client driver.

Example:

	sdhci1: sdhci@10013000 {
		...
		dmas = <&dma 7>;
		dma-names = "rx-tx";
		...
	};

/*
=====================================================================================

* i.MX 용 프리 스케일 직접 메모리 액세스 (DMA) 컨트롤러

이 문서에서는 dma / dma.txt에 설명 된대로 일반 DMA 컨트롤러와 DMA 요청 바인딩의 차이점 만 설명합니다.

* DMA 컨트롤러

필수 속성 :
- compatible : "fsl, <chip> -dma"여야합니다. 칩은 imx1, imx21 또는 imx27 일 수 있습니다.
- reg : DMA 레지스터 위치와 길이를 포함해야합니다.
- 인터럽트 : 첫 번째 항목은 DMA 인터럽트 여야하며 두 번째 항목은 선택 사항이며 DMA 오류 인터럽트를 포함해야합니다
- # dma-cells : 1이어야합니다. imx-dma는 다른 것을 지원하지 않습니다.

선택적 속성 :
- # dma-channels : 지원되는 DMA 채널의 수. 16이어야합니다.
- # dma-requests : 지원되는 DMA 요청 수.

예:

Example:

	dma: dma@10001000 {
		compatible = "fsl,imx27-dma";
		reg = <0x10001000 0x1000>;
		interrupts = <32 33>;
		#dma-cells = <1>;
		#dma-channels = <16>;
	};

* DMA 클라이언트

클라이언트는 목록에있는 phandles로 DMA 요청을 지정해야합니다.

필수 속성 :
- dmas : 하나 이상의 DMA 요청 지정자 목록입니다. 하나의 DMA 요청 지정자는 요청 라인을 지정하는 정수 다음에 DMA 컨트롤러에 대한 phandle로 구성됩니다.
- dma-names : DMA 요청에 대한 문자열 식별자 목록입니다. 올바른 이름을 보려면 특정 클라이언트 드라이버를 살펴보십시오.

Example:

	sdhci1: sdhci@10013000 {
		...
		dmas = <&dma 7>;
		dma-names = "rx-tx";
		...
	};


===========================================================================================
*/
```
