## Doc/DeviceDriver/devicetree/bindings/display/tilcdc/tilcdc.txt
```
Device-Tree bindings for tilcdc DRM driver

Required properties:
 - compatible: value should be "ti,am33xx-tilcdc".
 - interrupts: the interrupt number
 - reg: base address and size of the LCDC device

Recommended properties:
 - interrupt-parent: the phandle for the interrupt controller that
   services interrupts for this device.
 - ti,hwmods: Name of the hwmod associated to the LCDC

Optional properties:
 - max-bandwidth: The maximum pixels per second that the memory
   interface / lcd controller combination can sustain
 - max-width: The maximum horizontal pixel width supported by
   the lcd controller.
 - max-pixelclock: The maximum pixel clock that can be supported
   by the lcd controller in KHz.
 - blue-and-red-wiring: Recognized values "default", "straight" or
   "crossed". This property deals with the LCDC revision 2 (found on
   AM335x) color errata [1].
    - "straight" indicates normal wiring that supports RGB565,
      BGR888, and XBGR8888 color formats.
    - "crossed" indicates wiring that has blue and red wires
      crossed. This setup supports BGR565, RGB888 and XRGB8888
      formats.
    - If the property is not present or its value is not recognized
      the legacy mode is assumed. This configuration supports RGB565,
      RGB888 and XRGB8888 formats. However, depending on wiring, the red
      and blue colors are swapped in either 16 or 24-bit color modes.

Optional nodes:

 - port/ports: to describe a connection to an external encoder. The
   binding follows Documentation/devicetree/bindings/graph.txt and
   suppors a single port with a single endpoint.

 - See also Documentation/devicetree/bindings/display/tilcdc/panel.txt and
   Documentation/devicetree/bindings/display/tilcdc/tfp410.txt for connecting
   tfp410 DVI encoder or lcd panel to lcdc

[1] There is an errata about AM335x color wiring. For 16-bit color mode
    the wires work as they should (LCD_DATA[0:4] is for Blue[3:7]),
    but for 24 bit color modes the wiring of blue and red components is
    crossed and LCD_DATA[0:4] is for Red[3:7] and LCD_DATA[11:15] is
    for Blue[3-7]. For more details see section 3.1.1 in AM335x
    Silicon Errata:
    http://www.ti.com/general/docs/lit/getliterature.tsp?baseLiteratureNumber=sprz360

Example:

	fb: fb@4830e000 {
		compatible = "ti,am33xx-tilcdc";
		reg = <0x4830e000 0x1000>;
		interrupt-parent = <&intc>;
		interrupts = <36>;
		ti,hwmods = "lcdc";

		blue-and-red-wiring = "crossed";

		port {
			lcdc_0: endpoint@0 {
				remote-endpoint = <&hdmi_0>;
			};
		};
	};

	tda19988: tda19988 {
		compatible = "nxp,tda998x";
		reg = <0x70>;

		pinctrl-names = "default", "off";
		pinctrl-0 = <&nxp_hdmi_bonelt_pins>;
		pinctrl-1 = <&nxp_hdmi_bonelt_off_pins>;

		port {
			hdmi_0: endpoint@0 {
				remote-endpoint = <&lcdc_0>;
			};
		};
	};

/*
tilcdc DRM 드라이버에 대한 장치 트리 바인딩

필수 속성 :
 - compatible : 값은 "ti, am33xx-tilcdc"여야합니다.
 - interrupts : 인터럽트 번호
 - reg : LCDC 장치의 기본 주소 및 크기

권장 속성 :
 - interrupt-parent : 인터럽트 컨트롤러의 phandle
   서비스 인터럽트를 발생시킵니다.
 - ti, hwmods : LCDC와 관련된 hwmod의 이름입니다.

선택적 속성 :
 - 최대 대역폭 : 메모리 인터페이스 / lcd 컨트롤러 조합이 유지할 수있는 초당 최대 픽셀 수
 - 최대 너비 : 지원되는 최대 가로 픽셀 너비
   액정 컨트롤러.
 - max-pixelclock : lcd 컨트롤러가 KHz로 지원할 수있는 최대 픽셀 클록입니다.
 - 청색 및 적색 배선 : 인식 된 값은 "기본값", "직선"또는 "교차"입니다.
 이 속성은 LCD에있는 개정판 2 (AM335x에서 발견)의 색상 에라타 [1]를 다룹니다.
    - "직선"은 RGB565,
      BGR888 및 XBGR8888 색상 형식을 지원합니다.
    - "교차"는 파란색과 빨간색 선이 교차하는 배선을 나타냅니다. 이 설정은 BGR565, RGB888 및 XRGB8888을 지원합니다.
      형식.
    - 속성이 없거나 값이 인식되지 않는 경우
      레거시 모드로 간주됩니다. 이 구성은 RGB565, RGB888 및 XRGB8888 형식을 지원합니다. 그러나 배선에 따라 빨강 및 파랑 색이 16 비트 또는 24 비트 색 모드로 바뀝니다.

선택적 노드 :

 - 포트 / 포트 : 외부 인코더에 대한 연결을 나타냅니다. 바인딩은 Documentation / devicetree / bindings / graph.txt와
   단일 endpoint을 가진 단일 포트를 지원합니다.

 - Documentation / devicetree / bindings / display / tilcdc / panel.txt를 참조하십시오.
   tfp410 DVI 인코더 또는 lcd 패널을 lcdc에 연결하기위한 Documentation / devicetree / bindings / display / tilcdc / tfp410.txt

[1] AM335x 컬러 배선에 관한 정오표가 있습니다.
16 비트 컬러 모드에서는 전선이 정상적으로 작동하지만 (LCD_DATA [0 : 4]는 파란색 [3 : 7]), 24 비트 색상 모드에서는 파란색과 빨간색 구성 요소의 배선이 교차하고 LCD_DATA [0 : 4] ]는 빨간색 [3 : 7]이고 LCD_DATA [11:15]는
 블루 [3-7]. 자세한 내용은 AM335x의 3.1.1 절을 참조하십시오.
    실리콘 정오표 :
    http://www.ti.com/general/docs/lit/getliterature.tsp?baseLiteratureNumber=sprz360
```

## Doc/DeviceDriver/devicetree/bindings/dma/adi,axi-dmac.txt
```
Analog Device AXI-DMAC DMA controller

Required properties:
 - compatible: Must be "adi,axi-dmac-1.00.a".
 - reg: Specification for the controllers memory mapped register map.
 - interrupts: Specification for the controllers interrupt.
 - clocks: Phandle and specifier to the controllers AXI interface clock
 - #dma-cells: Must be 1.

Required sub-nodes:
 - adi,channels: This sub-node must contain a sub-node for each DMA channel. For
   the channel sub-nodes the following bindings apply. They must match the
   configuration options of the peripheral as it was instantiated.

Required properties for adi,channels sub-node:
 - #size-cells: Must be 0
 - #address-cells: Must be 1

Required channel sub-node properties:
 - reg: Which channel this node refers to.
 - adi,length-width: Width of the DMA transfer length register.
 - adi,source-bus-width,
   adi,destination-bus-width: Width of the source or destination bus in bits.
 - adi,source-bus-type,
   adi,destination-bus-type: Type of the source or destination bus. Must be one
   of the following:
	0 (AXI_DMAC_TYPE_AXI_MM): Memory mapped AXI interface
	1 (AXI_DMAC_TYPE_AXI_STREAM): Streaming AXI interface
	2 (AXI_DMAC_TYPE_AXI_FIFO): FIFO interface

Optional channel properties:
 - adi,cyclic: Must be set if the channel supports hardware cyclic DMA
   transfers.
 - adi,2d: Must be set if the channel supports hardware 2D DMA transfers.

DMA clients connected to the AXI-DMAC DMA controller must use the format
described in the dma.txt file using a one-cell specifier. The value of the
specifier refers to the DMA channel index.

Example:

dma: dma@7c420000 {
	compatible = "adi,axi-dmac-1.00.a";
	reg = <0x7c420000 0x10000>;
	interrupts = <0 57 0>;
	clocks = <&clkc 16>;
	#dma-cells = <1>;

	adi,channels {
		#size-cells = <0>;
		#address-cells = <1>;

		dma-channel@0 {
			reg = <0>;
			adi,source-bus-width = <32>;
			adi,source-bus-type = <ADI_AXI_DMAC_TYPE_MM_AXI>;
			adi,destination-bus-width = <64>;
			adi,destination-bus-type = <ADI_AXI_DMAC_TYPE_FIFO>;
		};
	};
};

/*
아날로그 Device AXI-DMAC DMA 컨트롤러

필수 속성 :
 - 호환 : "adi, axi-dmac-1.00.a"여야합니다.
 - reg : 컨트롤러 메모리 매핑 된 레지스터 맵에 대한 사양입니다.
 - interrupts : 컨트롤러 인터럽트에 대한 사양입니다.
 - clocks : AXI 인터페이스 클럭에 대한 Phandle 및 지정자
 - # dma-cells : 1이어야합니다.

필수 하위 노드 :
 - adi, 채널 :이 하위 노드에는 각 DMA 채널에 대한 하위 노드가 있어야합니다. 채널 하위 노드의 경우 다음 바인딩이 적용됩니다. 주변 Device의 구성 옵션이 인스턴스화 될 때 일치시켜야합니다.

adi, 채널 하위 노드에 필요한 속성 :
 - # 크기 - 셀 : 0이어야합니다.
 - # 주소 - 셀 : 1이어야합니다.

필수 채널 서브 노드 특성 :
 - reg :이 노드가 참조하는 채널.
 - adi, length-width : DMA 전송 길이 레지스터의 너비.
 - adi, 소스 버스 폭,
   adi, destination-bus-width : 소스 또는 대상 버스의 너비 (비트).
 - adi, 소스 버스 유형,
   adi, destination-bus-type : 소스 또는 대상 버스 유형입니다. 다음 중 하나 여야합니다.
0 (AXI_DMAC_TYPE_AXI_MM) : 메모리 맵핑 된 AXI 인터페이스
1 (AXI_DMAC_TYPE_AXI_STREAM) : 스트리밍 AXI 인터페이스
2 (AXI_DMAC_TYPE_AXI_FIFO) : FIFO 인터페이스

선택적 채널 속성 :
 - adi, cyclic : 채널이 하드웨어 순환 DMA 전송을 지원해야하는 경우 설정해야합니다.
 - adi, 2d : 채널이 하드웨어 2D DMA 전송을 지원하는 경우 설정해야합니다.

AXI-DMAC DMA 컨트롤러에 연결된 DMA 클라이언트는 1 셀 지정자를 사용하여 dma.txt 파일에 설명 된 형식을 사용해야합니다. 지정자의 값은 DMA 채널 색인을 참조합니다.

Example:

dma: dma@7c420000 {
	compatible = "adi,axi-dmac-1.00.a";
	reg = <0x7c420000 0x10000>;
	interrupts = <0 57 0>;
	clocks = <&clkc 16>;
	#dma-cells = <1>;

	adi,channels {
		#size-cells = <0>;
		#address-cells = <1>;

		dma-channel@0 {
			reg = <0>;
			adi,source-bus-width = <32>;
			adi,source-bus-type = <ADI_AXI_DMAC_TYPE_MM_AXI>;
			adi,destination-bus-width = <64>;
			adi,destination-bus-type = <ADI_AXI_DMAC_TYPE_FIFO>;
		};
	};
};

*/
```

## Doc/DeviceDriver/devicetree/bindings/dma/apm-xgene-dma.txt
```
Applied Micro X-Gene SoC DMA nodes

DMA nodes are defined to describe on-chip DMA interfaces in
APM X-Gene SoC.

Required properties for DMA interfaces:
- compatible: Should be "apm,xgene-dma".
- device_type: set to "dma".
- reg: Address and length of the register set for the device.
  It contains the information of registers in the following order:
  1st - DMA control and status register address space.
  2nd - Descriptor ring control and status register address space.
  3rd - Descriptor ring command register address space.
  4th - Soc efuse register address space.
- interrupts: DMA has 5 interrupts sources. 1st interrupt is
  DMA error reporting interrupt. 2nd, 3rd, 4th and 5th interrupts
  are completion interrupts for each DMA channels.
- clocks: Reference to the clock entry.

Optional properties:
- dma-coherent : Present if dma operations are coherent

Example:
	dmaclk: dmaclk@1f27c000 {
		compatible = "apm,xgene-device-clock";
		#clock-cells = <1>;
		clocks = <&socplldiv2 0>;
		reg = <0x0 0x1f27c000 0x0 0x1000>;
		reg-names = "csr-reg";
		clock-output-names = "dmaclk";
	};

	dma: dma@1f270000 {
			compatible = "apm,xgene-storm-dma";
			device_type = "dma";
			reg = <0x0 0x1f270000 0x0 0x10000>,
			      <0x0 0x1f200000 0x0 0x10000>,
			      <0x0 0x1b000000 0x0 0x400000>,
			      <0x0 0x1054a000 0x0 0x100>;
			interrupts = <0x0 0x82 0x4>,
				     <0x0 0xb8 0x4>,
				     <0x0 0xb9 0x4>,
				     <0x0 0xba 0x4>,
				     <0x0 0xbb 0x4>;
			dma-coherent;
			clocks = <&dmaclk 0>;
	};

/*

Applied Micro X-Gene SoC DMA 노드

DMA 노드는 APM X-Gene SoC의 온칩 DMA 인터페이스를 설명하기 위해 정의됩니다.

DMA 인터페이스의 필수 속성 :
- 호환 : "apm, xgene-dma"여야합니다.
- device_type : "dma"로 설정하십시오.
- reg : 장치에 설정된 레지스터의 주소와 길이.
  다음 순서로 레지스터 정보를 포함합니다.
  1st - DMA 제어 및 상태 레지스터 주소 공간.
  제 2 - 기술자 링 제어 및 상태 레지스터 주소 공간.
  3 - 디스크립터 링 명령 레지스터 주소 공간.
  4th - Soc efuse 레지스터 주소 공간.
- 인터럽트 : DMA에는 5 개의 인터럽트 소스가 있습니다. 첫 번째 인터럽트
  DMA 오류보고 인터럽트. 2, 3, 4 및 5 번째 인터럽트는 각 DMA 채널에 대한 완료 인터럽트입니다.
- clocks : 시계 입력에 대한 참조.

선택적 속성 :
- dma-coherent : dma 작업이 일관성이 있다면 제시하십시오.

Example:
	dmaclk: dmaclk@1f27c000 {
		compatible = "apm,xgene-device-clock";
		#clock-cells = <1>;
		clocks = <&socplldiv2 0>;
		reg = <0x0 0x1f27c000 0x0 0x1000>;
		reg-names = "csr-reg";
		clock-output-names = "dmaclk";
	};

	dma: dma@1f270000 {
			compatible = "apm,xgene-storm-dma";
			device_type = "dma";
			reg = <0x0 0x1f270000 0x0 0x10000>,
			      <0x0 0x1f200000 0x0 0x10000>,
			      <0x0 0x1b000000 0x0 0x400000>,
			      <0x0 0x1054a000 0x0 0x100>;
			interrupts = <0x0 0x82 0x4>,
				     <0x0 0xb8 0x4>,
				     <0x0 0xb9 0x4>,
				     <0x0 0xba 0x4>,
				     <0x0 0xbb 0x4>;
			dma-coherent;
			clocks = <&dmaclk 0>;
	};

*/
```

## Doc/DeviceDriver/devicetree/bindings/dma/arm-pl08x.txt
```
* ARM PrimeCells PL080 and PL081 and derivatives DMA controller

Required properties:
- compatible: "arm,pl080", "arm,primecell";
	      "arm,pl081", "arm,primecell";
- reg: Address range of the PL08x registers
- interrupt: The PL08x interrupt number
- clocks: The clock running the IP core clock
- clock-names: Must contain "apb_pclk"
- lli-bus-interface-ahb1: if AHB master 1 is eligible for fetching LLIs
- lli-bus-interface-ahb2: if AHB master 2 is eligible for fetching LLIs
- mem-bus-interface-ahb1: if AHB master 1 is eligible for fetching memory contents
- mem-bus-interface-ahb2: if AHB master 2 is eligible for fetching memory contents
- #dma-cells: must be <2>. First cell should contain the DMA request,
              second cell should contain either 1 or 2 depending on
              which AHB master that is used.

Optional properties:
- dma-channels: contains the total number of DMA channels supported by the DMAC
- dma-requests: contains the total number of DMA requests supported by the DMAC
- memcpy-burst-size: the size of the bursts for memcpy: 1, 4, 8, 16, 32
  64, 128 or 256 bytes are legal values
- memcpy-bus-width: the bus width used for memcpy: 8, 16 or 32 are legal
  values

Clients
Required properties:
- dmas: List of DMA controller phandle, request channel and AHB master id
- dma-names: Names of the aforementioned requested channels

Example:

dmac0: dma-controller@10130000 {
	compatible = "arm,pl080", "arm,primecell";
	reg = <0x10130000 0x1000>;
	interrupt-parent = <&vica>;
	interrupts = <15>;
	clocks = <&hclkdma0>;
	clock-names = "apb_pclk";
	lli-bus-interface-ahb1;
	lli-bus-interface-ahb2;
	mem-bus-interface-ahb2;
	memcpy-burst-size = <256>;
	memcpy-bus-width = <32>;
	#dma-cells = <2>;
};

device@40008000 {
	...
	dmas = <&dmac0 0 2
		&dmac0 1 2>;
	dma-names = "tx", "rx";
	...
};

* ARM PrimeCells PL080 棺 PL081 棺 颇积拱 DMA 牧飘费矾

鞘荐 加己 :
- 龋券 啊瓷 : "arm, pl080", "arm, primecell";
"迫, pl081", "迫, primecell";
- reg : PL08x 饭瘤胶磐狼 林家 裹困
- 牢磐反飘 : PL08x 牢磐反飘 锅龋
- clocks : IP 内绢 努钒阑 角青窍绰 努废
- clock-names : "apb_pclk"甫 器窃秦具钦聪促.
- lli-bus-interface-ahb1 : AHB 付胶磐 1捞 LLI甫 啊廉棵 荐乐绰 版快
- lli-bus-interface-ahb2 : AHB 付胶磐 2啊 LLI甫 啊廉棵 荐乐绰 版快
- mem-bus-interface-ahb1 : AHB 付胶磐 1捞 皋葛府 郴侩阑 啊廉棵 荐乐绰 版快
- mem-bus-interface-ahb2 : AHB 付胶磐 2啊 皋葛府 郴侩阑 啊廉棵 荐乐绰 版快
- # dma-cells : <2> 咯具钦聪促. 霉 锅掳 伎俊绰 DMA 夸没捞 器窃登绢具窍绊 滴 锅掳 伎俊绰 荤侩登绰 AHB 付胶磐俊 蝶扼 1 肚绰 2啊 乐绢具钦聪促.

急琶利 加己 :
- dma-channels : DMAC俊辑 瘤盔窍绰 醚 DMA 盲澄 荐甫 器窃钦聪促.
- dma-requests : DMAC俊辑 瘤盔窍绰 醚 DMA 夸没 荐甫 器窃钦聪促.
- memcpy-burst-size : memcpy狼 滚胶飘 农扁 : 1, 4, 8, 16, 32, 64, 128 肚绰 256 官捞飘绰 蜡瓤茄 蔼涝聪促.
- memcpy-bus-width : memcpy俊 荤侩 等 滚胶 呈厚 : 8, 16 肚绰 32绰 蜡瓤茄 蔼 努扼捞攫飘

鞘荐 加己 :
- dmas : DMA 牧飘费矾 phandle, 夸没 盲澄 棺 AHB 付胶磐 ID 格废
- dma-names : 困俊辑 攫鞭 茄 夸没 等 盲澄狼 捞抚

Example:

dmac0: dma-controller@10130000 {
	compatible = "arm,pl080", "arm,primecell";
	reg = <0x10130000 0x1000>;
	interrupt-parent = <&vica>;
	interrupts = <15>;
	clocks = <&hclkdma0>;
	clock-names = "apb_pclk";
	lli-bus-interface-ahb1;
	lli-bus-interface-ahb2;
	mem-bus-interface-ahb2;
	memcpy-burst-size = <256>;
	memcpy-bus-width = <32>;
	#dma-cells = <2>;
};

device@40008000 {
	...
	dmas = <&dmac0 0 2
		&dmac0 1 2>;
	dma-names = "tx", "rx";
	...
};

*/
```
