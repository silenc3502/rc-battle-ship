## Doc/DeviceDriver/devicetree/bindings/dma/fsl-imx-sdma.txt
```
* Freescale Smart Direct Memory Access (SDMA) Controller for i.MX

Required properties:
- compatible : Should be one of
      "fsl,imx25-sdma"
      "fsl,imx31-sdma", "fsl,imx31-to1-sdma", "fsl,imx31-to2-sdma"
      "fsl,imx35-sdma", "fsl,imx35-to1-sdma", "fsl,imx35-to2-sdma"
      "fsl,imx51-sdma"
      "fsl,imx53-sdma"
      "fsl,imx6q-sdma"
  The -to variants should be preferred since they allow to determine the
  correct ROM script addresses needed for the driver to work without additional
  firmware.
- reg : Should contain SDMA registers location and length
- interrupts : Should contain SDMA interrupt
- #dma-cells : Must be <3>.
  The first cell specifies the DMA request/event ID.  See details below
  about the second and third cell.
- fsl,sdma-ram-script-name : Should contain the full path of SDMA RAM
  scripts firmware

The second cell of dma phandle specifies the peripheral type of DMA transfer.
The full ID of peripheral types can be found below.

	ID	transfer type
	---------------------
	0	MCU domain SSI
	1	Shared SSI
	2	MMC
	3	SDHC
	4	MCU domain UART
	5	Shared UART
	6	FIRI
	7	MCU domain CSPI
	8	Shared CSPI
	9	SIM
	10	ATA
	11	CCM
	12	External peripheral
	13	Memory Stick Host Controller
	14	Shared Memory Stick Host Controller
	15	DSP
	16	Memory
	17	FIFO type Memory
	18	SPDIF
	19	IPU Memory
	20	ASRC
	21	ESAI
	22	SSI Dual FIFO	(needs firmware ver >= 2)
	23	Shared ASRC
	24	SAI

The third cell specifies the transfer priority as below.

	ID	transfer priority
	-------------------------
	0	High
	1	Medium
	2	Low

Examples:

sdma@83fb0000 {
	compatible = "fsl,imx51-sdma", "fsl,imx35-sdma";
	reg = <0x83fb0000 0x4000>;
	interrupts = <6>;
	#dma-cells = <3>;
	fsl,sdma-ram-script-name = "sdma-imx51.bin";
};

DMA clients connected to the i.MX SDMA controller must use the format
described in the dma.txt file.

Examples:

ssi2: ssi@70014000 {
	compatible = "fsl,imx51-ssi", "fsl,imx21-ssi";
	reg = <0x70014000 0x4000>;
	interrupts = <30>;
	clocks = <&clks 49>;
	dmas = <&sdma 24 1 0>,
	       <&sdma 25 1 0>;
	dma-names = "rx", "tx";
	fsl,fifo-depth = <15>;
};

/*
====================================================================================

* i.MX 용 프리 스케일 스마트 직접 메모리 액세스 (SDMA) 컨트롤러

필수 속성 :
- 호환 가능 : 다음 중 하나 여야합니다.
      "fsl, imx25-sdma"
      "fsl, imx31-sdma", "fsl, imx31-to1-sdma", "fsl, imx31-to2-sdma"
      "fsl, imx35-sdma", "fsl, imx35-to1-sdma", "fsl, imx35-to2-sdma"
      "fsl, imx51-sdma"
      "fsl, imx53-sdma"
      "fsl, imx6q-sdma"
  -to 변형은 드라이버가 추가 펌웨어없이 작동하는 데 필요한 올바른 ROM 스크립트 주소를 결정할 수 있으므로 선호됩니다.
- reg : SDMA 레지스터 위치와 길이를 포함해야한다.
- 인터럽트 : SDMA 인터럽트를 포함해야합니다.
- # dma-cells : <3>이어야합니다.
  첫 번째 셀은 DMA 요청 / 이벤트 ID를 지정합니다. 두 번째 및 세 번째 셀에 대한 자세한 내용은 아래를 참조하십시오.
- fsl, sdma-ram-script-name : SDMA RAM 스크립트 펌웨어의 전체 경로를 포함해야합니다.

dma phandle의 두 번째 셀은 주변 장치 유형의 DMA 전송을 지정합니다.
주변기기 유형의 전체 ID는 아래에서 확인할 수 있습니다.

ID 전송 유형
---------------------
0 MCU 도메인 SSI
공유 SSI 1 개
2 MMC
3 SDHC
4 MCU 도메인 UART
5 공유 UART
6 FIRI
7 MCU 도메인 CSPI
8 공유 CSPI
9 SIM
10 ATA
11 CCM
12 외부 주변 장치
13 메모리 스틱 호스트 컨트롤러
공유 메모리 스틱 호스트 컨트롤러 14 개
15 DSP
16 메모리
17 FIFO 형 메모리
18 SPDIF
19 IPU 메모리
20 ASRC
21 ESAI
22 SSI 이중 FIFO (펌웨어 버전 2 이상 필요)
23 공유 ASRC
24 SAI

세 번째 셀은 다음과 같이 전송 우선 순위를 지정합니다.

ID 전송 우선 순위
-------------------------
0 높음
1 중형
2 낮음

Examples:

sdma@83fb0000 {
	compatible = "fsl,imx51-sdma", "fsl,imx35-sdma";
	reg = <0x83fb0000 0x4000>;
	interrupts = <6>;
	#dma-cells = <3>;
	fsl,sdma-ram-script-name = "sdma-imx51.bin";
};
i.MX SDMA 컨트롤러에 연결된 DMA 클라이언트는 dma.txt 파일에 설명 된 형식을 사용해야합니다.


Examples:

ssi2: ssi@70014000 {
	compatible = "fsl,imx51-ssi", "fsl,imx21-ssi";
	reg = <0x70014000 0x4000>;
	interrupts = <30>;
	clocks = <&clks 49>;
	dmas = <&sdma 24 1 0>,
	       <&sdma 25 1 0>;
	dma-names = "rx", "tx";
	fsl,fifo-depth = <15>;
};
====================================================================================
*/
```

## Doc/DeviceDriver/devicetree/bindings/dma/img-mdc-dma.txt
```
* IMG Multi-threaded DMA Controller (MDC)

Required properties:
- compatible: Must be "img,pistachio-mdc-dma".
- reg: Must contain the base address and length of the MDC registers.
- interrupts: Must contain all the per-channel DMA interrupts.
- clocks: Must contain an entry for each entry in clock-names.
  See ../clock/clock-bindings.txt for details.
- clock-names: Must include the following entries:
  - sys: MDC system interface clock.
- img,cr-periph: Must contain a phandle to the peripheral control syscon
  node which contains the DMA request to channel mapping registers.
- img,max-burst-multiplier: Must be the maximum supported burst size multiplier.
  The maximum burst size is this value multiplied by the hardware-reported bus
  width.
- #dma-cells: Must be 3:
  - The first cell is the peripheral's DMA request line.
  - The second cell is a bitmap specifying to which channels the DMA request
    line may be mapped (i.e. bit N set indicates channel N is usable).
  - The third cell is the thread ID to be used by the channel.

Optional properties:
- dma-channels: Number of supported DMA channels, up to 32.  If not specified
  the number reported by the hardware is used.

Example:

mdc: dma-controller@18143000 {
	compatible = "img,pistachio-mdc-dma";
	reg = <0x18143000 0x1000>;
	interrupts = <GIC_SHARED 27 IRQ_TYPE_LEVEL_HIGH>,
		     <GIC_SHARED 28 IRQ_TYPE_LEVEL_HIGH>,
		     <GIC_SHARED 29 IRQ_TYPE_LEVEL_HIGH>,
		     <GIC_SHARED 30 IRQ_TYPE_LEVEL_HIGH>,
		     <GIC_SHARED 31 IRQ_TYPE_LEVEL_HIGH>,
		     <GIC_SHARED 32 IRQ_TYPE_LEVEL_HIGH>,
		     <GIC_SHARED 33 IRQ_TYPE_LEVEL_HIGH>,
		     <GIC_SHARED 34 IRQ_TYPE_LEVEL_HIGH>,
		     <GIC_SHARED 35 IRQ_TYPE_LEVEL_HIGH>,
		     <GIC_SHARED 36 IRQ_TYPE_LEVEL_HIGH>,
		     <GIC_SHARED 37 IRQ_TYPE_LEVEL_HIGH>,
		     <GIC_SHARED 38 IRQ_TYPE_LEVEL_HIGH>;
	clocks = <&system_clk>;
	clock-names = "sys";

	img,max-burst-multiplier = <16>;
	img,cr-periph = <&cr_periph>;

	#dma-cells = <3>;
};

spi@18100f00 {
	...
	dmas = <&mdc 9 0xffffffff 0>, <&mdc 10 0xffffffff 0>;
	dma-names = "tx", "rx";
	...
};

/*

* IMG 멀티 스레드 DMA 컨트롤러 (MDC)

필수 속성 :
- 호환 : "img, 피스타치오 -mdc-dma"여야합니다.
- reg : MDC 레지스터의 기본 주소와 길이를 포함해야합니다.
- 인터럽트 : 모든 채널 별 DMA 인터럽트를 포함해야합니다.
- clocks : clock-name의 각 항목에 대한 항목을 포함해야합니다.
  자세한 내용은 ../clock/clock-bindings.txt를 참조하십시오.
- clock-names : 다음 항목을 포함해야합니다.
  - sys : MDC 시스템 인터페이스 클럭.
- img, cr-periph : 주변 제어 syscon에 phandle을 포함해야합니다.
  채널 맵핑 레지스터에 대한 DMA 요구를 포함하는 노드.
- img, max-burst-multiplier : 지원되는 최대 버스트 크기 배수 여야합니다.
최대 버스트 크기는 하드웨어에보고 된 버스 폭을 곱한 값입니다.
- # dma-cells : 3이어야합니다.
  - 첫 번째 셀은 주변 장치의 DMA 요청 라인입니다.
  - 제 2 셀은 DMA 요청 라인이 맵핑 될 수있는 채널 (즉, 비트 N 세트는 채널 N이 사용 가능함을 나타냄)을 지정하는 비트 맵이다.
  - 세 번째 셀은 채널에서 사용할 스레드 ID입니다.

선택적 속성 :
- dma-channels : 지원되는 DMA 채널의 수 (최대 32). 지정하지 않으면 하드웨어에서보고 한 번호가 사용됩니다.

Example:

mdc: dma-controller@18143000 {
	compatible = "img,pistachio-mdc-dma";
	reg = <0x18143000 0x1000>;
	interrupts = <GIC_SHARED 27 IRQ_TYPE_LEVEL_HIGH>,
		     <GIC_SHARED 28 IRQ_TYPE_LEVEL_HIGH>,
		     <GIC_SHARED 29 IRQ_TYPE_LEVEL_HIGH>,
		     <GIC_SHARED 30 IRQ_TYPE_LEVEL_HIGH>,
		     <GIC_SHARED 31 IRQ_TYPE_LEVEL_HIGH>,
		     <GIC_SHARED 32 IRQ_TYPE_LEVEL_HIGH>,
		     <GIC_SHARED 33 IRQ_TYPE_LEVEL_HIGH>,
		     <GIC_SHARED 34 IRQ_TYPE_LEVEL_HIGH>,
		     <GIC_SHARED 35 IRQ_TYPE_LEVEL_HIGH>,
		     <GIC_SHARED 36 IRQ_TYPE_LEVEL_HIGH>,
		     <GIC_SHARED 37 IRQ_TYPE_LEVEL_HIGH>,
		     <GIC_SHARED 38 IRQ_TYPE_LEVEL_HIGH>;
	clocks = <&system_clk>;
	clock-names = "sys";

	img,max-burst-multiplier = <16>;
	img,cr-periph = <&cr_periph>;

	#dma-cells = <3>;
};

spi@18100f00 {
	...
	dmas = <&mdc 9 0xffffffff 0>, <&mdc 10 0xffffffff 0>;
	dma-names = "tx", "rx";
	...
};

*/
```

## Doc/DeviceDriver/devicetree/bindings/dma/jz4780-dma.txt
```
* Ingenic JZ4780 DMA Controller

Required properties:

- compatible: Should be "ingenic,jz4780-dma"
- reg: Should contain the DMA controller registers location and length.
- interrupts: Should contain the interrupt specifier of the DMA controller.
- interrupt-parent: Should be the phandle of the interrupt controller that
- clocks: Should contain a clock specifier for the JZ4780 PDMA clock.
- #dma-cells: Must be <2>. Number of integer cells in the dmas property of
  DMA clients (see below).

Optional properties:

- ingenic,reserved-channels: Bitmask of channels to reserve for devices that
  need a specific channel. These channels will only be assigned when explicitly
  requested by a client. The primary use for this is channels 0 and 1, which
  can be configured to have special behaviour for NAND/BCH when using
  programmable firmware.

Example:

dma: dma@13420000 {
	compatible = "ingenic,jz4780-dma";
	reg = <0x13420000 0x10000>;

	interrupt-parent = <&intc>;
	interrupts = <10>;

	clocks = <&cgu JZ4780_CLK_PDMA>;

	#dma-cells = <2>;

	ingenic,reserved-channels = <0x3>;
};

DMA clients must use the format described in dma.txt, giving a phandle to the
DMA controller plus the following 2 integer cells:

1. Request type: The DMA request type for transfers to/from the device on
   the allocated channel, as defined in the SoC documentation.

2. Channel: If set to 0xffffffff, any available channel will be allocated for
   the client. Otherwise, the exact channel specified will be used. The channel
   should be reserved on the DMA controller using the ingenic,reserved-channels
   property.

Example:

uart0: serial@10030000 {
	...
	dmas = <&dma 0x14 0xffffffff
		&dma 0x15 0xffffffff>;
	dma-names = "tx", "rx";
	...
};




/*
* Ingenic JZ4780 DMA 컨트롤러

필수 속성 :

- 호환 : "ingenic, jz4780-dma"이어야 함
- reg : DMA 컨트롤러에 위치와 길이를 등록해야합니다.
- interrupts : DMA 컨트롤러의 인터럽트 지정자를 포함해야합니다.
- interrupt-parent : 인터럽트 컨트롤러의 phandle이어야합니다.
- clocks : JZ4780 PDMA 클록에 대한 시계 지정자를 포함해야합니다.
- # dma-cells : <2> 여야합니다. DMA 클라이언트의 dmas 속성에있는 정수 셀 수 (아래 참조)

선택적 속성 :

- ingenic, reserved-channels : 특정 채널이 필요한 장치에 예약 할 채널의 비트 마스크입니다. 이 채널은 클라이언트가 명시 적으로 요청한 경우에만 할당됩니다. 이것의 주요 용도는 채널 0과 1이며, 프로그래머블 펌웨어를 사용할 때 NAND / BCH에 특별한 동작을하도록 구성 할 수 있습니다.

Example:

dma: dma@13420000 {
	compatible = "ingenic,jz4780-dma";
	reg = <0x13420000 0x10000>;

	interrupt-parent = <&intc>;
	interrupts = <10>;

	clocks = <&cgu JZ4780_CLK_PDMA>;

	#dma-cells = <2>;

	ingenic,reserved-channels = <0x3>;
};


DMA 클라이언트는 dma.txt에 설명 된 형식을 사용해야하며 DMA 컨트롤러에 다음과 같은 2 개의 정수 셀을 추가 할 수 있습니다.

1. 요청 유형 : SoC 문서에 정의 된대로 할당 된 채널에서 장치로 / 장치로 전송하기위한 DMA 요청 유형입니다.

2. 채널 : 0xffffffff로 설정하면 사용 가능한 채널이
   클라이언트. 그렇지 않으면 지정된 정확한 채널이 사용됩니다. 채널은 고유, 예약 채널 속성을 사용하여 DMA 컨트롤러에 예약되어야합니다.


Example:

uart0: serial@10030000 {
	...
	dmas = <&dma 0x14 0xffffffff
		&dma 0x15 0xffffffff>;
	dma-names = "tx", "rx";
	...
};
*/
```
