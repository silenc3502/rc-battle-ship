## Doc/DeviceDriver/devicetree/bindings/display/ti/ti,dra7-dss.txt
```
Texas Instruments DRA7x Display Subsystem
=========================================

See Documentation/devicetree/bindings/display/ti/ti,omap-dss.txt for generic
description about OMAP Display Subsystem bindings.

DSS Core
--------

Required properties:
- compatible: "ti,dra7-dss"
- reg: address and length of the register spaces for 'dss'
- ti,hwmods: "dss_core"
- clocks: handle to fclk
- clock-names: "fck"
- syscon: phandle to control module core syscon node

Optional properties:

Some DRA7xx SoCs have one dedicated video PLL, some have two. These properties
can be used to describe the video PLLs:

- reg: address and length of the register spaces for 'pll1_clkctrl',
  'pll1', 'pll2_clkctrl', 'pll2'
- clocks: handle to video1 pll clock and video2 pll clock
- clock-names: "video1_clk" and "video2_clk"

Required nodes:
- DISPC

Optional nodes:
- DSS Submodules: HDMI
- Video port for DPI output

DPI Endpoint required properties:
- data-lines: number of lines used


DISPC
-----

Required properties:
- compatible: "ti,dra7-dispc"
- reg: address and length of the register space
- ti,hwmods: "dss_dispc"
- interrupts: the DISPC interrupt
- clocks: handle to fclk
- clock-names: "fck"

HDMI
----

Required properties:
- compatible: "ti,dra7-hdmi"
- reg: addresses and lengths of the register spaces for 'wp', 'pll', 'phy',
       'core'
- reg-names: "wp", "pll", "phy", "core"
- interrupts: the HDMI interrupt line
- ti,hwmods: "dss_hdmi"
- vdda-supply: vdda power supply
- clocks: handles to fclk and pll clock
- clock-names: "fck", "sys_clk"

Optional nodes:
- Video port for HDMI output

HDMI Endpoint optional properties:
- lanes: list of 8 pin numbers for the HDMI lanes: CLK+, CLK-, D0+, D0-,
  D1+, D1-, D2+, D2-. (default: 0,1,2,3,4,5,6,7)

/*
Texas Instruments DRA7x 디스플레이 서브 시스템
=============================

generic에 대해서는 Documentation / devicetree / bindings / display / ti / ti, omap-dss.txt를 참조하십시오.
OMAP 디스플레이 서브 시스템 바인딩에 대한 설명.

DSS 코어
--------

필수 속성 :
- 호환 : "ti, dra7-dss"
- reg : 'dss'에 대한 레지스터 공간의 주소와 길이
- 티, hwmods : "dss_core"
- 시계 : fclk 핸들
- 시계 이름 : "fck"
- syscon : 모듈 코어 syscon 노드를 제어하는 ​​phandle

선택적 속성 :

일부 DRA7xx SoC는 하나의 전용 비디오 PLL을 가지고 있으며 일부는 2 개를 가지고 있습니다. 이러한 속성
비디오 PLL을 설명하는 데 사용할 수 있습니다.

- reg : 'pll1_clkctrl'에 대한 레지스터 공간의 주소와 길이,
  'pll1', 'pll2_clkctrl', 'pll2'
- clocks : video1 pll clock 및 video2 pll clock을 처리합니다.
- clock-names : "video1_clk"및 "video2_clk"

필수 노드 :
- DISPC

선택적 노드 :
- DSS 서브 모듈 : HDMI
- DPI 출력을위한 비디오 포트

DPI endpoint 필수 속성 :
- data-lines : 사용 된 라인 수


DISPC
-----

필수 속성 :
- 호환 : "ti, dra7-dispc"
- reg : 레지스터 공간의 주소와 길이
- 티, hwmods : "dss_dispc"
- 인터럽트 : DISPC 인터럽트
- 시계 : fclk 핸들
- 시계 이름 : "fck"

HDMI
----

필수 속성 :
- 호환 : "ti, dra7-hdmi"
- reg : 'wp', 'pll', 'phy'에 대한 레지스터 공간의 주소와 길이
       '핵심'
- reg-names : "wp", "pll", "phy", "core"
- 인터럽트 : HDMI 인터럽트 라인
- 티, hwmods : "dss_hdmi"
- vdda 공급 : vdda 전원 공급 장치
- clocks : fclk 및 pll 시계를 처리합니다.
- clock-names : "fck", "sys_clk"

선택적 노드 :
- HDMI 출력용 비디오 포트

HDMI 엔드 포인트 옵션 속성 :
- 레인 : HDMI 레인에 대한 8 핀 번호 목록 : CLK +, CLK-, D0 +, D0-,
  D1 +, D1-, D2 +, D2-. (기본값 : 0,1,2,3,4,5,6,7)
*/
```

## Doc/DeviceDriver/devicetree/bindings/display/ti/ti,omap-dss.txt
```
Texas Instruments OMAP Display Subsystem
========================================

Generic Description
-------------------

This document is a generic description of the OMAP Display Subsystem bindings.
Binding details for each OMAP SoC version are described in respective binding
documentation.

The OMAP Display Subsystem (DSS) hardware consists of DSS Core, DISPC module and
a number of encoder modules. All DSS versions contain DSS Core and DISPC, but
the encoder modules vary.

The DSS Core is the parent of the other DSS modules, and manages clock routing,
integration to the SoC, etc.

DISPC is the display controller, which reads pixels from the memory and outputs
a RGB pixel stream to encoders.

The encoder modules encode the received RGB pixel stream to a video output like
HDMI, MIPI DPI, etc.

Video Ports
-----------

The DSS Core and the encoders have video port outputs. The structure of the
video ports is described in Documentation/devicetree/bindings/graph.txt,
and the properties for the ports and endpoints for each encoder are
described in the SoC's DSS binding documentation.

The video ports are used to describe the connections to external hardware, like
panels or external encoders.

Aliases
-------

The board dts file may define aliases for displays to assign "displayX" style
name for each display. If no aliases are defined, a semi-random number is used
for the display.

Example
-------

A shortened example of the DSS description for OMAP4, with non-relevant parts
removed, defined in omap4.dtsi:

dss: dss@58000000 {
	compatible = "ti,omap4-dss";
	reg = <0x58000000 0x80>;
	status = "disabled";
	ti,hwmods = "dss_core";
	clocks = <&dss_dss_clk>;
	clock-names = "fck";
	#address-cells = <1>;
	#size-cells = <1>;
	ranges;

	dispc@58001000 {
		compatible = "ti,omap4-dispc";
		reg = <0x58001000 0x1000>;
		interrupts = <GIC_SPI 25 IRQ_TYPE_LEVEL_HIGH>;
		ti,hwmods = "dss_dispc";
		clocks = <&dss_dss_clk>;
		clock-names = "fck";
	};

	hdmi: encoder@58006000 {
		compatible = "ti,omap4-hdmi";
		reg = <0x58006000 0x200>,
		      <0x58006200 0x100>,
		      <0x58006300 0x100>,
		      <0x58006400 0x1000>;
		reg-names = "wp", "pll", "phy", "core";
		interrupts = <GIC_SPI 101 IRQ_TYPE_LEVEL_HIGH>;
		status = "disabled";
		ti,hwmods = "dss_hdmi";
		clocks = <&dss_48mhz_clk>, <&dss_sys_clk>;
		clock-names = "fck", "sys_clk";
	};
};

A shortened example of the board description for OMAP4 Panda board, defined in
omap4-panda.dts.

The Panda board has a DVI and a HDMI connector, and the board contains a TFP410
chip (MIPI DPI to DVI encoder) and a TPD12S015 chip (HDMI ESD protection & level
shifter). The video pipelines for the connectors are formed as follows:

DSS Core --(MIPI DPI)--> TFP410 --(DVI)--> DVI Connector
OMAP HDMI --(HDMI)--> TPD12S015 --(HDMI)--> HDMI Connector

/ {
	aliases {
		display0 = &dvi0;
		display1 = &hdmi0;
	};

	tfp410: encoder@0 {
		compatible = "ti,tfp410";
		gpios = <&gpio1 0 GPIO_ACTIVE_LOW>;	/* 0, power-down */

		pinctrl-names = "default";
		pinctrl-0 = <&tfp410_pins>;

		ports {
			#address-cells = <1>;
			#size-cells = <0>;

			port@0 {
				reg = <0>;

				tfp410_in: endpoint@0 {
					remote-endpoint = <&dpi_out>;
				};
			};

			port@1 {
				reg = <1>;

				tfp410_out: endpoint@0 {
					remote-endpoint = <&dvi_connector_in>;
				};
			};
		};
	};

	dvi0: connector@0 {
		compatible = "dvi-connector";
		label = "dvi";

		i2c-bus = <&i2c3>;

		port {
			dvi_connector_in: endpoint {
				remote-endpoint = <&tfp410_out>;
			};
		};
	};

	tpd12s015: encoder@1 {
		compatible = "ti,tpd12s015";

		pinctrl-names = "default";
		pinctrl-0 = <&tpd12s015_pins>;

		gpios = <&gpio2 28 GPIO_ACTIVE_HIGH>,	/* 60, CT CP HPD */
			<&gpio2 9 GPIO_ACTIVE_HIGH>,	/* 41, LS OE */
			<&gpio2 31 GPIO_ACTIVE_HIGH>;	/* 63, HPD */

		ports {
			#address-cells = <1>;
			#size-cells = <0>;

			port@0 {
				reg = <0>;

				tpd12s015_in: endpoint@0 {
					remote-endpoint = <&hdmi_out>;
				};
			};

			port@1 {
				reg = <1>;

				tpd12s015_out: endpoint@0 {
					remote-endpoint = <&hdmi_connector_in>;
				};
			};
		};
	};

	hdmi0: connector@1 {
		compatible = "hdmi-connector";
		label = "hdmi";

		port {
			hdmi_connector_in: endpoint {
				remote-endpoint = <&tpd12s015_out>;
			};
		};
	};
};

&dss {
	status = "ok";

	pinctrl-names = "default";
	pinctrl-0 = <&dss_dpi_pins>;

	port {
		dpi_out: endpoint {
			remote-endpoint = <&tfp410_in>;
			data-lines = <24>;
		};
	};
};

&hdmi {
	status = "ok";
	vdda-supply = <&vdac>;

	pinctrl-names = "default";
	pinctrl-0 = <&dss_hdmi_pins>;

	port {
		hdmi_out: endpoint {
			remote-endpoint = <&tpd12s015_in>;
		};
	};
};

/*
Texas Instruments OMAP 叼胶敲饭捞 辑宏 矫胶袍
==========================

老馆 汲疙
-------------------

捞 巩辑绰 OMAP 叼胶敲饭捞 辑宏 矫胶袍 官牢爹俊 措茄 老馆利牢 汲疙捞促.
阿 OMAP SoC 滚傈俊 措茄 官牢爹 技何 荤亲篮 阿 官牢爹 巩辑俊 汲疙登绢 乐嚼聪促.

OMAP 叼胶敲饭捞 辑宏 矫胶袍 (DSS) 窍靛傀绢绰 DSS 内绢, DISPC 葛碘 棺 促荐狼 牢内歹 葛碘肺 备己邓聪促.

葛电 DSS 滚傈俊绰 DSS Core 棺 DISPC啊 器窃登绢 乐瘤父 牢内歹 葛碘篮 促剧钦聪促.

DSS 内绢绰 促弗 DSS 葛碘狼 惑困捞哥 努钒 扼快泼, SoC客狼 烹钦 殿阑 包府钦聪促.

DISPC绰 皋葛府俊辑 侨伎阑 佬绊 RGB 侨伎 胶飘覆阑 牢内歹肺 免仿窍绰 叼胶敲饭捞 牧飘费矾涝聪促.

牢内歹 葛碘篮 荐脚 等 RGB 侨伎 胶飘覆阑 HDMI, MIPI DPI 殿苞 鞍篮 厚叼坷 免仿栏肺 牢内爹钦聪促.

厚叼坷 器飘
-----------

DSS 内绢 棺 牢内歹俊绰 厚叼坷 器飘 免仿捞 乐嚼聪促. 厚叼坷 器飘狼 备炼绰 Documentation / devicetree / bindings / graph.txt俊 汲疙登绢 乐栏哥 

阿 浚内歹狼 器飘 棺 endpoint俊 措茄 殿废 沥焊绰 SoC狼 DSS 官牢爹 汲疙辑俊 汲疙登绢 乐嚼聪促.

厚叼坷 器飘绰 菩澄 肚绰 寇何 牢内歹客 鞍篮 寇何 窍靛傀绢俊 措茄 楷搬阑 汲疙窍绰 单 荤侩邓聪促.

Aliases
-------

焊靛 dts 颇老篮 阿 叼胶敲饭捞俊 措秦 "displayX"胶鸥老 捞抚阑 瘤沥窍扁 困秦 叼胶敲饭捞狼 Aliases阑 沥狼 且 荐 乐嚼聪促. 

Aliases捞 沥狼登瘤 臼篮 版快 技固 烙狼 锅龋啊 叼胶敲饭捞俊 荤侩邓聪促.

Example
-------

A shortened example of the DSS description for OMAP4, with non-relevant parts removed, defined in omap4.dtsi:

dss: dss@58000000 {
	compatible = "ti,omap4-dss";
	reg = <0x58000000 0x80>;
	status = "disabled";
	ti,hwmods = "dss_core";
	clocks = <&dss_dss_clk>;
	clock-names = "fck";
	#address-cells = <1>;
	#size-cells = <1>;
	ranges;

	dispc@58001000 {
		compatible = "ti,omap4-dispc";
		reg = <0x58001000 0x1000>;
		interrupts = <GIC_SPI 25 IRQ_TYPE_LEVEL_HIGH>;
		ti,hwmods = "dss_dispc";
		clocks = <&dss_dss_clk>;
		clock-names = "fck";
	};

	hdmi: encoder@58006000 {
		compatible = "ti,omap4-hdmi";
		reg = <0x58006000 0x200>,
		      <0x58006200 0x100>,
		      <0x58006300 0x100>,
		      <0x58006400 0x1000>;
		reg-names = "wp", "pll", "phy", "core";
		interrupts = <GIC_SPI 101 IRQ_TYPE_LEVEL_HIGH>;
		status = "disabled";
		ti,hwmods = "dss_hdmi";
		clocks = <&dss_48mhz_clk>, <&dss_sys_clk>;
		clock-names = "fck", "sys_clk";
	};
};

A shortened example of the board description for OMAP4 Panda board, defined in omap4-panda.dts.

The Panda board has a DVI and a HDMI connector, and the board contains a TFP410 chip (MIPI DPI to DVI encoder) and a TPD12S015 chip (HDMI ESD protection & level shifter). The video pipelines for the connectors are formed as follows:

DSS Core --(MIPI DPI)--> TFP410 --(DVI)--> DVI Connector
OMAP HDMI --(HDMI)--> TPD12S015 --(HDMI)--> HDMI Connector

/ {
	aliases {
		display0 = &dvi0;
		display1 = &hdmi0;
	};

	tfp410: encoder@0 {
		compatible = "ti,tfp410";
		gpios = <&gpio1 0 GPIO_ACTIVE_LOW>;	/* 0, power-down */

		pinctrl-names = "default";
		pinctrl-0 = <&tfp410_pins>;

		ports {
			#address-cells = <1>;
			#size-cells = <0>;

			port@0 {
				reg = <0>;

				tfp410_in: endpoint@0 {
					remote-endpoint = <&dpi_out>;
				};
			};

			port@1 {
				reg = <1>;

				tfp410_out: endpoint@0 {
					remote-endpoint = <&dvi_connector_in>;
				};
			};
		};
	};

	dvi0: connector@0 {
		compatible = "dvi-connector";
		label = "dvi";

		i2c-bus = <&i2c3>;

		port {
			dvi_connector_in: endpoint {
				remote-endpoint = <&tfp410_out>;
			};
		};
	};

	tpd12s015: encoder@1 {
		compatible = "ti,tpd12s015";

		pinctrl-names = "default";
		pinctrl-0 = <&tpd12s015_pins>;

		gpios = <&gpio2 28 GPIO_ACTIVE_HIGH>,	/* 60, CT CP HPD */
			<&gpio2 9 GPIO_ACTIVE_HIGH>,	/* 41, LS OE */
			<&gpio2 31 GPIO_ACTIVE_HIGH>;	/* 63, HPD */

		ports {
			#address-cells = <1>;
			#size-cells = <0>;

			port@0 {
				reg = <0>;

				tpd12s015_in: endpoint@0 {
					remote-endpoint = <&hdmi_out>;
				};
			};

			port@1 {
				reg = <1>;

				tpd12s015_out: endpoint@0 {
					remote-endpoint = <&hdmi_connector_in>;
				};
			};
		};
	};

	hdmi0: connector@1 {
		compatible = "hdmi-connector";
		label = "hdmi";

		port {
			hdmi_connector_in: endpoint {
				remote-endpoint = <&tpd12s015_out>;
			};
		};
	};
};

&dss {
	status = "ok";

	pinctrl-names = "default";
	pinctrl-0 = <&dss_dpi_pins>;

	port {
		dpi_out: endpoint {
			remote-endpoint = <&tfp410_in>;
			data-lines = <24>;
		};
	};
};

&hdmi {
	status = "ok";
	vdda-supply = <&vdac>;

	pinctrl-names = "default";
	pinctrl-0 = <&dss_hdmi_pins>;

	port {
		hdmi_out: endpoint {
			remote-endpoint = <&tpd12s015_in>;
		};
	};
};

*/
```

## Doc/DeviceDriver/devicetree/bindings/display/ti/ti,omap2-dss.txt
```
Texas Instruments OMAP2 Display Subsystem
=========================================

See Documentation/devicetree/bindings/display/ti/ti,omap-dss.txt for generic
description about OMAP Display Subsystem bindings.

DSS Core
--------

Required properties:
- compatible: "ti,omap2-dss"
- reg: address and length of the register space
- ti,hwmods: "dss_core"

Optional nodes:
- Video port for DPI output

DPI Endpoint required properties:
- data-lines: number of lines used


DISPC
-----

Required properties:
- compatible: "ti,omap2-dispc"
- reg: address and length of the register space
- ti,hwmods: "dss_dispc"
- interrupts: the DISPC interrupt


RFBI
----

Required properties:
- compatible: "ti,omap2-rfbi"
- reg: address and length of the register space
- ti,hwmods: "dss_rfbi"


VENC
----

Required properties:
- compatible: "ti,omap2-venc"
- reg: address and length of the register space
- ti,hwmods: "dss_venc"
- vdda-supply: power supply for DAC

VENC Endpoint required properties:

Required properties:
- ti,invert-polarity: invert the polarity of the video signal
- ti,channels: 1 for composite, 2 for s-video

/*
Texas Instruments OMAP2 叼胶敲饭捞 辑宏 矫胶袍
=============================

OMAP 叼胶敲饭捞 辑宏 矫胶袍 官牢爹俊 措茄 老馆利牢 汲疙篮 Documentation / devicetree / bindings / display / ti / ti, omap-dss.txt甫 曼炼窍绞矫坷.

DSS 内绢
--------

鞘荐 加己 :
- 龋券 : "ti, omap2-dss"
- reg : 饭瘤胶磐 傍埃狼 林家客 辨捞
- 萍, hwmods : "dss_core"

急琶利 畴靛 :
- DPI 免仿阑困茄 厚叼坷 器飘

DPI endpoint 鞘荐 加己 :
- data-lines : 荤侩 等 扼牢 荐


DISPC
-----

鞘荐 加己 :
- 龋券 : "ti, omap2-dispc"
- reg : 饭瘤胶磐 傍埃狼 林家客 辨捞
- 萍, hwmods : "dss_dispc"
- 牢磐反飘 : DISPC 牢磐反飘


RFBI
----

鞘荐 加己 :
- 龋券 : "ti, omap2-rfbi"
- reg : 饭瘤胶磐 傍埃狼 林家客 辨捞
- 萍, hwmods : "dss_rfbi"


VENC
----

鞘荐 加己 :
- 龋券 : "ti, omap2-venc"
- reg : 饭瘤胶磐 傍埃狼 林家客 辨捞
- 萍, hwmods : "dss_venc"
- vdda-supply : DAC 侩 傈盔 傍鞭 厘摹

VENC 浚靛 器牢飘 鞘荐 加己 :

鞘荐 加己 :
- ti, invert-polarity : 厚叼坷 脚龋狼 必己阑 馆傈矫诺聪促.
- 萍, 盲澄 : 钦己拱 1, s- 厚叼坷 2
*/
```
