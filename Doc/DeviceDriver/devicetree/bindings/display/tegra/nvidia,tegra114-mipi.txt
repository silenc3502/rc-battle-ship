## Doc/DeviceDriver/devicetree/bindings/display/ti/ti,omap3-dss.txt
```
Texas Instruments OMAP3 Display Subsystem
=========================================

See Documentation/devicetree/bindings/display/ti/ti,omap-dss.txt for generic
description about OMAP Display Subsystem bindings.

DSS Core
--------

Required properties:
- compatible: "ti,omap3-dss"
- reg: address and length of the register space
- ti,hwmods: "dss_core"
- clocks: handle to fclk
- clock-names: "fck"

Optional nodes:
- Video ports:
	- Port 0: DPI output
	- Port 1: SDI output

DPI Endpoint required properties:
- data-lines: number of lines used

SDI Endpoint required properties:
- datapairs: number of datapairs used


DISPC
-----

Required properties:
- compatible: "ti,omap3-dispc"
- reg: address and length of the register space
- ti,hwmods: "dss_dispc"
- interrupts: the DISPC interrupt
- clocks: handle to fclk
- clock-names: "fck"


RFBI
----

Required properties:
- compatible: "ti,omap3-rfbi"
- reg: address and length of the register space
- ti,hwmods: "dss_rfbi"
- clocks: handles to fclk and iclk
- clock-names: "fck", "ick"


VENC
----

Required properties:
- compatible: "ti,omap3-venc"
- reg: address and length of the register space
- ti,hwmods: "dss_venc"
- vdda-supply: power supply for DAC
- clocks: handle to fclk
- clock-names: "fck"

VENC Endpoint required properties:
- ti,invert-polarity: invert the polarity of the video signal
- ti,channels: 1 for composite, 2 for s-video


DSI
---

Required properties:
- compatible: "ti,omap3-dsi"
- reg: addresses and lengths of the register spaces for 'proto', 'phy' and 'pll'
- reg-names: "proto", "phy", "pll"
- interrupts: the DSI interrupt line
- ti,hwmods: "dss_dsi1"
- vdd-supply: power supply for DSI
- clocks: handles to fclk and pll clock
- clock-names: "fck", "sys_clk"

DSI Endpoint required properties:
- lanes: list of pin numbers for the DSI lanes: CLK+, CLK-, DATA0+, DATA0-,
  DATA1+, DATA1-, ...

/*
Texas Instruments OMAP3 叼胶敲饭捞 辑宏 矫胶袍
=============================

OMAP 叼胶敲饭捞 辑宏 矫胶袍 官牢爹俊 措茄 老馆利牢 汲疙篮 Documentation / devicetree / bindings / display / ti / ti, omap-dss.txt甫 曼炼窍绞矫坷.

DSS 内绢
--------

鞘荐 加己 :
- 龋券 : "ti, omap3-dss"
- reg : 饭瘤胶磐 傍埃狼 林家客 辨捞
- 萍, hwmods : "dss_core"
- 矫拌 : fclk 勤甸
- 矫拌 捞抚 : "fck"

急琶利 畴靛 :
- 厚叼坷 器飘 :
- 器飘 0 : DPI 免仿
- Port 1 : SDI 免仿

DPI 场痢 鞘荐 加己 :
- data-lines : 荤侩 等 扼牢 荐

SDI 浚靛 器牢飘 鞘荐 加己 :
- datapairs : 荤侩 等 单捞磐 楷搬 荐


DISPC
-----

鞘荐 加己 :
- 龋券 : "ti, omap3-dispc"
- reg : 饭瘤胶磐 傍埃狼 林家客 辨捞
- 萍, hwmods : "dss_dispc"
- 牢磐反飘 : DISPC 牢磐反飘
- 矫拌 : fclk 勤甸
- 矫拌 捞抚 : "fck"


RFBI
----

鞘荐 加己 :
- 龋券 : "ti, omap3-rfbi"
- reg : 饭瘤胶磐 傍埃狼 林家客 辨捞
- 萍, hwmods : "dss_rfbi"
- 矫拌 : fclk 棺 iclk 勤甸
- 矫拌 捞抚 : "fck", "ick"


VENC
----

鞘荐 加己 :
- 龋券 : "ti, omap3-venc"
- reg : 饭瘤胶磐 傍埃狼 林家客 辨捞
- 萍, hwmods : "dss_venc"
- vdda-supply : DAC 侩 傈盔 傍鞭 厘摹
- 矫拌 : fclk 勤甸
- 矫拌 捞抚 : "fck"

VENC 浚靛 器牢飘 鞘荐 加己 :
- ti, invert-polarity : 厚叼坷 脚龋狼 必己阑 馆傈矫诺聪促.
- 萍, 盲澄 : 钦己拱 1, s- 厚叼坷 2


DSI
---

鞘荐 加己 :
- 龋券 : "ti, omap3-dsi"
- reg : 'proto', 'phy'棺 'pll'俊 措茄 饭瘤胶磐 傍埃狼 林家客 辨捞
- reg-names : "proto", "phy", "pll"
- 牢磐反飘 : DSI 牢磐反飘 扼牢
- ti, hwmods : "dss_dsi1"
- vdd-supply : DSI 侩 傈盔 傍鞭 厘摹
- clocks : fclk 棺 pll 矫拌甫 贸府钦聪促.
- clock-names : "fck", "sys_clk"

DSI 浚靛 器牢飘 鞘荐 漂己 :
- 瞒急 : DSI 饭牢狼 巧 锅龋 格废 : CLK +, CLK-, DATA0 +, DATA0-, DATA1 +, DATA1-, ...
*/
```

## Doc/DeviceDriver/devicetree/bindings/display/ti/ti,omap4-dss.txt
```
Texas Instruments OMAP4 Display Subsystem
=========================================

See Documentation/devicetree/bindings/display/ti/ti,omap-dss.txt for generic
description about OMAP Display Subsystem bindings.

DSS Core
--------

Required properties:
- compatible: "ti,omap4-dss"
- reg: address and length of the register space
- ti,hwmods: "dss_core"
- clocks: handle to fclk
- clock-names: "fck"

Required nodes:
- DISPC

Optional nodes:
- DSS Submodules: RFBI, VENC, DSI, HDMI
- Video port for DPI output

DPI Endpoint required properties:
- data-lines: number of lines used


DISPC
-----

Required properties:
- compatible: "ti,omap4-dispc"
- reg: address and length of the register space
- ti,hwmods: "dss_dispc"
- interrupts: the DISPC interrupt
- clocks: handle to fclk
- clock-names: "fck"


RFBI
----

Required properties:
- compatible: "ti,omap4-rfbi"
- reg: address and length of the register space
- ti,hwmods: "dss_rfbi"
- clocks: handles to fclk and iclk
- clock-names: "fck", "ick"

Optional nodes:
- Video port for RFBI output
- RFBI controlled peripherals


VENC
----

Required properties:
- compatible: "ti,omap4-venc"
- reg: address and length of the register space
- ti,hwmods: "dss_venc"
- vdda-supply: power supply for DAC
- clocks: handle to fclk
- clock-names: "fck"

Optional nodes:
- Video port for VENC output

VENC Endpoint required properties:
- ti,invert-polarity: invert the polarity of the video signal
- ti,channels: 1 for composite, 2 for s-video


DSI
---

Required properties:
- compatible: "ti,omap4-dsi"
- reg: addresses and lengths of the register spaces for 'proto', 'phy' and 'pll'
- reg-names: "proto", "phy", "pll"
- interrupts: the DSI interrupt line
- ti,hwmods: "dss_dsi1" or "dss_dsi2"
- vdd-supply: power supply for DSI
- clocks: handles to fclk and pll clock
- clock-names: "fck", "sys_clk"

Optional nodes:
- Video port for DSI output
- DSI controlled peripherals

DSI Endpoint required properties:
- lanes: list of pin numbers for the DSI lanes: CLK+, CLK-, DATA0+, DATA0-,
  DATA1+, DATA1-, ...


HDMI
----

Required properties:
- compatible: "ti,omap4-hdmi"
- reg: addresses and lengths of the register spaces for 'wp', 'pll', 'phy',
       'core'
- reg-names: "wp", "pll", "phy", "core"
- interrupts: the HDMI interrupt line
- ti,hwmods: "dss_hdmi"
- vdda-supply: vdda power supply
- clocks: handles to fclk and pll clock
- clock-names: "fck", "sys_clk"

Optional nodes:
- Video port for HDMI output

HDMI Endpoint optional properties:
- lanes: list of 8 pin numbers for the HDMI lanes: CLK+, CLK-, D0+, D0-,
  D1+, D1-, D2+, D2-. (default: 0,1,2,3,4,5,6,7)


/*

Texas Instruments OMAP4 디스플레이 서브 시스템
=============================

OMAP 디스플레이 서브 시스템 바인딩에 대한 일반적인 설명은 Documentation / devicetree / bindings / display / ti / ti, omap-dss.txt를 참조하십시오.

DSS 코어
--------

필수 속성 :
- 호환 : "ti, omap4-dss"
- reg : 레지스터 공간의 주소와 길이
- 티, hwmods : "dss_core"
- 시계 : fclk 핸들
- 시계 이름 : "fck"

필수 노드 :
- DISPC

선택적 노드 :
- DSS 서브 모듈 : RFBI, VENC, DSI, HDMI
- DPI 출력을위한 비디오 포트

DPI 끝점 필수 속성 :
- data-lines : 사용 된 라인 수


DISPC
-----

필수 속성 :
- 호환 : "ti, omap4-dispc"
- reg : 레지스터 공간의 주소와 길이
- 티, hwmods : "dss_dispc"
- 인터럽트 : DISPC 인터럽트
- 시계 : fclk 핸들
- 시계 이름 : "fck"


RFBI
----

필수 속성 :
- 호환 : "ti, omap4-rfbi"
- reg : 레지스터 공간의 주소와 길이
- 티, hwmods : "dss_rfbi"
- 시계 : fclk 및 iclk 핸들
- 시계 이름 : "fck", "ick"

선택적 노드 :
- RFBI 출력을위한 비디오 포트
- RFBI 제어 주변 장치


VENC
----

필수 속성 :
- 호환 : "ti, omap4-venc"
- reg : 레지스터 공간의 주소와 길이
- 티, hwmods : "dss_venc"
- vdda-supply : DAC 용 전원 공급 장치
- 시계 : fclk 핸들
- 시계 이름 : "fck"

선택적 노드 :
- VENC 출력을위한 비디오 포트

VENC 엔드 포인트 필수 속성 :
- ti, invert-polarity : 비디오 신호의 극성을 반전시킵니다.
- 티, 채널 : 합성물 1, s- 비디오 2


DSI
---

필수 속성 :
- 호환 : "ti, omap4-dsi"
- reg : 'proto', 'phy'및 'pll'에 대한 레지스터 공간의 주소와 길이
- reg-names : "proto", "phy", "pll"
- 인터럽트 : DSI 인터럽트 라인
- ti, hwmods : "dss_dsi1"또는 "dss_dsi2"
- vdd-supply : DSI 용 전원 공급 장치
- clocks : fclk 및 pll 시계를 처리합니다.
- clock-names : "fck", "sys_clk"

선택적 노드 :
- DSI 출력을위한 비디오 포트
- DSI 제어 주변 장치

DSI 엔드 포인트 필수 특성 :
- 차선 : DSI 레인의 핀 번호 목록 : CLK +, CLK-, DATA0 +, DATA0-, DATA1 +, DATA1-, ...


HDMI
----

필수 속성 :
- 호환 : "ti, omap4-hdmi"
- reg : 'wp', 'pll', 'phy'에 대한 레지스터 공간의 주소와 길이
       '핵심'
- reg-names : "wp", "pll", "phy", "core"
- 인터럽트 : HDMI 인터럽트 라인
- 티, hwmods : "dss_hdmi"
- vdda 공급 : vdda 전원 공급 장치
- clocks : fclk 및 pll 시계를 처리합니다.
- clock-names : "fck", "sys_clk"

선택적 노드 :
- HDMI 출력용 비디오 포트

HDMI 엔드 포인트 옵션 속성 :
- 레인 : CLK +, CLK-, D0 +, D0-, D1 +, D1-, D2 +, D2-의 HDMI 레인에 대한 8 개의 핀 번호 목록. (기본값 : 0,1,2,3,4,5,6,7)

*/
```

## Doc/DeviceDriver/devicetree/bindings/display/ti/ti,opa362.txt
```
OPA362 analog video amplifier

Required properties:
- compatible: "ti,opa362"
- enable-gpios: enable/disable output gpio

Required node:
- Video port 0 for opa362 input
- Video port 1 for opa362 output

Example:

tv_amp: opa362 {
	compatible = "ti,opa362";
	enable-gpios = <&gpio1 23 0>;  /* GPIO to enable video out amplifier */

	ports {
		#address-cells = <1>;
		#size-cells = <0>;

		port@0 {
			reg = <0>;
			opa_in: endpoint@0 {
				remote-endpoint = <&venc_out>;
			};
		};

		port@1 {
			reg = <1>;
			opa_out: endpoint@0 {
				remote-endpoint = <&tv_connector_in>;
			};
		};
	};
};




/*
OPA362 酒朝肺弊 厚叼坷 刘气扁

鞘荐 加己 :
- 龋券 : "ti, opa362"
- enable-gpios : 免仿 gpio甫 劝己拳 / 厚劝己拳钦聪促.

鞘荐 畴靛 :
- opa362 涝仿阑困茄 厚叼坷 器飘 0
- opa362 免仿阑困茄 厚叼坷 器飘 1

Example:

tv_amp: opa362 {
	compatible = "ti,opa362";
	enable-gpios = <&gpio1 23 0>;  /* GPIO to enable video out amplifier */

	ports {
		#address-cells = <1>;
		#size-cells = <0>;

		port@0 {
			reg = <0>;
			opa_in: endpoint@0 {
				remote-endpoint = <&venc_out>;
			};
		};

		port@1 {
			reg = <1>;
			opa_out: endpoint@0 {
				remote-endpoint = <&tv_connector_in>;
			};
		};
	};
};





*/
```

## Doc/DeviceDriver/devicetree/bindings/display/ti/ti,tfp410.txt
```
TFP410 DPI to DVI encoder
=========================

Required properties:
- compatible: "ti,tfp410"

Optional properties:
- powerdown-gpios: power-down gpio

Required nodes:
- Video port 0 for DPI input
- Video port 1 for DVI output

Example
-------

tfp410: encoder@0 {
	compatible = "ti,tfp410";
	powerdown-gpios = <&twl_gpio 2 GPIO_ACTIVE_LOW>;

	ports {
		#address-cells = <1>;
		#size-cells = <0>;

		port@0 {
			reg = <0>;

			tfp410_in: endpoint@0 {
				remote-endpoint = <&dpi_out>;
			};
		};

		port@1 {
			reg = <1>;

			tfp410_out: endpoint@0 {
				remote-endpoint = <&dvi_connector_in>;
			};
		};
	};
};

/*
TFP410 DPI - DVI 浚内歹
=============

鞘荐 加己 :
- 龋券 : "ti, tfp410"

急琶利 加己 :
- powerdown-gpios : power-down gpio

鞘荐 畴靛 :
- DPI 涝仿阑困茄 厚叼坷 器飘 0
- DVI 免仿侩 厚叼坷 器飘 1

Example
-------

tfp410: encoder@0 {
	compatible = "ti,tfp410";
	powerdown-gpios = <&twl_gpio 2 GPIO_ACTIVE_LOW>;

	ports {
		#address-cells = <1>;
		#size-cells = <0>;

		port@0 {
			reg = <0>;

			tfp410_in: endpoint@0 {
				remote-endpoint = <&dpi_out>;
			};
		};

		port@1 {
			reg = <1>;

			tfp410_out: endpoint@0 {
				remote-endpoint = <&dvi_connector_in>;
			};
		};
	};
};

*/
```

## Doc/DeviceDriver/devicetree/bindings/display/tilcdc/panel.txt
```
Device-Tree bindings for tilcdc DRM generic panel output driver

Required properties:
 - compatible: value should be "ti,tilcdc,panel".
 - panel-info: configuration info to configure LCDC correctly for the panel
   - ac-bias: AC Bias Pin Frequency
   - ac-bias-intrpt: AC Bias Pin Transitions per Interrupt
   - dma-burst-sz: DMA burst size
   - bpp: Bits per pixel
   - fdd: FIFO DMA Request Delay
   - sync-edge: Horizontal and Vertical Sync Edge: 0=rising 1=falling
   - sync-ctrl: Horizontal and Vertical Sync: Control: 0=ignore
   - raster-order: Raster Data Order Select: 1=Most-to-least 0=Least-to-most
   - fifo-th: DMA FIFO threshold
 - display-timings: typical videomode of lcd panel.  Multiple video modes
   can be listed if the panel supports multiple timings, but the 'native-mode'
   should be the preferred/default resolution.  Refer to
   Documentation/devicetree/bindings/display/display-timing.txt for display
   timing binding details.

Optional properties:
- backlight: phandle of the backlight device attached to the panel
- enable-gpios: GPIO pin to enable or disable the panel

Recommended properties:
 - pinctrl-names, pinctrl-0: the pincontrol settings to configure
   muxing properly for pins that connect to TFP410 device

Example:

	/* Settings for CDTech_S035Q01 / LCD3 cape: */
	lcd3 {
		compatible = "ti,tilcdc,panel";
		pinctrl-names = "default";
		pinctrl-0 = <&bone_lcd3_cape_lcd_pins>;
		backlight = <&backlight>;
		enable-gpios = <&gpio3 19 0>;

		panel-info {
			ac-bias           = <255>;
			ac-bias-intrpt    = <0>;
			dma-burst-sz      = <16>;
			bpp               = <16>;
			fdd               = <0x80>;
			sync-edge         = <0>;
			sync-ctrl         = <1>;
			raster-order      = <0>;
			fifo-th           = <0>;
		};
		display-timings {
			native-mode = <&timing0>;
			timing0: 320x240 {
				hactive         = <320>;
				vactive         = <240>;
				hback-porch     = <21>;
				hfront-porch    = <58>;
				hsync-len       = <47>;
				vback-porch     = <11>;
				vfront-porch    = <23>;
				vsync-len       = <2>;
				clock-frequency = <8000000>;
				hsync-active    = <0>;
				vsync-active    = <0>;
			};
		};
	};

/*
Device-Tree bindings for tilcdc DRM generic panel output driver

필수 속성 :
 - 호환 가능 : 값은 "ti, tilcdc, panel"이어야합니다.
 - panel-info : 패널에 대해 LCDC를 올바르게 구성하는 구성 정보
 - ac 바이어스 : AC 바이어스 핀 주파수
 - ac-bias-intrpt : 인터럽트 당 AC 바이어스 핀 전환
 - dma-burst-sz : DMA 버스트 크기
 - bpp : 픽셀 당 비트
 - fdd : FIFO DMA 요청 지연
 - 동기 에지 : 수평 및 수직 동기 에지 : 0 = 상승 1 = 하강
 - sync-ctrl : 수평 및 수직 동기화 : 제어 : 0 = 무시
 - 래스터 순서 : 래스터 데이터 순서 선택 : 1 = 가장 - 최소 0 = 최소 - 최대
 - fifo-th : DMA FIFO 임계 값
 - 디스플레이 타이밍 : LCD 패널의 일반적인 비디오 모드. 패널이 여러 타이밍을 지원하는 경우 여러 비디오 모드를 나열 할 수 있지만 

'기본 모드'를 기본 / 기본 해상도로 사용해야합니다. 표시 타이밍 바인딩 세부 사항은 Documentation / devicetree / bindings / display / display-timing.txt를 참조하십시오.

선택적 속성 :
- 백라이트 : 패널에 부착 된 백라이트 장치의 phandle
- enable-gpios : 패널을 활성화 또는 비활성화하는 GPIO 핀

권장 속성 :
 - pinctrl-names, pinctrl-0 : 구성 할 핀 제어 설정
   TFP410 장치에 연결되는 핀에 대해 적절하게 멀티플렉싱

Example:

	/* Settings for CDTech_S035Q01 / LCD3 cape: */
	lcd3 {
		compatible = "ti,tilcdc,panel";
		pinctrl-names = "default";
		pinctrl-0 = <&bone_lcd3_cape_lcd_pins>;
		backlight = <&backlight>;
		enable-gpios = <&gpio3 19 0>;

		panel-info {
			ac-bias           = <255>;
			ac-bias-intrpt    = <0>;
			dma-burst-sz      = <16>;
			bpp               = <16>;
			fdd               = <0x80>;
			sync-edge         = <0>;
			sync-ctrl         = <1>;
			raster-order      = <0>;
			fifo-th           = <0>;
		};
		display-timings {
			native-mode = <&timing0>;
			timing0: 320x240 {
				hactive         = <320>;
				vactive         = <240>;
				hback-porch     = <21>;
				hfront-porch    = <58>;
				hsync-len       = <47>;
				vback-porch     = <11>;
				vfront-porch    = <23>;
				vsync-len       = <2>;
				clock-frequency = <8000000>;
				hsync-active    = <0>;
				vsync-active    = <0>;
			};
		};
	};

*/
```

## Doc/DeviceDriver/devicetree/bindings/display/tilcdc/tfp410.txt
```
Device-Tree bindings for tilcdc DRM TFP410 output driver

Required properties:
 - compatible: value should be "ti,tilcdc,tfp410".
 - i2c: the phandle for the i2c device to use for DDC

Recommended properties:
 - pinctrl-names, pinctrl-0: the pincontrol settings to configure
   muxing properly for pins that connect to TFP410 device
 - powerdn-gpio: the powerdown GPIO, pulled low to power down the
   TFP410 device (for DPMS_OFF)

Example:

	dvicape {
		compatible = "ti,tilcdc,tfp410";
		i2c = <&i2c2>;
		pinctrl-names = "default";
		pinctrl-0 = <&bone_dvi_cape_dvi_00A1_pins>;
		powerdn-gpio = <&gpio2 31 0>;
	};

/*
tilcdc DRM TFP410 출력 드라이버에 대한 Device 트리 바인딩

필수 속성 :
  - compatible : 값은 "ti, tilcdc, tfp410"이어야합니다.
  - i2c : DDC에 사용할 i2c Device의 phandle

권장 속성 :
  - pinctrl-names, pinctrl-0 : 구성 할 핀 제어 설정
    TFP410 Device에 연결되는 핀에 대해 적절하게 멀티플렉싱
  - powerdn-gpio : TFF410 디바이스의 전원을 끄기 위해 로우로 풀 된 파워 다운 GPIO (DPMS_OFF의 경우)


Example:

	dvicape {
		compatible = "ti,tilcdc,tfp410";
		i2c = <&i2c2>;
		pinctrl-names = "default";
		pinctrl-0 = <&bone_dvi_cape_dvi_00A1_pins>;
		powerdn-gpio = <&gpio2 31 0>;
	};

*/
```
