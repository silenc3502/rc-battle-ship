## Doc/DeviceDriver/devicetree/bindings/display/panel/display-timing.txt
```
display-timing bindings
=======================

display-timings node
--------------------

required properties:
 - none

optional properties:
 - native-mode: The native mode for the display, in case multiple modes are
		provided. When omitted, assume the first node is the native.

timing subnode
--------------

required properties:
 - hactive, vactive: display resolution
 - hfront-porch, hback-porch, hsync-len: horizontal display timing parameters
   in pixels
   vfront-porch, vback-porch, vsync-len: vertical display timing parameters in
   lines
 - clock-frequency: display clock in Hz

optional properties:
 - hsync-active: hsync pulse is active low/high/ignored
 - vsync-active: vsync pulse is active low/high/ignored
 - de-active: data-enable pulse is active low/high/ignored
 - pixelclk-active: with
			- active high = drive pixel data on rising edge/
					sample data on falling edge
			- active low  = drive pixel data on falling edge/
					sample data on rising edge
			- ignored     = ignored
 - interlaced (bool): boolean to enable interlaced mode
 - doublescan (bool): boolean to enable doublescan mode
 - doubleclk (bool): boolean to enable doubleclock mode

All the optional properties that are not bool follow the following logic:
    <1>: high active
    <0>: low active
    omitted: not used on hardware

There are different ways of describing the capabilities of a display. The
devicetree representation corresponds to the one commonly found in datasheets
for displays. If a display supports multiple signal timings, the native-mode
can be specified.

The parameters are defined as:

  +----------+-------------------------------------+----------+-------+
  |          |        ↑                            |          |       |
  |          |        |vback_porch                 |          |       |
  |          |        ↓                            |          |       |
  +----------#######################################----------+-------+
  |          #        ↑                            #          |       |
  |          #        |                            #          |       |
  |  hback   #        |                            #  hfront  | hsync |
  |   porch  #        |       hactive              #  porch   |  len  |
  |<-------->#<-------+--------------------------->#<-------->|<----->|
  |          #        |                            #          |       |
  |          #        |vactive                     #          |       |
  |          #        |                            #          |       |
  |          #        ↓                            #          |       |
  +----------#######################################----------+-------+
  |          |        ↑                            |          |       |
  |          |        |vfront_porch                |          |       |
  |          |        ↓                            |          |       |
  +----------+-------------------------------------+----------+-------+
  |          |        ↑                            |          |       |
  |          |        |vsync_len                   |          |       |
  |          |        ↓                            |          |       |
  +----------+-------------------------------------+----------+-------+

Example:

	display-timings {
		native-mode = <&timing0>;
		timing0: 1080p24 {
			/* 1920x1080p24 */
			clock-frequency = <52000000>;
			hactive = <1920>;
			vactive = <1080>;
			hfront-porch = <25>;
			hback-porch = <25>;
			hsync-len = <25>;
			vback-porch = <2>;
			vfront-porch = <2>;
			vsync-len = <2>;
			hsync-active = <1>;
		};
	};

Every required property also supports the use of ranges, so the commonly used
datasheet description with minimum, typical and maximum values can be used.

Example:

	timing1: timing {
		/* 1920x1080p24 */
		clock-frequency = <148500000>;
		hactive = <1920>;
		vactive = <1080>;
		hsync-len = <0 44 60>;
		hfront-porch = <80 88 95>;
		hback-porch = <100 148 160>;
		vfront-porch = <0 4 6>;
		vback-porch = <0 36 50>;
		vsync-len = <0 5 6>;
	};


/*
display-timing bindings

===========

표시 타이밍 노드
--------------------

필수 속성 :
 - 없음

선택적 속성 :
 - native-mode : 다중 모드가 제공되는 경우 디스플레이의 기본 모드. 생략되면 첫 x 째 노드가 기본 노드라고 가정합니다.

타이밍 서브 노드
--------------

필수 속성 :
 - hactive, vactive : 디스플레이 해상도
 - hfront-porch, hback-porch, hsync-len : 수평 표시 타이밍 매개 변수 (픽셀 단위)
   vfront-porch, vback-porch, vsync-len : 행의 수직 표시 타이밍 매개 변수
 - 클럭 주파수 : Hz 단위의 디스플레이 클럭

선택적 속성 :
 - hsync-active : hsync 펄스가 활성 낮음 / 높음 / 무시 됨
 - vsync-active : vsync 펄스가 활성 낮음 / 높음 / 무시 됨
 - 비활성 : 데이터 활성화 펄스가 활성 낮음 / 높음 / 무시 됨
 - pixelclk - 활성 : 함께
- 액티브 하이 = 상승 에지에서 픽셀 데이터 구동 /
하강 에지에서 샘플 데이터
- 액티브 로우 = 하강 에지에서 픽셀 데이터 구동 /
상승 에지에서 샘플 데이터
- 무시 됨 = 무시 됨
 - interlaced (bool) : 인터레이스 된 모드를 가능하게하는 boolean
 - doublescan (bool) : doubleScan 모드를 가능하게하는 boolean
 doubleclk (bool) : doubleclock 모드를 가능하게하는 boolean

bool이 아닌 모든 선택적 속성은 다음 logic를 따릅니다.
    <1> : 높은 활성
    <0> : 낮음 활성
    생략 : 하드웨어에 사용되지 않음

디스플레이의 기능을 설명하는 다양한 방법이 있습니다. devicetree 표현은 디스플레이 용 데이터 시트에서 흔히 볼 수있는 표현과 일치합니다. 

디스플레이가 다중 신호 타이밍을 지원하면 기본 모드를 지정할 수 있습니다.

매개 변수는 다음과 같이 정의됩니다.

  + ---------- + ------------------------------------- + ---------- + ------- +
  | | ↑ | | |
  | | | vback_porch | | |
  | | ↓ | | |
  + ---------- ###################### ---------- + ------- +
  | # ↑ # | |
  | # | # | |
  | hback # | # hfront | hsync |
  | 현관 # | hactive # porch | len |
  | <--------> # <------- + ---------------------------> # <--------> | <-----> |
  | # | # | |
  | # | vactive # | |
  | # | # | |
  | # ↓ # | |
  + ---------- ###################### ---------- + ------- +
  | | ↑ | | |
  | | | vfront_porch | | |
  | | ↓ | | |
  + ---------- + ------------------------------------- + ---------- + ------- +
  | | ↑ | | |
  | | | vsync_len | | |
  | | ↓ | | |
  + ---------- + ------------------------------------- + ---------- + ------- +

Example:

	display-timings {
		native-mode = <&timing0>;
		timing0: 1080p24 {
			/* 1920x1080p24 */
			clock-frequency = <52000000>;
			hactive = <1920>;
			vactive = <1080>;
			hfront-porch = <25>;
			hback-porch = <25>;
			hsync-len = <25>;
			vback-porch = <2>;
			vfront-porch = <2>;
			vsync-len = <2>;
			hsync-active = <1>;
		};
	};

모든 필수 속성은 범위 사용도 지원하므로 일반적으로 사용되는 최소, 일반 및 최대 값의 데이터 시트 설명을 사용할 수 있습니다.

Example:

	timing1: timing {
		/* 1920x1080p24 */
		clock-frequency = <148500000>;
		hactive = <1920>;
		vactive = <1080>;
		hsync-len = <0 44 60>;
		hfront-porch = <80 88 95>;
		hback-porch = <100 148 160>;
		vfront-porch = <0 4 6>;
		vback-porch = <0 36 50>;
		vsync-len = <0 5 6>;
	};

*/
```

## Doc/DeviceDriver/devicetree/bindings/display/panel/edt,et057090dhu.txt
```
Emerging Display Technology Corp. 5.7" VGA TFT LCD panel

Required properties:
- compatible: should be "edt,et057090dhu"

This binding is compatible with the simple-panel binding, which is specified
in simple-panel.txt in this directory.

/*
Emerging Display Technology Corp. 5.7" VGA TFT LCD panel


鞘荐 加己 :
- 龋券 : "edt, et057090dhu"咯具钦聪促.

捞 官牢爹篮捞 叼泛配府狼 simple-panel.txt俊 瘤沥等 窜鉴 菩澄 官牢爹苞 龋券邓聪促.
*/
```

## Doc/DeviceDriver/devicetree/bindings/display/panel/edt,et070080dh6.txt
```
Emerging Display Technology Corp. ET070080DH6 7.0" WVGA TFT LCD panel

Required properties:
- compatible: should be "edt,et070080dh6"

This panel is the same as ETM0700G0DH6 except for the touchscreen.
ET070080DH6 is the model with resistive touch.

This binding is compatible with the simple-panel binding, which is specified
in simple-panel.txt in this directory.

/*
Emerging Display Technology Corp. ET070080DH6 7.0 "WVGA TFT LCD 菩澄

鞘荐 加己 :
- 龋券 啊瓷 : "edt, et070080dh6"捞绢具钦聪促.

捞 菩澄篮 磐摹 胶农赴阑 力寇窍绊 ETM0700G0DH6苞 悼老钦聪促.
ET070080DH6篮 历亲己 磐摹啊乐绰 葛胆涝聪促.

捞 官牢爹篮捞 叼泛配府狼 simple-panel.txt俊 瘤沥等 窜鉴 菩澄 官牢爹苞 龋券邓聪促.
*/
```

## Doc/DeviceDriver/devicetree/bindings/display/panel/edt,etm0700g0dh6.txt
```
Emerging Display Technology Corp. ETM0700G0DH6 7.0" WVGA TFT LCD panel

Required properties:
- compatible: should be "edt,etm0700g0dh6"

This panel is the same as ET070080DH6 except for the touchscreen.
ETM0700G0DH6 is the model with capacitive multitouch.

This binding is compatible with the simple-panel binding, which is specified
in simple-panel.txt in this directory.

/*
Emerging Display Technology Corp. ETM0700G0DH6 7.0 "WVGA TFT LCD 菩澄

鞘荐 加己 :
- 龋券 啊瓷 : "edt, etm0700g0dh6"捞绢具钦聪促.

捞 菩澄篮 磐摹 胶农赴阑 力寇窍绊 ET070080DH6苞 悼老钦聪促.
ETM0700G0DH6篮 侩樊 己 钢萍 磐摹甫 荤侩窍绰 葛胆涝聪促.

捞 官牢爹篮捞 叼泛配府狼 simple-panel.txt俊 瘤沥等 窜鉴 菩澄 官牢爹苞 龋券邓聪促.
*/
```

## Doc/DeviceDriver/devicetree/bindings/display/panel/foxlink,fl500wvr00-a0t.txt
```
Foxlink Group 5" WVGA TFT LCD panel

Required properties:
- compatible: should be "foxlink,fl500wvr00-a0t"

This binding is compatible with the simple-panel binding, which is specified
in simple-panel.txt in this directory.

/*
Foxlink Group 5 "WVGA TFT LCD 菩澄

鞘荐 加己 :
- 龋券 啊瓷 : "foxlink, fl500wvr00-a0t"咯具钦聪促.

捞 官牢爹篮捞 叼泛配府狼 simple-panel.txt俊 瘤沥等 窜鉴 菩澄 官牢爹苞 龋券邓聪促.

*/
```

## Doc/DeviceDriver/devicetree/bindings/display/panel/giantplus,gpg482739qs5.txt
```
GiantPlus GPG48273QS5 4.3" (480x272) WQVGA TFT LCD panel

Required properties:
- compatible: should be "giantplus,gpg48273qs5"

This binding is compatible with the simple-panel binding, which is specified
in simple-panel.txt in this directory.

/*

244/5000
GiantPlus GPG48273QS5 4.3 "(480x272) WQVGA TFT LCD 菩澄

鞘荐 加己 :
- 龋券 啊瓷 : "giantplus, gpg48273qs5"捞绢具钦聪促.

捞 官牢爹篮捞 叼泛配府狼 simple-panel.txt俊 瘤沥等 窜鉴 菩澄 官牢爹苞 龋券邓聪促.
*/
```

## Doc/DeviceDriver/devicetree/bindings/display/panel/hannstar,hsd070pww1.txt
```
HannStar Display Corp. HSD070PWW1 7.0" WXGA TFT LCD panel

Required properties:
- compatible: should be "hannstar,hsd070pww1"

This binding is compatible with the simple-panel binding, which is specified
in simple-panel.txt in this directory.

/*
HannStar Display Corp. HSD070PWW1 7.0 "WXGA TFT LCD 菩澄

鞘荐 加己 :
- 龋券 啊瓷 : "hannstar, hsd070pww1"捞绢具钦聪促.

捞 官牢爹篮捞 叼泛配府狼 simple-panel.txt俊 瘤沥等 窜鉴 菩澄 官牢爹苞 龋券邓聪促.

*/
```

## Doc/DeviceDriver/devicetree/bindings/display/panel/hannstar,hsd100pxn1.txt
```
HannStar Display Corp. HSD100PXN1 10.1" XGA LVDS panel

Required properties:
- compatible: should be "hannstar,hsd100pxn1"

This binding is compatible with the simple-panel binding, which is specified
in simple-panel.txt in this directory.

/*
HannStar Display Corp. HSD100PXN1 10.1 "XGA LVDS 菩澄

鞘荐 加己 :
- 龋券 啊瓷 : "hannstar, hsd100pxn1"捞绢具钦聪促.

捞 官牢爹篮捞 叼泛配府狼 simple-panel.txt俊 瘤沥等 窜鉴 菩澄 官牢爹苞 龋券邓聪促.

*/
```

## Doc/DeviceDriver/devicetree/bindings/display/panel/hit,tx23d38vm0caa.txt
```
Hitachi Ltd. Corporation 9" WVGA (800x480) TFT LCD panel

Required properties:
- compatible: should be "hit,tx23d38vm0caa"

This binding is compatible with the simple-panel binding, which is specified
in simple-panel.txt in this directory.

/*
Hitachi Ltd. Corporation 9 "WVGA (800x480) TFT LCD 菩澄

鞘荐 加己 :
- 龋券 啊瓷 : "hit, tx23d38vm0caa"捞绢具钦聪促.

捞 官牢爹篮捞 叼泛配府狼 simple-panel.txt俊 瘤沥等 窜鉴 菩澄 官牢爹苞 龋券邓聪促.
*/
```

## Doc/DeviceDriver/devicetree/bindings/display/panel/innolux,g121i1-l01.txt
```
Innolux Corporation 12.1" WXGA (1280x800) TFT LCD panel

Required properties:
- compatible: should be "innolux,g121i1-l01"

This binding is compatible with the simple-panel binding, which is specified
in simple-panel.txt in this directory.

/*
Innolux Corporation 12.1 "WXGA (1280x800) TFT LCD 菩澄

鞘荐 加己 :
- 龋券 啊瓷 : "innolux, g121i1-l01"捞绢具钦聪促.

捞 官牢爹篮捞 叼泛配府狼 simple-panel.txt俊 瘤沥等 窜鉴 菩澄 官牢爹苞 龋券邓聪促.
*/
```

## Doc/DeviceDriver/devicetree/bindings/display/panel/innolux,n116bge.txt
```
Innolux Corporation 11.6" WXGA (1366x768) TFT LCD panel

Required properties:
- compatible: should be "innolux,n116bge"

This binding is compatible with the simple-panel binding, which is specified
in simple-panel.txt in this directory.

/*
Innolux Corporation 11.6 "WXGA (1366x768) TFT LCD 菩澄

鞘荐 加己 :
- 龋券 啊瓷 : "innolux, n116bge"咯具钦聪促.

捞 官牢爹篮捞 叼泛配府狼 simple-panel.txt俊 瘤沥等 窜鉴 菩澄 官牢爹苞 龋券邓聪促.
*/
```

## Doc/DeviceDriver/devicetree/bindings/display/panel/innolux,n156bge-l21.txt
```
InnoLux 15.6" WXGA TFT LCD panel

Required properties:
- compatible: should be "innolux,n156bge-l21"

This binding is compatible with the simple-panel binding, which is specified
in simple-panel.txt in this directory.

/*
InnoLux 15.6 "WXGA TFT LCD 菩澄

鞘荐 加己 :
- 龋券 啊瓷 : "innolux, n156bge-l21"捞绢具钦聪促.

捞 官牢爹篮捞 叼泛配府狼 simple-panel.txt俊 瘤沥等 窜鉴 菩澄 官牢爹苞 龋券邓聪促.
*/
```

## Doc/DeviceDriver/devicetree/bindings/display/panel/innolux,zj070na-01p.txt
```
Innolux Corporation 7.0" WSVGA (1024x600) TFT LCD panel

Required properties:
- compatible: should be "innolux,zj070na-01p"

This binding is compatible with the simple-panel binding, which is specified
in simple-panel.txt in this directory.

/*
Innolux Corporation 7.0 "WSVGA (1024x600) TFT LCD 菩澄

鞘荐 加己 :
- 龋券 啊瓷 : "innolux, zj070na-01p"咯具钦聪促.

捞 官牢爹篮捞 叼泛配府狼 simple-panel.txt俊 瘤沥等 窜鉴 菩澄 官牢爹苞 龋券邓聪促.
*/
```
