## Doc/DeviceDriver/devicetree/bindings/display/imx/fsl-imx-drm.txt
```
Freescale i.MX DRM master device
================================

The freescale i.MX DRM master device is a virtual device needed to list all
IPU or other display interface nodes that comprise the graphics subsystem.

Required properties:
- compatible: Should be "fsl,imx-display-subsystem"
- ports: Should contain a list of phandles pointing to display interface ports
  of IPU devices

example:

display-subsystem {
	compatible = "fsl,display-subsystem";
	ports = <&ipu_di0>;
};


Freescale i.MX IPUv3
====================

Required properties:
- compatible: Should be "fsl,<chip>-ipu"
- reg: should be register base and length as documented in the
  datasheet
- interrupts: Should contain sync interrupt and error interrupt,
  in this order.
- resets: phandle pointing to the system reset controller and
          reset line index, see reset/fsl,imx-src.txt for details
Optional properties:
- port@[0-3]: Port nodes with endpoint definitions as defined in
  Documentation/devicetree/bindings/media/video-interfaces.txt.
  Ports 0 and 1 should correspond to CSI0 and CSI1,
  ports 2 and 3 should correspond to DI0 and DI1, respectively.

example:

ipu: ipu@18000000 {
	#address-cells = <1>;
	#size-cells = <0>;
	compatible = "fsl,imx53-ipu";
	reg = <0x18000000 0x080000000>;
	interrupts = <11 10>;
	resets = <&src 2>;

	ipu_di0: port@2 {
		reg = <2>;

		ipu_di0_disp0: endpoint {
			remote-endpoint = <&display_in>;
		};
	};
};

Parallel display support
========================

Required properties:
- compatible: Should be "fsl,imx-parallel-display"
Optional properties:
- interface_pix_fmt: How this display is connected to the
  display interface. Currently supported types: "rgb24", "rgb565", "bgr666"
  and "lvds666".
- edid: verbatim EDID data block describing attached display.
- ddc: phandle describing the i2c bus handling the display data
  channel
- port@[0-1]: Port nodes with endpoint definitions as defined in
  Documentation/devicetree/bindings/media/video-interfaces.txt.
  Port 0 is the input port connected to the IPU display interface,
  port 1 is the output port connected to a panel.

example:

display@di0 {
	compatible = "fsl,imx-parallel-display";
	edid = [edid-data];
	interface-pix-fmt = "rgb24";

	port@0 {
		reg = <0>;

		display_in: endpoint {
			remote-endpoint = <&ipu_di0_disp0>;
		};
	};

	port@1 {
		reg = <1>;

		display_out: endpoint {
			remote-endpoint = <&panel_in>;
		};
	};
};

panel {
	...

	port {
		panel_in: endpoint {
			remote-endpoint = <&display_out>;
		};
	};
};



/*
橇府 胶纳老 i.MX DRM 付胶磐 叼官捞胶
==================

橇府 胶纳老 i.MX DRM 付胶磐 叼官捞胶绰 弊贰侨 辑宏 矫胶袍阑 备己窍绰 葛电 IPU 肚绰 扁鸥 叼胶敲饭捞 牢磐其捞胶 畴靛甫 唱凯窍绰 单 鞘夸茄 啊惑 叼官捞胶涝聪促.

鞘荐 加己 :
- compatible : "fsl, imx-display-subsystem"捞绢具钦聪促.
- 器飘 : IPU 厘摹狼 叼胶敲饭捞 牢磐其捞胶 器飘甫 啊府虐绰 phandles 格废阑 器窃秦具钦聪促.

example:

display-subsystem {
	compatible = "fsl,display-subsystem";
	ports = <&ipu_di0>;
};


橇府 胶纳老 i.MX IPUv3
================

鞘荐 加己 :
- 龋券 啊瓷 : "fsl, <chip> -ipu"咯具钦聪促.
- reg : 单捞磐 矫飘俊 巩辑拳 等措肺 饭瘤胶磐 扁夯 棺 辨捞 咯具钦聪促.
- 牢磐反飘 : 悼扁拳 牢磐反飘 棺 坷幅 牢磐反飘甫捞 鉴辑肺 器窃秦具钦聪促.
- reset : 矫胶袍 府悸 牧飘费矾甫 啊府虐绰 phandle苞 扼牢 牢郸胶 犁汲沥, 磊技茄 郴侩篮 reset / fsl, imx-src.txt甫 曼炼窍绞矫坷.
急琶利 加己 :
- port @ [0-3] : Documentation / devicetree / bindings / media / video-interfaces.txt俊 沥狼 等 浚靛器牢飘 沥狼啊乐绰 器飘 畴靛.
器飘 0苞 1篮 CSI0苞 CSI1俊 措览秦具窍哥,
器飘 2 棺 3篮 阿阿 DI0 棺 DI1俊 秦寸秦具钦聪促.

example:

ipu: ipu@18000000 {
	#address-cells = <1>;
	#size-cells = <0>;
	compatible = "fsl,imx53-ipu";
	reg = <0x18000000 0x080000000>;
	interrupts = <11 10>;
	resets = <&src 2>;

	ipu_di0: port@2 {
		reg = <2>;

		ipu_di0_disp0: endpoint {
			remote-endpoint = <&display_in>;
		};
	};
};

捍纺 叼胶敲饭捞 瘤盔
============

鞘荐 加己 :
- 龋券 : "fsl, imx-parallel-display"咯具钦聪促.
急琶利 加己 :
- interface_pix_fmt :捞 叼胶敲饭捞啊 叼胶敲饭捞 牢磐其捞胶俊 楷搬登绰 规过. 泅犁 瘤盔登绰 蜡屈 : "rgb24", "rgb565", "bgr666"棺 "lvds666".
- edid : 楷搬等 叼胶敲饭捞甫 汲疙窍绰 绵距 EDID 单捞磐 喉废.
- ddc : 叼胶敲饭捞 单捞磐 盲澄阑 贸府窍绰 i2c 滚胶甫 汲疙窍绰 phandle
- port @ [0-1] : Documentation / devicetree / bindings / media / video-interfaces.txt俊 沥狼 等 浚靛器牢飘 沥狼啊乐绰 器飘 畴靛.
器飘 0篮 IPU 叼胶敲饭捞 牢磐其捞胶俊 楷搬等 涝仿 器飘捞哥,
器飘 1篮 菩澄俊 楷搬等 免仿 器飘涝聪促.

example:

display@di0 {
	compatible = "fsl,imx-parallel-display";
	edid = [edid-data];
	interface-pix-fmt = "rgb24";

	port@0 {
		reg = <0>;

		display_in: endpoint {
			remote-endpoint = <&ipu_di0_disp0>;
		};
	};

	port@1 {
		reg = <1>;

		display_out: endpoint {
			remote-endpoint = <&panel_in>;
		};
	};
};

panel {
	...

	port {
		panel_in: endpoint {
			remote-endpoint = <&display_out>;
		};
	};
};


*/
```

## Doc/DeviceDriver/devicetree/bindings/display/imx/hdmi.txt
```
Device-Tree bindings for HDMI Transmitter

HDMI Transmitter
================

The HDMI Transmitter is a Synopsys DesignWare HDMI 1.4 TX controller IP
with accompanying PHY IP.

Required properties:
 - #address-cells : should be <1>
 - #size-cells : should be <0>
 - compatible : should be "fsl,imx6q-hdmi" or "fsl,imx6dl-hdmi".
 - gpr : should be <&gpr>.
   The phandle points to the iomuxc-gpr region containing the HDMI
   multiplexer control register.
 - clocks, clock-names : phandles to the HDMI iahb and isrf clocks, as described
   in Documentation/devicetree/bindings/clock/clock-bindings.txt and
   Documentation/devicetree/bindings/clock/imx6q-clock.txt.
 - port@[0-4]: Up to four port nodes with endpoint definitions as defined in
   Documentation/devicetree/bindings/media/video-interfaces.txt,
   corresponding to the four inputs to the HDMI multiplexer.

Optional properties:
 - ddc-i2c-bus: phandle of an I2C controller used for DDC EDID probing

example:

	gpr: iomuxc-gpr@020e0000 {
		/* ... */
	};

        hdmi: hdmi@0120000 {
                #address-cells = <1>;
                #size-cells = <0>;
                compatible = "fsl,imx6q-hdmi";
                reg = <0x00120000 0x9000>;
                interrupts = <0 115 0x04>;
                gpr = <&gpr>;
                clocks = <&clks 123>, <&clks 124>;
                clock-names = "iahb", "isfr";
                ddc-i2c-bus = <&i2c2>;

                port@0 {
                        reg = <0>;

                        hdmi_mux_0: endpoint {
                                remote-endpoint = <&ipu1_di0_hdmi>;
                        };
                };

                port@1 {
                        reg = <1>;

                        hdmi_mux_1: endpoint {
                                remote-endpoint = <&ipu1_di1_hdmi>;
                        };
                };
        };


/*
HDMI 价脚扁俊 措茄 厘摹 飘府 官牢爹

HDMI 价脚扁
==============

HDMI 价脚扁绰 PHY IP啊 器窃 等 Synopsys DesignWare HDMI 1.4 TX 牧飘费矾 IP涝聪促.

鞘荐 加己 :
- # address-cells : <1>捞绢具钦聪促.

- # size-cells : <0>捞绢具钦聪促.

- compatible : "fsl, imx6q-hdmi"肚绰 "fsl, imx6dl-hdmi"咯具钦聪促.

- gpr : <& gpr>捞绢具钦聪促.

Phandle篮 HDMI 钢萍敲泛辑 力绢 饭瘤胶磐啊 器窃 等 iomuxc-gpr 康开阑 啊府 诺聪促.

- clocks, clock-names : Documentation / devicetree / bindings / clock / clock-bindings.txt 棺 Documentation / 
devicetree / bindings / clock / imx6q-clock.txt俊 汲疙 等措肺 HDMI iahb 棺 isrf 努钒俊 楷搬钦聪促.

 - port @ [0-4] : HDMI 钢萍敲泛辑俊 措茄 匙 俺狼 涝仿俊 秦寸窍绰 Documentation / devicetree / bindings / media / video-interfaces.txt俊 沥狼 等 浚靛器牢飘 沥狼啊乐绰 弥措 匙 俺狼 器飘 畴靛.

急琶利 加己 :
- ddc-i2c-bus : DDC EDID 橇肺葫俊 荤侩登绰 I2C 牧飘费矾狼 phandle


example:

	gpr: iomuxc-gpr@020e0000 {
		/* ... */
	};

        hdmi: hdmi@0120000 {
                #address-cells = <1>;
                #size-cells = <0>;
                compatible = "fsl,imx6q-hdmi";
                reg = <0x00120000 0x9000>;
                interrupts = <0 115 0x04>;
                gpr = <&gpr>;
                clocks = <&clks 123>, <&clks 124>;
                clock-names = "iahb", "isfr";
                ddc-i2c-bus = <&i2c2>;

                port@0 {
                        reg = <0>;

                        hdmi_mux_0: endpoint {
                                remote-endpoint = <&ipu1_di0_hdmi>;
                        };
                };

                port@1 {
                        reg = <1>;

                        hdmi_mux_1: endpoint {
                                remote-endpoint = <&ipu1_di1_hdmi>;
                        };
                };
        };

*/
```
