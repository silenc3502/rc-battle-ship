## Doc/DeviceDriver/devicetree/bindings/display/imx/ldb.txt
```
Device-Tree bindings for LVDS Display Bridge (ldb)

LVDS Display Bridge
===================

The LVDS Display Bridge device tree node contains up to two lvds-channel
nodes describing each of the two LVDS encoder channels of the bridge.

Required properties:
 - #address-cells : should be <1>
 - #size-cells : should be <0>
 - compatible : should be "fsl,imx53-ldb" or "fsl,imx6q-ldb".
                Both LDB versions are similar, but i.MX6 has an additional
                multiplexer in the front to select any of the four IPU display
                interfaces as input for each LVDS channel.
 - gpr : should be <&gpr> on i.MX53 and i.MX6q.
         The phandle points to the iomuxc-gpr region containing the LVDS
         control register.
- clocks, clock-names : phandles to the LDB divider and selector clocks and to
                        the display interface selector clocks, as described in
                        Documentation/devicetree/bindings/clock/clock-bindings.txt
        The following clocks are expected on i.MX53:
                "di0_pll" - LDB LVDS channel 0 mux
                "di1_pll" - LDB LVDS channel 1 mux
                "di0" - LDB LVDS channel 0 gate
                "di1" - LDB LVDS channel 1 gate
                "di0_sel" - IPU1 DI0 mux
                "di1_sel" - IPU1 DI1 mux
        On i.MX6q the following additional clocks are needed:
                "di2_sel" - IPU2 DI0 mux
                "di3_sel" - IPU2 DI1 mux
        The needed clock numbers for each are documented in
        Documentation/devicetree/bindings/clock/imx5-clock.txt, and in
        Documentation/devicetree/bindings/clock/imx6q-clock.txt.

Optional properties:
 - pinctrl-names : should be "default" on i.MX53, not used on i.MX6q
 - pinctrl-0 : a phandle pointing to LVDS pin settings on i.MX53,
               not used on i.MX6q
 - fsl,dual-channel : boolean. if it exists, only LVDS channel 0 should
   be configured - one input will be distributed on both outputs in dual
   channel mode

LVDS Channel
============

Each LVDS Channel has to contain either an of graph link to a panel device node
or a display-timings node that describes the video timings for the connected
LVDS display as well as the fsl,data-mapping and fsl,data-width properties.

Required properties:
 - reg : should be <0> or <1>
 - port: Input and output port nodes with endpoint definitions as defined in
   Documentation/devicetree/bindings/graph.txt.
   On i.MX5, the internal two-input-multiplexer is used. Due to hardware
   limitations, only one input port (port@[0,1]) can be used for each channel
   (lvds-channel@[0,1], respectively).
   On i.MX6, there should be four input ports (port@[0-3]) that correspond
   to the four LVDS multiplexer inputs.
   A single output port (port@2 on i.MX5, port@4 on i.MX6) must be connected
   to a panel input port. Optionally, the output port can be left out if
   display-timings are used instead.

Optional properties (required if display-timings are used):
 - display-timings : A node that describes the display timings as defined in
   Documentation/devicetree/bindings/display/display-timing.txt.
 - fsl,data-mapping : should be "spwg" or "jeida"
                      This describes how the color bits are laid out in the
                      serialized LVDS signal.
 - fsl,data-width : should be <18> or <24>

example:

gpr: iomuxc-gpr@53fa8000 {
	/* ... */
};

ldb: ldb@53fa8008 {
	#address-cells = <1>;
	#size-cells = <0>;
	compatible = "fsl,imx53-ldb";
	gpr = <&gpr>;
	clocks = <&clks IMX5_CLK_LDB_DI0_SEL>,
		 <&clks IMX5_CLK_LDB_DI1_SEL>,
		 <&clks IMX5_CLK_IPU_DI0_SEL>,
		 <&clks IMX5_CLK_IPU_DI1_SEL>,
		 <&clks IMX5_CLK_LDB_DI0_GATE>,
		 <&clks IMX5_CLK_LDB_DI1_GATE>;
	clock-names = "di0_pll", "di1_pll",
		      "di0_sel", "di1_sel",
		      "di0", "di1";

	/* Using an of-graph endpoint link to connect the panel */
	lvds-channel@0 {
		#address-cells = <1>;
		#size-cells = <0>;
		reg = <0>;

		port@0 {
			reg = <0>;

			lvds0_in: endpoint {
				remote-endpoint = <&ipu_di0_lvds0>;
			};
		};

		port@2 {
			reg = <2>;

			lvds0_out: endpoint {
				remote-endpoint = <&panel_in>;
			};
		};
	};

	/* Using display-timings and fsl,data-mapping/width instead */
	lvds-channel@1 {
		#address-cells = <1>;
		#size-cells = <0>;
		reg = <1>;
		fsl,data-mapping = "spwg";
		fsl,data-width = <24>;

		display-timings {
			/* ... */
		};

		port@1 {
			reg = <1>;

			lvds1_in: endpoint {
				remote-endpoint = <&ipu_di1_lvds1>;
			};
		};
	};
};

panel: lvds-panel {
	/* ... */

	port {
		panel_in: endpoint {
			remote-endpoint = <&lvds0_out>;
		};
	};
};


/*

LVDS 叼胶敲饭捞 宏府瘤 (ldb)俊 措茄 厘摹 飘府 官牢爹

LVDS 叼胶敲饭捞 宏府瘤
===========

LVDS 叼胶敲饭捞 宏府瘤 厘摹 飘府 畴靛俊绰 宏府瘤狼 滴 LVDS 牢内歹 盲澄阑 阿阿 汲疙窍绰 弥措 滴 俺狼 LVD 盲澄 畴靛啊 乐嚼聪促.

鞘荐 加己 :
- # address-cells : <1>捞绢具钦聪促.
- # size-cells : <0>捞绢具钦聪促.
- compatible : "fsl, imx53-ldb"肚绰 "fsl, imx6q-ldb"咯具钦聪促.
滴 LDB 滚傈篮 厚搅窍瘤父, i.MX6篮 4 俺狼 IPU 叼胶敲饭捞 牢磐其捞胶 吝 窍唱甫 阿 LVDS 盲澄狼 涝仿栏肺 急琶窍扁 困秦 傈搁俊 钢萍敲泛辑啊 眠啊肺 乐嚼聪促.
- gpr : i.MX53 棺 i.MX6q俊辑 <& gpr>捞绢具钦聪促.
捞 phandle篮 LVDS 力绢 饭瘤胶磐甫 器窃窍绰 iomuxc-gpr 康开阑 啊府 诺聪促.
- clocks, clock-names : Documentation / devicetree / bindings / clock / clock-bindings.txt俊 汲疙 等措肺 LDB 盒硅扁 棺 急琶扁 努废 棺 叼胶敲饭捞 牢磐其捞胶 急琶扁 努钒俊 措茄 瘤魔
i.MX53俊绰 促澜苞 鞍篮 努钒捞 鞘夸钦聪促.
"di0_pll"- LDB LVDS 盲澄 0 钢萍 敲泛胶
"di1_pll"- LDB LVDS 盲澄 1 钢萍 敲泛胶
"di0"- LDB LVDS 盲澄 0 霸捞飘
"di1"- LDB LVDS 盲澄 1 霸捞飘
"di0_sel"- IPU1 DI0 mux
"di1_sel"- IPU1 DI1 mux
i.MX6q俊绰 促澜苞 鞍篮 眠啊 努钒捞 鞘夸钦聪促.
"di2_sel"- IPU2 DI0 钢萍敲泛辑
"di3_sel"- IPU2 DI1 mux
阿阿狼 鞘夸茄 努钒 锅龋绰 Documentation / devicetree / bindings / clock / imx5-clock.txt客 Documentation / devicetree / bindings / clock / imx6q-clock.txt俊 巩辑拳登绢 乐嚼聪促.

急琶利 加己 :
- pinctrl-names : i.MX53俊辑绰 "default"捞绊 i.MX6q俊辑绰 荤侩登瘤 臼嚼聪促.
- pinctrl-0 : i.MX53狼 LVDS 巧 汲沥阑 啊府虐绰 phandle, i.MX6q俊辑绰 荤侩登瘤 臼澜
- fsl, 捞吝 盲澄 : boolean捞 父距 粮犁茄促搁, LVDS 盲澄 0父捞 备己登绢具钦聪促 - 窍唱狼 涝仿篮 掂倔 盲澄 葛靛俊辑 滴 免仿俊 盒硅 瞪 巴涝聪促

LVDS 盲澄
============

阿 LVDS 盲澄俊绰 菩澄 厘摹 畴靛俊 措茄 弊贰橇 傅农 肚绰 楷搬等 LVDS 叼胶敲饭捞 棺 fsl, data-mapping 棺 fsl, data-width 加己俊 措茄 厚叼坷 鸥捞怪阑 汲疙窍绰 叼胶敲饭捞 鸥捞怪 畴靛 吝 窍唱啊 乐绢具钦聪促.

鞘荐 加己 :
- reg : <0> 肚绰 <1>捞绢具钦聪促.
- port : Documentation / devicetree / bindings / graph.txt俊 沥狼 等 浚靛 器牢飘 沥狼啊乐绰 涝仿 棺 免仿 器飘 畴靛.
i.MX5俊辑绰 郴何 2 涝仿 钢萍敲泛辑啊 荤侩邓聪促. 窍靛傀绢 力茄 荤亲栏肺 牢秦 窍唱狼 涝仿 器飘 (器飘 @ [0,1]) 父 阿 盲澄俊 荤侩且 荐 乐嚼聪促 (阿阿 lvds-channel @ [0,1]).
i.MX6俊绰 4 俺狼 LVDS 钢萍敲泛辑 涝仿俊 秦寸窍绰 4 俺狼 涝仿 器飘 (器飘 @ [0-3])啊 乐绢具钦聪促.
窜老 免仿 器飘 (i.MX5狼 器飘 @ 2, i.MX6狼 器飘 @ 4)绰 菩澄 涝仿 器飘俊 楷搬秦具钦聪促. 急琶利栏肺 叼胶敲饭捞 鸥捞怪捞 措脚 荤侩登搁 免仿 器飘甫 积帆 且 荐 乐嚼聪促.

急琶利 加己 (钎矫 鸥捞怪阑 荤侩且 版快 鞘夸) :
- display-timings : Documentation / devicetree / bindings / display / display-timing.txt俊 沥狼 等措肺 钎矫 鸥捞怪阑 汲疙窍绰 畴靛涝聪促.
- fsl, data-mapping : "spwg"肚绰 "jeida"咯具钦聪促.
流纺拳 等 LVDS 脚龋俊 祸惑 厚飘啊 硅摹登绰 规过阑 汲疙钦聪促.
- fsl, data-width :绰 <18> 肚绰 <24> 咯具钦聪促.


example:

gpr: iomuxc-gpr@53fa8000 {
	/* ... */
};

ldb: ldb@53fa8008 {
	#address-cells = <1>;
	#size-cells = <0>;
	compatible = "fsl,imx53-ldb";
	gpr = <&gpr>;
	clocks = <&clks IMX5_CLK_LDB_DI0_SEL>,
		 <&clks IMX5_CLK_LDB_DI1_SEL>,
		 <&clks IMX5_CLK_IPU_DI0_SEL>,
		 <&clks IMX5_CLK_IPU_DI1_SEL>,
		 <&clks IMX5_CLK_LDB_DI0_GATE>,
		 <&clks IMX5_CLK_LDB_DI1_GATE>;
	clock-names = "di0_pll", "di1_pll",
		      "di0_sel", "di1_sel",
		      "di0", "di1";

	/ * 弊贰橇 浚靛 器牢飘 傅农甫 荤侩窍咯 菩澄 楷搬 * /
	lvds-channel@0 {
		#address-cells = <1>;
		#size-cells = <0>;
		reg = <0>;

		port@0 {
			reg = <0>;

			lvds0_in: endpoint {
				remote-endpoint = <&ipu_di0_lvds0>;
			};
		};

		port@2 {
			reg = <2>;

			lvds0_out: endpoint {
				remote-endpoint = <&panel_in>;
			};
		};
	};

	/ * 措脚俊 叼胶敲饭捞 鸥捞怪苞 fsl, 单捞磐 概俏 / 呈厚 荤侩 * /
	lvds-channel@1 {
		#address-cells = <1>;
		#size-cells = <0>;
		reg = <1>;
		fsl,data-mapping = "spwg";
		fsl,data-width = <24>;

		display-timings {
			/* ... */
		};

		port@1 {
			reg = <1>;

			lvds1_in: endpoint {
				remote-endpoint = <&ipu_di1_lvds1>;
			};
		};
	};
};

panel: lvds-panel {
	/* ... */

	port {
		panel_in: endpoint {
			remote-endpoint = <&lvds0_out>;
		};
	};
};

*/
```

## Doc/DeviceDriver/devicetree/bindings/display/marvell,pxa2xx-lcdc.txt
```
PXA LCD Controller
------------------

Required properties:
 - compatible : one of these
	"marvell,pxa2xx-lcdc",
	"marvell,pxa270-lcdc",
	"marvell,pxa300-lcdc"
 - reg : should contain 1 register range (address and length).
 - interrupts : framebuffer controller interrupt.
 - clocks: phandle to input clocks

Required nodes:
 - port: connection to the LCD panel (see video-interfaces.txt)
	 This node must have its properties bus-width and remote-endpoint set.
	 If the panel is not a TFT color panel, then a "lcd-type" property in
	 the panel should specify the panel type.
	 This panel node should be in the board dts.

Example:
	lcd-controller@40500000 {
		compatible = "marvell,pxa2xx-lcdc";
		reg = <0x44000000 0x10000>;
		interrupts = <17>;
		clocks = <&clks CLK_LCD>;
		status = "okay";

		port {
			lcdc_out: endpoint {
				remote-endpoint = <&panel_in>;
				bus-width = <16>;
			};
		};
	};

/*
PXA LCD 컨트롤러
------------------

필수 속성 :
  - 호환 가능 :이 중 하나
"marvell, pxa2xx-lcdc",
"marvell, pxa270-lcdc",
"marvell, pxa300-lcdc"
  - reg : 1 개의 레지스터 범위 (주소와 길이)를 포함해야합니다.
  - 인터럽트 : 프레임 버퍼 컨트롤러 인터럽트.
  - clocks : 입력 클럭을위한 phandle

필수 노드 :
  - 포트 : LCD 패널에 연결 (video-interfaces.txt 참조)
이 노드는 속성 bus-width 및 remote-endpoint를 설정해야합니다.
패널이 TFT 컬러 패널이 아닌 경우 패널의 "lcd 유형"특성이 패널 유형을 지정해야합니다.
이 패널 노드는 보드 dts에 있어야합니다.

Example:
	lcd-controller@40500000 {
		compatible = "marvell,pxa2xx-lcdc";
		reg = <0x44000000 0x10000>;
		interrupts = <17>;
		clocks = <&clks CLK_LCD>;
		status = "okay";

		port {
			lcdc_out: endpoint {
				remote-endpoint = <&panel_in>;
				bus-width = <16>;
			};
		};
	};

*/
```

## Doc/DeviceDriver/devicetree/bindings/display/mipi-dsi-bus.txt
```
MIPI DSI (Display Serial Interface) busses
==========================================

The MIPI Display Serial Interface specifies a serial bus and a protocol for
communication between a host and up to four peripherals. This document will
define the syntax used to represent a DSI bus in a device tree.

This document describes DSI bus-specific properties only or defines existing
standard properties in the context of the DSI bus.

Each DSI host provides a DSI bus. The DSI host controller's node contains a
set of properties that characterize the bus. Child nodes describe individual
peripherals on that bus.

The following assumes that only a single peripheral is connected to a DSI
host. Experience shows that this is true for the large majority of setups.

DSI host
--------

In addition to the standard properties and those defined by the parent bus of
a DSI host, the following properties apply to a node representing a DSI host.

Required properties:
- #address-cells: The number of cells required to represent an address on the
  bus. DSI peripherals are addressed using a 2-bit virtual channel number, so
  a maximum of 4 devices can be addressed on a single bus. Hence the value of
  this property should be 1.
- #size-cells: Should be 0. There are cases where it makes sense to use a
  different value here. See below.

DSI peripheral
--------------

Peripherals are represented as child nodes of the DSI host's node. Properties
described here apply to all DSI peripherals, but individual bindings may want
to define additional, device-specific properties.

Required properties:
- reg: The virtual channel number of a DSI peripheral. Must be in the range
  from 0 to 3.

Some DSI peripherals respond to more than a single virtual channel. In that
case two alternative representations can be chosen:
- The reg property can take multiple entries, one for each virtual channel
  that the peripheral responds to.
- If the virtual channels that a peripheral responds to are consecutive, the
  #size-cells can be set to 1. The first cell of each entry in the reg
  property is the number of the first virtual channel and the second cell is
  the number of consecutive virtual channels.

Example
-------

	dsi-host {
		...

		#address-cells = <1>;
		#size-cells = <0>;

		/* peripheral responds to virtual channel 0 */
		peripheral@0 {
			compatible = "...";
			reg = <0>;
		};

		...
	};

	dsi-host {
		...

		#address-cells = <1>;
		#size-cells = <0>;

		/* peripheral responds to virtual channels 0 and 2 */
		peripheral@0 {
			compatible = "...";
			reg = <0, 2>;
		};

		...
	};

	dsi-host {
		...

		#address-cells = <1>;
		#size-cells = <1>;

		/* peripheral responds to virtual channels 1, 2 and 3 */
		peripheral@1 {
			compatible = "...";
			reg = <1 3>;
		};

		...
	};

/*
MIPI DSI (디스플레이 직렬 인터페이스) 버스
============================

MIPI 디스플레이 직렬 인터페이스는 호스트와 최대 4 개의 주변 장치 간의 통신을위한 직렬 버스 및 프로토콜을 지정합니다. 

이 문서는 장치 트리에서 DSI 버스를 나타내는 데 사용되는 구문을 정의합니다.

이 문서에서는 DSI 버스 관련 등록 정보 만 설명하거나 DSI 버스 컨텍스트에서 기존 표준 등록 정보를 정의합니다.

각 DSI 호스트는 DSI 버스를 제공합니다. DSI 호스트 컨트롤러의 노드에는 버스를 특징 짓는 속성 집합이 포함되어 있습니다. 

하위 노드는 해당 버스의 개별 주변 장치를 설명합니다.

다음은 단일 주변 장치 만 DSI 호스트에 연결되어 있다고 가정합니다. 경험에 따르면 이는 대다수의 설정에서 마찬가지입니다.

DSI 호스트
--------

표준 등록 정보와 DSI 호스트의 상위 버스에 의해 정의 된 등록 정보 외에도 다음 등록 정보가 DSI 호스트를 나타내는 노드에 적용됩니다.

필수 속성 :
- # address-cells : 버스의 주소를 나타내는데 필요한 셀의 수. DSI 주변 장치는 2 비트 가상 채널 번호를 사용하여 주소 지정되므로 단일 버스에서 최대 4 개의 장치를 지정할 수 있습니다.

 따라서 이 속성은 1이어야합니다.

- # size-cells : 0이어야합니다. 여기서 다른 값을 사용하는 것이 타당한 경우가 있습니다. 아래를 참조하십시오.

DSI 주변 장치
--------------

주변 장치는 DSI 호스트 노드의 자식 노드로 표시됩니다. 여기에 설명 된 등록 정보는 모든 DSI 주변 장치에 적용되지만 개별 바인딩은 장치 별 추가 등록 정보를 정의하고자 할 수 있습니다.

필수 속성 :
- reg : DSI 주변 장치의 가상 채널 번호입니다. 0에서 3까지의 범위 내에 있어야합니다.

일부 DSI 주변 장치는 단일 가상 채널 이상에 응답합니다. 이 경우 두 가지 대체 표현을 선택할 수 있습니다.

- reg 등록 정보는 주변 장치가 응답하는 각 가상 채널마다 하나씩 여러 항목을 사용할 수 있습니다.

- 주변 장치가 응답하는 가상 채널이 연속적이면 # 크기 셀을 1로 설정할 수 있습니다. 

reg 등록 정보의 각 항목의 첫 번째 셀은 첫 번째 가상 채널 번호이고 두 번째 셀 번호는 연속 가상 채널.

Example
-------

	dsi-host {
		...

		#address-cells = <1>;
		#size-cells = <0>;

		/* peripheral responds to virtual channel 0 */
		peripheral@0 {
			compatible = "...";
			reg = <0>;
		};

		...
	};

	dsi-host {
		...

		#address-cells = <1>;
		#size-cells = <0>;

		/* peripheral responds to virtual channels 0 and 2 */
		peripheral@0 {
			compatible = "...";
			reg = <0, 2>;
		};

		...
	};

	dsi-host {
		...

		#address-cells = <1>;
		#size-cells = <1>;

		/* peripheral responds to virtual channels 1, 2 and 3 */
		peripheral@1 {
			compatible = "...";
			reg = <1 3>;
		};

		...
	};


*/
```
