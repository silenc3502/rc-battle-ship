## Doc/DeviceDriver/devicetree/bindings/board/fsl-board.txt
```
Freescale Reference Board Bindings

This document describes device tree bindings for various devices that
exist on some Freescale reference boards.

* Board Control and Status (BCSR)

Required properties:

 - compatible : Should be "fsl,<board>-bcsr"
 - reg : Offset and length of the register set for the device

프리 스케일 레퍼런스 보드 바인딩

이 문서는 일부 Freescale 레퍼런스 보드에 존재하는 다양한 디바이스를위한 디바이스 트리 바인딩을 설명합니다.

* 보드 제어 및 상태 (BCSR)

필수 속성 :

  - 호환 가능 : "fsl, <board> -bcsr"이어야합니다.
  - reg : 장치에 설정된 레지스터 오프셋 및 길이



Example:

	bcsr@f8000000 {
		compatible = "fsl,mpc8360mds-bcsr";
		reg = <f8000000 8000>;
	};

* Freescale on-board FPGA

This is the memory-mapped registers for on board FPGA.

Required properties:
- compatible: should be a board-specific string followed by a string
  indicating the type of FPGA.  Example:
	"fsl,<board>-fpga", "fsl,fpga-pixis", or
	"fsl,<board>-fpga", "fsl,fpga-qixis"
- reg: should contain the address and the length of the FPGA register set.

Optional properties:
- interrupt-parent: should specify phandle for the interrupt controller.
- interrupts: should specify event (wakeup) IRQ.
프리 스케일 온보드 FPGA

이것은 보드상의 FPGA를위한 메모리 매핑 레지스터이다.

필수 속성 :
- 호환 : FPGA의 유형을 나타내는 문자열이 뒤에 오는 보드 특정 문자열이어야합니다. 예:
"fsl, <board> -fpga", "fsl, fpga-pixis"또는
"fsl, <board> -fpga", "fsl, fpga-qixis"
- reg : FPGA 레지스터 세트의 주소와 길이를 포함해야합니다.

선택적 속성 :
- interrupt-parent : 인터럽트 컨트롤러에 대해 phandle을 지정해야합니다.
- 인터럽트 : 이벤트 (wakeup) IRQ를 지정해야합니다.

Example (P1022DS):

	 board-control@3,0 {
		 compatible = "fsl,p1022ds-fpga", "fsl,fpga-ngpixis";
		 reg = <3 0 0x30>;
		 interrupt-parent = <&mpic>;
		 interrupts = <8 8 0 0>;
	 };

Example (LS2080A-RDB):

        cpld@3,0 {
                compatible = "fsl,ls2080ardb-fpga", "fsl,fpga-qixis";
                reg = <0x3 0 0x10000>;
        };

* Freescale BCSR GPIO banks

Some BCSR registers act as simple GPIO controllers, each such
register can be represented by the gpio-controller node.

Required properities:
- compatible : Should be "fsl,<board>-bcsr-gpio".
- reg : Should contain the address and the length of the GPIO bank
  register.
- #gpio-cells : Should be two. The first cell is the pin number and the
  second cell is used to specify optional parameters (currently unused).
- gpio-controller : Marks the port as GPIO controller.

* 프리 스케일 BCSR GPIO 뱅크

일부 BCSR 레지스터는 간단한 GPIO 컨트롤러의 역할을하며, 각 레지스터는 GPIO 컨트롤러 노드로 나타낼 수 있습니다.

필수 사항 :
- 호환 : "fsl, <board> -bcsr-gpio"여야합니다.
- reg : 주소와 GPIO 뱅크 레지스터의 길이를 포함해야합니다.
- # gpio-cells : 2 여야합니다. 첫 번째 셀은 핀 번호이며 두 번째 셀은 선택적 매개 변수 (현재 사용되지 않음)를 지정하는 데 사용됩니다.
- gpio-controller : 포트를 GPIO 컨트롤러로 표시합니다.


Example:

	bcsr@1,0 {
		#address-cells = <1>;
		#size-cells = <1>;
		compatible = "fsl,mpc8360mds-bcsr";
		reg = <1 0 0x8000>;
		ranges = <0 1 0 0x8000>;

		bcsr13: gpio-controller@d {
			#gpio-cells = <2>;
			compatible = "fsl,mpc8360mds-bcsr-gpio";
			reg = <0xd 1>;
			gpio-controller;
		};
	};

* Freescale on-board FPGA connected on I2C bus

Some Freescale boards like BSC9132QDS have on board FPGA connected on
the i2c bus.

Required properties:
- compatible: Should be a board-specific string followed by a string
  indicating the type of FPGA.  Example:
	"fsl,<board>-fpga", "fsl,fpga-qixis-i2c"
- reg: Should contain the address of the FPGA

* I2C 버스에 연결된 Freescale 온보드 FPGA

BSC9132QDS와 같은 일부 프리 스케일 보드에는 FPGA가 i2c 버스에 연결되어 있습니다.

필수 속성 :
- 호환 : FPGA의 유형을 나타내는 문자열 다음에 보드 특정 문자열이어야합니다. 예:
"fsl, <board> -fpga", "fsl, fpga-qixis-i2c"
- reg : FPGA의 주소를 포함해야한다.

Example:
	fpga: fpga@66 {
		compatible = "fsl,bsc9132qds-fpga", "fsl,fpga-qixis-i2c";
		reg = <0x66>;
	};

* Freescale on-board CPLD

Some Freescale boards like T1040RDB have an on board CPLD connected.

Required properties:
- compatible: Should be a board-specific string like "fsl,<board>-cpld"
  Example:
	"fsl,t1040rdb-cpld", "fsl,t1042rdb-cpld", "fsl,t1042rdb_pi-cpld"
- reg: should describe CPLD registers

* 프리 스케일 온보드 CPLD

T1040RDB와 같은 일부 프리 스케일 보드에는 온보드 CPLD가 연결되어있다.

필수 속성 :
- 호환 : "fsl, <board> -cpld"와 같은 보드 특정 문자열이어야합니다.
   예:
"fsl, t1040rdb - cpld", "fsl, t1042rdb-cpld", "fsl, t1042rdb_pi-cpld"
- reg : CPLD 레지스터를 설명해야합니다.


Example:
	cpld@3,0 {
		compatible = "fsl,t1040rdb-cpld";
		reg = <3 0 0x300>;
	};
```

## Doc/DeviceDriver/devicetree/bindings/bridge/adi,adv7123.txt
```
Analog Device ADV7123 Video DAC
-------------------------------

The ADV7123 is a digital-to-analog converter that outputs VGA signals from a
parallel video input.

Required properties:

- compatible: Should be "adi,adv7123"

Optional properties:

- psave-gpios: Power save control GPIO

Required nodes:

The ADV7123 has two video ports. Their connections are modeled using the OF
graph bindings specified in Documentation/devicetree/bindings/graph.txt.

- Video port 0 for DPI input
- Video port 1 for VGA output


Example
-------

	adv7123: encoder@0 {
		compatible = "adi,adv7123";

		ports {
			#address-cells = <1>;
			#size-cells = <0>;

			port@0 {
				reg = <0>;

				adv7123_in: endpoint@0 {
					remote-endpoint = <&dpi_out>;
				};
			};

			port@1 {
				reg = <1>;

				adv7123_out: endpoint@0 {
					remote-endpoint = <&vga_connector_in>;
				};
			};
		};
	};

/*
Analog Device ADV7123 Video DAC

ADV7123는 병렬 비디오 입력에서 VGA 신호를 출력하는 디지털 / 아날로그 변환기입니다.

필요한 속성 :
 - 호환성 : "adi, adv7123"로해야합니다.
옵션 속성 :
 - psave-gpios : 절전 제어 GPIO

ADV7123는 두 개의 비디오 포트가 있습니다. 그 연결은 Documentation / devicetree / bindings / graph.txt에서 지정된 OF 그래프 바인딩을 사용하여 모델링됩니다.

- DPI 입력의 비디오 포트 0
- VGA 출력 비디오 포트 1

Example
-------

	adv7123: encoder@0 {
		compatible = "adi,adv7123";

		ports {
			#address-cells = <1>;
			#size-cells = <0>;

			port@0 {
				reg = <0>;

				adv7123_in: endpoint@0 {
					remote-endpoint = <&dpi_out>;
				};
			};

			port@1 {
				reg = <1>;

				adv7123_out: endpoint@0 {
					remote-endpoint = <&vga_connector_in>;
				};
			};
		};
	};

*/
```

## Doc/DeviceDriver/devicetree/bindings/bridge/dw_hdmi.txt
```
DesignWare HDMI bridge bindings

Required properties:
- compatible: platform specific such as:
   * "snps,dw-hdmi-tx"
   * "fsl,imx6q-hdmi"
   * "fsl,imx6dl-hdmi"
   * "rockchip,rk3288-dw-hdmi"
- reg: Physical base address and length of the controller's registers.
- interrupts: The HDMI interrupt number
- clocks, clock-names : must have the phandles to the HDMI iahb and isfr clocks,
  as described in Documentation/devicetree/bindings/clock/clock-bindings.txt,
  the clocks are soc specific, the clock-names should be "iahb", "isfr"
-port@[X]: SoC specific port nodes with endpoint definitions as defined
   in Documentation/devicetree/bindings/media/video-interfaces.txt,
   please refer to the SoC specific binding document:
    * Documentation/devicetree/bindings/display/imx/hdmi.txt
    * Documentation/devicetree/bindings/display/rockchip/dw_hdmi-rockchip.txt

Optional properties
- reg-io-width: the width of the reg:1,4, default set to 1 if not present
- ddc-i2c-bus: phandle of an I2C controller used for DDC EDID probing
- clocks, clock-names: phandle to the HDMI CEC clock, name should be "cec"

Example:
	hdmi: hdmi@0120000 {
		compatible = "fsl,imx6q-hdmi";
		reg = <0x00120000 0x9000>;
		interrupts = <0 115 0x04>;
		gpr = <&gpr>;
		clocks = <&clks 123>, <&clks 124>;
		clock-names = "iahb", "isfr";
		ddc-i2c-bus = <&i2c2>;

		port@0 {
			reg = <0>;

			hdmi_mux_0: endpoint {
				remote-endpoint = <&ipu1_di0_hdmi>;
			};
		};

		port@1 {
			reg = <1>;

			hdmi_mux_1: endpoint {
				remote-endpoint = <&ipu1_di1_hdmi>;
			};
		};
	};

/*
DesignWare HDMI bridge bindings

필수 속성:
-호환 : 다음과 같은 특정 플랫폼

?* "snps, dw-hdmi-tx"
?* "fsl, imx6q-hdmi"
?* "fsl, imx6dl-hdmi"
?* "rockchip, rk3288-dw-hdmi"

- reg : 컨트롤러의 레지스터의 물리적 기본 주소와 길이.

 - 인터럽트 : HDMI 인터럽트 번호

 - 클럭, 클럭 이름 : HDMI iahb 및 isfr 클럭에 p hadle 가지고 있지 않으면 안됩니다.

-port @ [X] : Documentation / devicetree / bindings / media / video-interfaces.txt에 정의 된 엔드 포인트 정의가있는 SoC 특정 포트 노드.

???SoC 특정 바인딩 문서를 참조하십시오.
????* Documentation / devicetree / bindings / display / imx / hdmi.txt
????* Documentation / devicetree / bindings / display / rockchip / dw_hdmi-rockchip.txt

선택적 속성
- reg-io-width : reg의 너비 : 1,4, 존재하지 않으면 기본값은 1로 설정됩니다.
- ddc-i2c-bus : DDC EDID 프로빙에 사용되는 I2C 컨트롤러의 p 핸들
- 클럭, 클럭 이름 : HDMI CEC 클록에 대한 p핸들, 이름은 "cec"여야합니다.

Example:
	hdmi: hdmi@0120000 {
		compatible = "fsl,imx6q-hdmi";
		reg = <0x00120000 0x9000>;
		interrupts = <0 115 0x04>;
		gpr = <&gpr>;
		clocks = <&clks 123>, <&clks 124>;
		clock-names = "iahb", "isfr";
		ddc-i2c-bus = <&i2c2>;

		port@0 {
			reg = <0>;

			hdmi_mux_0: endpoint {
				remote-endpoint = <&ipu1_di0_hdmi>;
			};
		};

		port@1 {
			reg = <1>;

			hdmi_mux_1: endpoint {
				remote-endpoint = <&ipu1_di1_hdmi>;
			};
		};
	};

*/
```

## Doc/DeviceDriver/devicetree/bindings/bridge/ps8622.txt
```
ps8622-bridge bindings

Required properties:
	- compatible: "parade,ps8622" or "parade,ps8625"
	- reg: first i2c address of the bridge
	- sleep-gpios: OF device-tree gpio specification for PD_ pin.
	- reset-gpios: OF device-tree gpio specification for RST_ pin.

Optional properties:
	- lane-count: number of DP lanes to use
	- use-external-pwm: backlight will be controlled by an external PWM
	- video interfaces: Device node can contain video interface port
			    nodes for panel according to [1].

[1]: Documentation/devicetree/bindings/media/video-interfaces.txt

Example:
	lvds-bridge@48 {
		compatible = "parade,ps8622";
		reg = <0x48>;
		sleep-gpios = <&gpc3 6 1 0 0>;
		reset-gpios = <&gpc3 1 1 0 0>;
		lane-count = <1>;
		ports {
			port@0 {
				bridge_out: endpoint {
					remote-endpoint = <&panel_in>;
				};
			};
		};
	};



/*
ps8622-bridge bindings

필요한 속성 :
 - 호환성 : "parade, ps8622"또는 "parade, ps8625"
 - reg : 브리지의 첫 번째 i2c 주소
 - sleep-gpios : PD_ 핀 OF 장치 트리 gpio 지정.
 - reset-gpios : RST_ 핀 장치 트리 gpio 지정.

선택적 속성 :

옵션 속성 :
 - 레인 수 : 사용할 DP 레인 수
 - use-external-pwm : 백라이트는 외부 PWM에 의해 제어됩니다
 - 비디오 인터페이스 : 장치 노드는 [1]에 따라 패널의 비디오 인터페이스 포트 노드를 포함 할 수있다.

[1] : Documentation / devicetree / bindings / media / video-interfaces.txt

Example:
	lvds-bridge@48 {
		compatible = "parade,ps8622";
		reg = <0x48>;
		sleep-gpios = <&gpc3 6 1 0 0>;
		reset-gpios = <&gpc3 1 1 0 0>;
		lane-count = <1>;
		ports {
			port@0 {
				bridge_out: endpoint {
					remote-endpoint = <&panel_in>;
				};
			};
		};
	};

*/
```

## Doc/DeviceDriver/devicetree/bindings/bridge/ptn3460.txt
```
ptn3460 bridge bindings

Required properties:
	- compatible: "nxp,ptn3460"
	- reg: i2c address of the bridge
	- powerdown-gpio: OF device-tree gpio specification  for PD_N pin.
	- reset-gpio: OF device-tree gpio specification for RST_N pin.
	- edid-emulation: The EDID emulation entry to use
		+-------+------------+------------------+
		| Value | Resolution | Description      |
		|   0   |  1024x768  | NXP Generic      |
		|   1   |  1920x1080 | NXP Generic      |
		|   2   |  1920x1080 | NXP Generic      |
		|   3   |  1600x900  | Samsung LTM200KT |
		|   4   |  1920x1080 | Samsung LTM230HT |
		|   5   |  1366x768  | NXP Generic      |
		|   6   |  1600x900  | ChiMei M215HGE   |
		+-------+------------+------------------+

	- video interfaces: Device node can contain video interface port
			    nodes for panel according to [1].

[1]: Documentation/devicetree/bindings/media/video-interfaces.txt

Example:
	lvds-bridge@20 {
		compatible = "nxp,ptn3460";
		reg = <0x20>;
		powerdown-gpio = <&gpy2 5 1 0 0>;
		reset-gpio = <&gpx1 5 1 0 0>;
		edid-emulation = <5>;
		ports {
			port@0 {
				bridge_out: endpoint {
					remote-endpoint = <&panel_in>;
				};
			};
		};
	};


/*
ptn3460 브리지 바인딩

필수 속성 :
- 호환 : "nxp, ptn3460"
- reg : 브리지의 i2c 주소
- powerdown-gpio : OF PD_N 핀을위한 디바이스 트리 gpio 스펙.
- reset-gpio : RST_N 핀을위한 OF 디바이스 트리 gpio 사양.
- edid-emulation : 사용할 EDID 에뮬레이션 항목
+ ------- + ------------ + ------------------ +
| 가치 | 해상도 | 설명 |
| 0 | 1024x768 | NXP 일반 |
| 1 | 1920x1080 | NXP 일반 |
| 2 | 1920x1080 | NXP 일반 |
| 3 | 1600x900 | 삼성 LTM200KT |
| 4 | 1920x1080 | 삼성 LTM230HT |
| 5 | 1366x768 | NXP 일반 |
| 6 | 1600x900 | ChiMei M215HGE |
+ ------- + ------------ + ------------------ +

- 비디오 인터페이스 : 장치 노드는 비디오 인터페이스 포트를 포함 할 수 있습니다.
[1]에 따른 패널 용 노드.

[1] : Documentation / devicetree / bindings / media / video-interfaces.txt


Example:
	lvds-bridge@20 {
		compatible = "nxp,ptn3460";
		reg = <0x20>;
		powerdown-gpio = <&gpy2 5 1 0 0>;
		reset-gpio = <&gpx1 5 1 0 0>;
		edid-emulation = <5>;
		ports {
			port@0 {
				bridge_out: endpoint {
					remote-endpoint = <&panel_in>;
				};
			};
		};
	};

*/
```

## Doc/DeviceDriver/devicetree/bindings/bus/brcm,bus-axi.txt
```
Driver for ARM AXI Bus with Broadcom Plugins (bcma)

Required properties:

- compatible : brcm,bus-axi

- reg : iomem address range of chipcommon core

The cores on the AXI bus are automatically detected by bcma with the
memory ranges they are using and they get registered afterwards.
Automatic detection of the IRQ number is not working on
BCM47xx/BCM53xx ARM SoCs. To assign IRQ numbers to the cores, provide
them manually through device tree. Use an interrupt-map to specify the
IRQ used by the devices on the bus. The first address is just an index,
because we do not have any special register.

The top-level axi bus may contain children representing attached cores
(devices). This is needed since some hardware details can't be auto
detected (e.g. IRQ numbers). Also some of the cores may be responsible
for extra things, e.g. ChipCommon providing access to the GPIO chip.

- compatible : brcm, bus-axi

- reg : 칩 코어 코어의 iomem 주소 범위

AXI 버스의 코어는 사용중인 메모리 범위와 함께 bcma에 의해 자동으로 감지되며 이후에 등록됩니다. BCM47xx / BCM53xx ARM SoC에서는 IRQ 번호 자동 감지가 작동하지 않습니다. 코어에 IRQ 번호를 할당하려면 장치 트리를 통해 수동으로 제공하십시오. 인터럽트 맵을 사용하여 버스의 장치가 사용하는 IRQ를 지정하십시오. 우리는 특별한 레지스터가 없으므로 첫 번째 주소는 인덱스 일뿐입니다.

최상위 축 버스에는 연결된 코어 (장치)를 나타내는 하위 노드가있을 수 있습니다. 이는 일부 하드웨어 세부 사항을 자동으로 감지 할 수 없기 때문에 필요합니다 (e.g. IRQ 번호). 
GPIO 칩에 대한 액세스를 제공하는 e.g. 칩 커먼 (ChipCommon)도 있습니다.

Example:

	axi@18000000 {
		compatible = "brcm,bus-axi";
		reg = <0x18000000 0x1000>;
		ranges = <0x00000000 0x18000000 0x00100000>;
		#address-cells = <1>;
		#size-cells = <1>;
		#interrupt-cells = <1>;
		interrupt-map-mask = <0x000fffff 0xffff>;
		interrupt-map =
			/* Ethernet Controller 0 */
			<0x00024000 0 &gic GIC_SPI 147 IRQ_TYPE_LEVEL_HIGH>,

			/* Ethernet Controller 1 */
			<0x00025000 0 &gic GIC_SPI 148 IRQ_TYPE_LEVEL_HIGH>;

			/* PCIe Controller 0 */
			<0x00012000 0 &gic GIC_SPI 126 IRQ_TYPE_LEVEL_HIGH>,
			<0x00012000 1 &gic GIC_SPI 127 IRQ_TYPE_LEVEL_HIGH>,
			<0x00012000 2 &gic GIC_SPI 128 IRQ_TYPE_LEVEL_HIGH>,
			<0x00012000 3 &gic GIC_SPI 129 IRQ_TYPE_LEVEL_HIGH>,
			<0x00012000 4 &gic GIC_SPI 130 IRQ_TYPE_LEVEL_HIGH>,
			<0x00012000 5 &gic GIC_SPI 131 IRQ_TYPE_LEVEL_HIGH>;

		chipcommon {
			reg = <0x00000000 0x1000>;

			gpio-controller;
			#gpio-cells = <2>;
		};
	};
```
