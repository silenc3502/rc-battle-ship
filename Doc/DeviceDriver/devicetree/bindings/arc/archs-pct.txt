## Doc/DeviceDriver/devicetree/bindings/arc/archs-pct.txt
```
* ARC HS Performance Counters

The ARC HS can be configured with a pipeline performance monitor for counting
CPU and cache events like cache misses and hits. Like conventional PCT there
are 100+ hardware conditions dynamically mapped to upto 32 counters.
It also supports overflow interrupts.

Required properties:

- compatible : should contain
	"snps,archs-pct"

Example:

pmu {
        compatible = "snps,archs-pct";
};


ARC HS는 CPU와 캐시 미스와 충돌 등의 캐시 이벤트를 카운트하는 파이프 라인 성능 모니터로 구성 할 수 있습니다. 기존의 PCT뿐만 아니라 100 개 이상의 하드웨어 조건이 최대 32 개의 카운터에 동적으로 매핑되어 있습니다.
또한 오버 플로우 인터럽트도 지원하고 있습니다.
```

## Doc/DeviceDriver/devicetree/bindings/arc/axs101.txt
```
Synopsys DesignWare ARC Software Development Platforms Device Tree Bindings


//Synopsys DesignWare ARC 소프트웨어 개발 플랫폼 장치 트리 바인딩

---------------------------------------------------------------------------

SDP Main Board with an AXC001 CPU Card hoisting ARC700 core in silicon

Required root node properties:
    - compatible = "snps,axs101", "snps,arc-sdp";


/*
실리콘에 ARC700 코어를 탑재 한 AXC001 CPU 카드가있는 SDP 메인 보드

필수 루트 노드 속성
 - compatible = "snps,axs101", "snps,arc-sdp";
*/
```

## Doc/DeviceDriver/devicetree/bindings/arc/axs103.txt
```
Synopsys DesignWare ARC Software Development Platforms Device Tree Bindings
---------------------------------------------------------------------------

SDP Main Board with an AXC003 FPGA Card which can contain various flavours of
HS38x cores.

Required root node properties:
    - compatible = "snps,axs103", "snps,arc-sdp";

/*
다양한 기능을 담을 수있는 AXC003 FPGA 카드가 장착 된 SDP 메인 보드
HS38x 코어
*/
```

## Doc/DeviceDriver/devicetree/bindings/arc/pct.txt
```
* ARC Performance Counters

The ARC700 can be configured with a pipeline performance monitor for counting
CPU and cache events like cache misses and hits. Like conventional PCT there
are 100+ hardware conditions dynamically mapped to upto 32 counters

Note that:
 * The ARC 700 PCT does not support interrupts; although HW events may be
   counted, the HW events themselves cannot serve as a trigger for a sample.

Required properties:

- compatible : should contain
	"snps,arc700-pct"

Example:

pmu {
        compatible = "snps,arc700-pct";
};


/*
ARC700는 CPU와 캐시 미스와 충돌 등의 캐시 이벤트를 카운트하는 파이프 라인 성능 모니터로 구성 할 수 있습니다. 기존의 PCT뿐만 아니라 100 개 이상의 하드웨어 조건이 최대 32 개의 카운터에 동적으로 매핑됩니다

* ARC 700 PCT는 인터럽트를 지원하지 않습니다. HW 이벤트는 계산 될지도 모르지만, 
HW 이벤트 자체는 샘플의 트리거 역할을 할 수 없습니다
*/
```

## Doc/DeviceDriver/devicetree/bindings/arm/keystone/keystone.txt
```
TI Keystone Platforms Device Tree Bindings
-----------------------------------------------

Boards with Keystone2 based devices (TCI66xxK2H) SOC shall have the
following properties.
//Keystone2 기반 장치 (TCI66xxK2H)를 탑재 한 보드 SOC는
다음 특성.

Required properties:
 - compatible: All TI specific devices present in Keystone SOC should be in
   the form "ti,keystone-*". Generic devices like gic, arch_timers, ns16550
   type UART should use the specified compatible for those devices.
//호환성 : Keystone SOC에있는 모든 TI 고유의 장치는
"ti, keystone- *"형식입니다. gic, arch_timers, ns16550와 같은 범용 장치
유형 UART는 이러한 장치에 지정된 호환성을 사용해야합니다.


SoC families:

- Keystone 2 generic SoC:
   compatible = "ti,keystone"

SoCs:

- Keystone 2 Hawking/Kepler
   compatible = "ti,k2hk", "ti,keystone"
- Keystone 2 Lamarr
   compatible = "ti,k2l", "ti,keystone"
- Keystone 2 Edison
   compatible = "ti,k2e", "ti,keystone"
- K2G
   compatible = "ti,k2g", "ti,keystone"

Boards:
-  Keystone 2 Hawking/Kepler EVM
   compatible = "ti,k2hk-evm", "ti,k2hk", "ti,keystone"

-  Keystone 2 Lamarr EVM
   compatible = "ti,k2l-evm", "ti, k2l", "ti,keystone"

-  Keystone 2 Edison EVM
   compatible = "ti,k2e-evm", "ti,k2e", "ti,keystone"

-  K2G EVM
   compatible = "ti,k2g-evm", "ti,k2g", "ti-keystone"

-  K2G Industrial Communication Engine
   compatible = "ti,k2g-ice", "ti,k2g", "ti-keystone"
```

## Doc/DeviceDriver/devicetree/bindings/arm/keystone/ti,sci.txt
```
Texas Instruments System Control Interface (TI-SCI) Message Protocol
//텍사스 인스트루먼트의 시스템 제어 인터페이스 (TI-SCI) 메시지 프로토콜
-------------------------------------------------------------------

Texas Instrument's processors including those belonging to Keystone generation
of processors have separate hardware entity which is now responsible for the
management of the System on Chip (SoC) system. These include various system
level functions as well.
//Keystone 세대에 속한 텍사스 인스트루먼트 프로세서
의 프로세서는 별도의 하드웨어 엔티티를 가지며 현재는
시스템 온 칩 (SoC) 시스템 관리 여기에는 다양한 시스템
레벨 기능도 제공합니다.

TI-SCI controller Device Node:
=============================

Required properties:
--------------------
- compatible: should be "ti,k2g-sci"
- mbox-names:
	"rx" - Mailbox corresponding to receive path
	"tx" - Mailbox corresponding to transmit path

- mboxes: Mailboxes corresponding to the mbox-names. Each value of the mboxes
	  property should contain a phandle to the mailbox controller device
	  node and an args specifier that will be the phandle to the intended
	  sub-mailbox child node to be used for communication.

See Documentation/devicetree/bindings/mailbox/mailbox.txt for more details
about the generic mailbox controller and client driver bindings. Also see
Documentation/devicetree/bindings/mailbox/ti,message-manager.txt for typical
controller that is used to communicate with this System controllers.
//mbox-name에 해당하는 메일 박스. mbox의 각 값
속성에는 사서함 컨트롤러 장치에 대한 파들을 포함해야합니다.
노드와 args 지정자는 의도 한 의도에 따라 달라집니다.
통신에 사용될 하위 사서함 하위 노드

Optional Properties:
--------------------
- reg-names:
	debug_messages - Map the Debug message region
- reg:  register space corresponding to the debug_messages
- ti,system-reboot-controller: If system reboot can be triggered by SoC reboot

Example (K2G):
--------
	pmmc: pmmc {
		compatible = "ti,k2g-sci";
		mbox-names = "rx", "tx";
		mboxes= <&msgmgr &msgmgr_proxy_pmmc_rx>,
			<&msgmgr &msgmgr_proxy_pmmc_tx>;
		reg-names = "debug_messages";
		reg = <0x02921800 0x800>;
	};


TI-SCI Client Device Node:
========================

Client nodes refer to the required TI-SCI device using the "ti,sci" property.

Example (K2G):
-------------
	my_dev_node: dev_node {
		...
		ti,sci = <&pmmc>;
		...
	}
```

## Doc/DeviceDriver/devicetree/bindings/arm/omap/counter.txt
```
OMAP Counter-32K bindings

Required properties:
- compatible:	Must be "ti,omap-counter32k" for OMAP controllers
- reg:		Contains timer register address range (base address and length)
- ti,hwmods:	Name of the hwmod associated to the counter, which is typically
		"counter_32k"
	//필수 속성 :
	- 호환 가능 : OMAP 컨트롤러의 경우 "ti, omap-counter32k"여야합니다.
	- reg : 타이머 레지스터 주소 범위 (기본 주소 및 길이)를 포함합니다.
	- ti, hwmods : 카운터에 연결된 hwmod의 이름으로, 일반적으로
"counter_32k"

Example:

counter32k: counter@4a304000 {
	compatible = "ti,omap-counter32k";
	reg = <0x4a304000 0x20>;
	ti,hwmods = "counter_32k";
};
```

## Doc/DeviceDriver/devicetree/bindings/arm/omap/crossbar.txt
```
Some socs have a large number of interrupts requests to service
the needs of its many peripherals and subsystems. All of the
interrupt lines from the subsystems are not needed at the same
time, so they have to be muxed to the irq-controller appropriately.
In such places a interrupt controllers are preceded by an CROSSBAR
that provides flexibility in muxing the device requests to the controller
inputs.
	//일부 socs는 많은 수의 주변 장치 및 하위 시스템의 요구 사항을 처리하기 위해 많은 수의 인터럽트 요청을 처리합니다. 
	하위 시스템의 모든 인터럽트 라인은 동시에 필요하지 않으므로 IRQ 컨트롤러에 적절하게 다중화되어야합니다.
	그러한 장소에서 인터럽트 컨트롤러 앞에는 컨트롤러 요청에 장치 요청을 다중화하는 융통성을 제공하는 CROSSBAR가 선행됩니다.

Required properties:
- compatible : Should be "ti,irq-crossbar"
- reg: Base address and the size of the crossbar registers.
- interrupt-controller: indicates that this block is an interrupt controller.
- interrupt-parent: the interrupt controller this block is connected to.
- ti,max-irqs: Total number of irqs available at the parent interrupt controller.
- ti,max-crossbar-sources: Maximum number of crossbar sources that can be routed.
- ti,reg-size: Size of a individual register in bytes. Every individual
	    register is assumed to be of same size. Valid sizes are 1, 2, 4.
- ti,irqs-reserved: List of the reserved irq lines that are not muxed using
		 crossbar. These interrupt lines are reserved in the soc,
		 so crossbar bar driver should not consider them as free
		 lines.

필수 속성 :
- 호환 : "ti, irq-crossbar"여야합니다.
- reg :베이스 주소와 크로스바 레지스터의 크기.
- interrupt-controller :이 블록이 인터럽트 컨트롤러임을 나타냅니다.
- interrupt-parent :이 블록이 연결된 인터럽트 컨트롤러입니다.
- ti, max-irqs : 상위 인터럽트 컨트롤러에서 사용할 수있는 총 irq 수입니다.
- ti, max-crossbar-sources : 라우트 할 수있는 크로스바 소스의 최대 수.
- ti, reg-size : 개별 레지스터의 크기 (바이트). 모든 개별 레지스터는 동일한 크기로 간주됩니다. 유효한 크기는 1, 2, 4입니다.
- ti, irqs-reserved : 크로스바를 사용하여 다중화되지 않은 예약 된 irq 라인 목록. 이러한 인터럽트 라인은 soc에 예약되어 있으며,
그래서 크로스바 바 드라이버는 그들을 자유 선으로 간주해서는 안됩니다.

Optional properties:
- ti,irqs-skip: This is similar to "ti,irqs-reserved", but these are for
  SOC-specific hard-wiring of those irqs which unexpectedly bypasses the
  crossbar. These irqs have a crossbar register, but still cannot be used.

- ti,irqs-safe-map: integer which maps to a safe configuration to use
  when the interrupt controller irq is unused (when not provided, default is 0)

//- ti, irqs-skip : 이것은 "ti, irqs-reserved"와 유사하지만 예기치 않게 크로스바를 우회하는 irq의 SOC 특정 하드 와이어 링용입니다.
 이 irq에는 크로스바 레지스터가 있지만 여전히 사용할 수 없습니다.

- ti, irqs-safe-map : 인터럽트 컨트롤러 irq가 사용되지 않을 때 사용할 안전 구성에 매핑되는 정수 (제공되지 않을 경우 기본값은 0 임)

Examples:
		crossbar_mpu: crossbar@4a002a48 {
			compatible = "ti,irq-crossbar";
			reg = <0x4a002a48 0x130>;
			ti,max-irqs = <160>;
			ti,max-crossbar-sources = <400>;
			ti,reg-size = <2>;
			ti,irqs-reserved = <0 1 2 3 5 6 131 132>;
			ti,irqs-skip = <10 133 139 140>;
		};

Consumer:
========
See Documentation/devicetree/bindings/interrupt-controller/interrupts.txt and
Documentation/devicetree/bindings/arm/gic.txt for further details.

An interrupt consumer on an SoC using crossbar will use:
	interrupts = <GIC_SPI request_number interrupt_level>
	//자세한 내용은 Documentation / devicetree / bindings / interrupt-controller / interrupts.txt 및 Documentation / devicetree / bindings / arm / gic.txt를 참조하십시오.

	크로스바를 사용하는 SoC의 인터럽트 소비자는 다음을 사용합니다.
	인터럽트 = <GIC_SPI request_number interrupt_level>

Example:
	device_x@0x4a023000 {
		/* Crossbar 8 used */
		interrupts = <GIC_SPI 8 IRQ_TYPE_LEVEL_HIGH>;
		...
	};
```

## Doc/DeviceDriver/devicetree/bindings/arm/omap/ctrl.txt
```
OMAP Control Module bindings

Control Module contains miscellaneous features under it based on SoC type.
Pincontrol is one common feature, and it has a specialized support
described in [1]. Typically some clock nodes are also under control module.
Syscon is used to share register level access to drivers external to
control module driver itself.
	//제어 모듈에는 SoC 유형에 기반한 기타 기능이 포함되어 있습니다.
	핀 컨트롤은 일반적인 기능 중 하나이며, [1]에서 설명한 특수 지원이 있습니다. 
	일반적으로 일부 클록 노드도 제어 모듈 아래에 있습니다. 
	Syscon은 제어 모듈 드라이버 자체의 외부 드라이버에 대한 레지스터 레벨 액세스를 공유하는 데 사용됩니다.

See [2] for documentation about clock/clockdomain nodes.

[1] Documentation/devicetree/bindings/pinctrl/pinctrl-single.txt
[2] Documentation/devicetree/bindings/clock/ti/*

Required properties:
- compatible:	Must be one of:
		"ti,am3-scm"
		"ti,am4-scm"
		"ti,dm814-scrm"
		"ti,dm816-scrm"
		"ti,omap2-scm"
		"ti,omap3-scm"
		"ti,omap4-scm-core"
		"ti,omap4-scm-padconf-core"
		"ti,omap5-scm-core"
		"ti,omap5-scm-padconf-core"
		"ti,dra7-scm-core"
- reg:		Contains Control Module register address range
		(base address and length)

Optional properties:
- clocks:	clocks for this module
- clockdomains:	clockdomains for this module

Examples:

scm: scm@2000 {
	compatible = "ti,omap3-scm", "simple-bus";
	reg = <0x2000 0x2000>;
	#address-cells = <1>;
	#size-cells = <1>;
	ranges = <0 0x2000 0x2000>;

	omap3_pmx_core: pinmux@30 {
		compatible = "ti,omap3-padconf",
			     "pinctrl-single";
		reg = <0x30 0x230>;
		#address-cells = <1>;
		#size-cells = <0>;
		#interrupt-cells = <1>;
		interrupt-controller;
		pinctrl-single,register-width = <16>;
		pinctrl-single,function-mask = <0xff1f>;
	};

	scm_conf: scm_conf@270 {
		compatible = "syscon";
		reg = <0x270 0x330>;
		#address-cells = <1>;
		#size-cells = <1>;

		scm_clocks: clocks {
			#address-cells = <1>;
			#size-cells = <0>;
		};
	};

	scm_clockdomains: clockdomains {
	};
}

&scm_clocks {
	mcbsp5_mux_fck: mcbsp5_mux_fck {
		#clock-cells = <0>;
		compatible = "ti,composite-mux-clock";
		clocks = <&core_96m_fck>, <&mcbsp_clks>;
		ti,bit-shift = <4>;
		reg = <0x02d8>;
	};
};
```

## Doc/DeviceDriver/devicetree/bindings/arm/omap/dmm.txt
```
OMAP Dynamic Memory Manager (DMM) bindings

The dynamic memory manager (DMM) is a module located immediately in front of the
SDRAM controllers (called EMIFs on OMAP). DMM manages various aspects of memory
accesses such as priority generation amongst initiators, configuration of SDRAM
interleaving, optimizing transfer of 2D block objects, and provide MMU-like page
translation for initiators which need contiguous dma bus addresses.
	//DMM (Dynamic Memory Manager)은 DRAM 컨트롤러 바로 앞에 위치한 모듈입니다 (OMAP의 EMIF라고 함). 
	DMM은 이니시에이터 중 우선 순위 생성, SDRAM 인터리빙 구성, 2D 블록 객체 전송 최적화 및 인접한 DMA 버스 주소가 필요한 
	이니시에이터 용 MMU와 같은 페이지 변환과 같은 메모리 액세스의 다양한 측면을 관리합니다.

Required properties:
- compatible:	Should contain "ti,omap4-dmm" for OMAP4 family
		Should contain "ti,omap5-dmm" for OMAP5 family
		Should contain "ti,dra7-dmm" for DRA7x family
- reg:		Contains DMM register address range (base address and length)
- interrupts:	Should contain an interrupt-specifier for DMM_IRQ.
- ti,hwmods:	Name of the hwmod associated to DMM, which is typically "dmm"

//필수 속성 :
- 호환 가능 : OMAP4 제품군에 "ti, omap4-dmm"을 포함해야합니다.
OMAP5 제품군에 대해 "ti, omap5-dmm"을 포함해야합니다.
DRA7x 계열의 "ti, dra7-dmm"을 포함해야합니다.
- reg : DMM 레지스터 주소 범위 (기본 주소 및 길이)를 포함합니다.
- interrupts : DMM_IRQ에 대한 인터럽트 지정자를 포함해야합니다.
- ti, hwmods : 일반적으로 "dmm"인 DMM과 관련된 hwmod의 이름입니다.


Example:

dmm@4e000000 {
	compatible = "ti,omap4-dmm";
	reg = <0x4e000000 0x800>;
	ti,hwmods = "dmm";
};
```

## Doc/DeviceDriver/devicetree/bindings/arm/omap/iva.txt
```
* TI - IVA (Imaging and Video Accelerator) subsystem

The IVA contain various audio, video or imaging HW accelerator
depending of the version.
//IVA는 버전에 따라 다양한 오디오, 비디오 또는 이미징 HW 가속기를 포함합니다.

Required properties:
- compatible : Should be:
  - "ti,ivahd" for OMAP4
  - "ti,iva2.2" for OMAP3
  - "ti,iva2.1" for OMAP2430
  - "ti,iva1" for OMAP2420
- ti,hwmods: "iva"

Examples:

iva {
    compatible = "ti,ivahd", "ti,iva";
    ti,hwmods = "iva";
};
```

## Doc/DeviceDriver/devicetree/bindings/arm/omap/mpu.txt
```
* TI - MPU (Main Processor Unit) subsystem

The MPU subsystem contain one or several ARM cores
depending of the version.
The MPU contain CPUs, GIC, L2 cache and a local PRCM.
//MPU 하위 시스템은 버전에 따라 하나 또는 여러 개의 ARM 코어를 포함합니다.
MPU는 CPU, GIC, L2 캐시 및 로컬 PRCM을 포함합니다.

Required properties:
- compatible : Should be "ti,omap3-mpu" for OMAP3
               Should be "ti,omap4-mpu" for OMAP4
	       Should be "ti,omap5-mpu" for OMAP5
- ti,hwmods: "mpu"

Optional properties:
- sram:	Phandle to the ocmcram node

Examples:

- For an OMAP5 SMP system:

mpu {
    compatible = "ti,omap5-mpu";
    ti,hwmods = "mpu"
};

- For an OMAP4 SMP system:

mpu {
    compatible = "ti,omap4-mpu";
    ti,hwmods = "mpu";
};


- For an OMAP3 monocore system:

mpu {
    compatible = "ti,omap3-mpu";
    ti,hwmods = "mpu";
};
```
