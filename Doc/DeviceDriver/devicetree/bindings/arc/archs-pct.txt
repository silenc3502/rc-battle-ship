## Doc/DeviceDriver/devicetree/bindings/bus/brcm,gisb-arb.txt
```
Broadcom GISB bus Arbiter controller

Required properties:

- compatible:
    "brcm,gisb-arb" or "brcm,bcm7445-gisb-arb" for 28nm chips
    "brcm,bcm7435-gisb-arb" for newer 40nm chips
    "brcm,bcm7400-gisb-arb" for older 40nm chips and all 65nm chips
    "brcm,bcm7038-gisb-arb" for 130nm chips
- reg: specifies the base physical address and size of the registers
- interrupt-parent: specifies the phandle to the parent interrupt controller
  this arbiter gets interrupt line from
- interrupts: specifies the two interrupts (timeout and TEA) to be used from
  the parent interrupt controller

Optional properties:

- brcm,gisb-arb-master-mask: 32-bits wide bitmask used to specify which GISB
  masters are valid at the system level
- brcm,gisb-arb-master-names: string list of the litteral name of the GISB
  masters. Should match the number of bits set in brcm,gisb-master-mask and
  the order in which they appear

필수 속성 :

- compatible:
     28nm 칩의 경우 "brcm, gisb-arb"또는 "brcm, bcm7445-gisb-arb"
     최신 40nm 칩용 "brcm, bcm7435-gisb-arb"
     구형 40nm 칩 및 모든 65nm 칩용 "brcm, bcm7400-gisb-arb"
     130nm 칩의 경우 "brcm, bcm7038-gisb-arb"
- reg : 레지스터의 기본 물리적 주소와 크기를 지정합니다.
- interrupt-parent :이 중재자가 인터럽트 라인을 얻는 상위 인터럽트 컨트롤러에 대한 phandle을 지정합니다.
- interrupts : 부모 인터럽트 컨트롤러에서 사용할 두 개의 인터럽트 (타임 아웃 및 TEA)를 지정합니다.

선택적 속성 :

- brcm, gisb-arb-master-mask : 시스템 레벨에서 어떤 GISB 마스터가 유효한지 지정하는 데 사용되는 32 비트 폭의 비트 마스크
- brcm, gisb-arb-master-names : GISB 마스터의 litteral 이름의 문자열 목록. brcm, gisb-master-mask 및 표시된 순서의 비트 수와 일치해야합니다.



Example:

gisb-arb@f0400000 {
	compatible = "brcm,gisb-arb";
	reg = <0xf0400000 0x800>;
	interrupts = <0>, <2>;
	interrupt-parent = <&sun_l2_intc>;

	brcm,gisb-arb-master-mask = <0x7>;
	brcm,gisb-arb-master-names = "bsp_0", "scpu_0", "cpu_0";
};
```

## Doc/DeviceDriver/devicetree/bindings/bus/imx-weim.txt
```
Device tree bindings for i.MX Wireless External Interface Module (WEIM)

The term "wireless" does not imply that the WEIM is literally an interface
without wires. It simply means that this module was originally designed for
wireless and mobile applications that use low-power technology.

The actual devices are instantiated from the child nodes of a WEIM node.

"무선"이라는 용어는 WEIM이 문자 그대로 유선이없는 인터페이스라는 것을 의미하지는 않습니다. 이는 단순히이 모듈이 원래 저전력 기술을 사용하는 무선 및 모바일 애플리케이션 용으로 설계되었다는 것을 의미합니다.

실제 장치는 WEIM 노드의 하위 노드에서 인스턴스화됩니다.


Required properties:

 - compatible:		Should contain one of the following:
			  "fsl,imx1-weim"
			  "fsl,imx27-weim"
			  "fsl,imx51-weim"
			  "fsl,imx50-weim"
			  "fsl,imx6q-weim"
 - reg:			A resource specifier for the register space
			(see the example below)
 - clocks:		the clock, see the example below.
 - #address-cells:	Must be set to 2 to allow memory address translation
 - #size-cells:		Must be set to 1 to allow CS address passing
 - ranges:		Must be set up to reflect the memory layout with four
			integer values for each chip-select line in use:

			   <cs-number> 0 <physical address of mapping> <size>
필수 속성 :

  - compatible : 다음 중 하나를 포함해야합니다 :
"fsl, imx1-weim"
"fsl, imx27-weim"
"fsl, imx51-weim"
"fsl, imx50-weim"
"fsl, imx6q-weim"
  - reg : 레지스터 공간에 대한 리소스 지정자 (아래 예제 참조)
  - clocks : clock는 아래 예를 참조하십시오.
  - # address-cells : 메모리 주소 변환을 허용하려면 2로 설정해야합니다.
  - # 크기 - 셀 : CS 주소 전달을 허용하려면 1로 설정해야합니다.
  - 범위 : 사용중인 각 칩 선택 라인에 대해 네 개의 정수 값을 갖는 메모리 레이아웃을 반영하도록 설정해야합니다.

<cs-number> 0 <매핑의 실제 주소> <size>



Optional properties:

 - fsl,weim-cs-gpr:	For "fsl,imx50-weim" and "fsl,imx6q-weim" type of
			devices, it should be the phandle to the system General
			Purpose Register controller that contains WEIM CS GPR
			register, e.g. IOMUXC_GPR1 on i.MX6Q.  IOMUXC_GPR1[11:0]
			should be set up as one of the following 4 possible
			values depending on the CS space configuration.

			IOMUXC_GPR1[11:0]    CS0    CS1    CS2    CS3
			---------------------------------------------
				05	    128M     0M     0M     0M
				033          64M    64M     0M     0M
				0113         64M    32M    32M     0M
				01111        32M    32M    32M    32M

			In case that the property is absent, the reset value or
			what bootloader sets up in IOMUXC_GPR1[11:0] will be
			used.

선택적 속성 :

  - fsl, weim-cs-gpr : "fsl, imx50-weim"및 "fsl, imx6q-weim"유형의 장치의 경우, WEIM CS GPR 레지스터, e.g. IOMUXC_GPR1 on i.MX6Q 를 포함하는 시스템 범용 레지스터 컨트롤러의 phandle 이어야합니다 . IOMUXC_GPR1 [11 : 0]은 CS 공간 구성에 따라 다음 4 가지 가능한 값 중 하나로 설정되어야합니다.


			IOMUXC_GPR1[11:0]    CS0    CS1    CS2    CS3
			---------------------------------------------
				05	    128M     0M     0M     0M
				033          64M    64M     0M     0M
				0113         64M    32M    32M     0M
				01111        32M    32M    32M    32M

속성이 없으면 재설정 값이나 IOMUXC_GPR1 [11 : 0]에 설정 한 부트 로더가 사용됩니다.



Timing property for child nodes. It is mandatory, not optional.

 - fsl,weim-cs-timing:	The timing array, contains timing values for the
			child node. We can get the CS index from the child
			node's "reg" property. The number of registers depends
			on the selected chip.
			For i.MX1, i.MX21 ("fsl,imx1-weim") there are two
			registers: CSxU, CSxL.
			For i.MX25, i.MX27, i.MX31 and i.MX35 ("fsl,imx27-weim")
			there are three registers: CSCRxU, CSCRxL, CSCRxA.
			For i.MX50, i.MX53 ("fsl,imx50-weim"),
			i.MX51 ("fsl,imx51-weim") and i.MX6Q ("fsl,imx6q-weim")
			there are six registers: CSxGCR1, CSxGCR2, CSxRCR1,
			CSxRCR2, CSxWCR1, CSxWCR2.

Timing property for child nodes. 선택 사항이 아닌 필수 항목입니다.

  - fsl, weim-cs-timing : 타이밍 배열은 자식 노드의 타이밍 값을 포함합니다. 우리는 자식 노드의 "reg"속성으로부터 CS 인덱스를 얻을 수있다. 레지스터의 수는 선택한 칩에 따라 다릅니다.

i.MX1, i.MX21 ( "fsl, imx1-weim")에는 CSxU, CSxL의 두 가지 레지스터가 있습니다. i.MX25, i.MX27, i.MX31 및 i.MX35 ( "fsl, imx27-weim")에는 CSCRxU, CSCRxL, CSCRxA의 세 가지 레지스터가 있습니다: i.MX50, i.MX53 ( "fsl, imx50-weim"), i.MX51 ( "fsl, imx51-weim") 및 i.MX6Q ( "fsl, imx6q-weim")에는 6 개의 레지스터가 있습니다. CSxGCR1, CSxGCR2, CSxRCR1, CSxRCR2, CSxWCR1, CSxWCR2. 

Example for an imx6q-sabreauto board, the NOR flash connected to the WEIM:
imx6q-sabreauto 보드의 예 : NOR 플래시가 WEIM에 연결됨 :

	weim: weim@021b8000 {
		compatible = "fsl,imx6q-weim";
		reg = <0x021b8000 0x4000>;
		clocks = <&clks 196>;
		#address-cells = <2>;
		#size-cells = <1>;
		ranges = <0 0 0x08000000 0x08000000>;
		fsl,weim-cs-gpr = <&gpr>;

		nor@0,0 {
			compatible = "cfi-flash";
			reg = <0 0 0x02000000>;
			#address-cells = <1>;
			#size-cells = <1>;
			bank-width = <2>;
			fsl,weim-cs-timing = <0x00620081 0x00000001 0x1c022000
					0x0000c000 0x1404a38e 0x00000000>;
		};
	};
```
