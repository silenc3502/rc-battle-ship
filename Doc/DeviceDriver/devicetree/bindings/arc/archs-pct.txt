## Doc/DeviceDriver/devicetree/bindings/arm/omap/omap.txt
```
* Texas Instruments OMAP

OMAP is currently using a static file per SoC family to describe the
IPs present in the SoC.
On top of that an omap_device is created to extend the platform_device
capabilities and to allow binding with one or several hwmods.
The hwmods will contain all the information to build the device:
address range, irq lines, dma lines, interconnect, PRCM register,
clock domain, input clocks.
For the moment just point to the existing hwmod, the next step will be
to move data from hwmod to device-tree representation.
//OMAP은 현재 SoC 제품군에있는 정적 파일을 사용하여 SoC에있는 IP를 설명합니다.
그 중 omap_device는 platform_device 기능을 확장하고 하나 또는 여러 개의 hwmod와 바인딩 할 수 있도록 만들어졌습니다.
hwmod에는 주소 범위, irq 행, dma 행, 상호 연결, PRCM 레지스터, 클럭 도메인, 입력 클럭과 같이 장치를 빌드하는 데 필요한 모든 정보가 들어 있습니다.
잠시 동안 기존 hwmod를 가리키면 다음 단계는 hwmod에서 장치 트리 표현으로 데이터를 이동하는 것입니다.


Required properties:
- compatible: Every devices present in OMAP SoC should be in the
  form: "ti,XXX"
- ti,hwmods: list of hwmod names (ascii strings), that comes from the OMAP
  HW documentation, attached to a device. Must contain at least
  one hwmod.
필수 속성 :
- 호환 가능 : OMAP SoC에있는 모든 장치는 "ti, XXX"형식이어야합니다.
- ti, hwmods : 장치에 연결된 OMAP HW 문서에서 가져온 hwmod 이름 (ascii 문자열) 목록입니다. 하나 이상의 hwmod가 있어야합니다.	

Optional properties:
- ti,no_idle_on_suspend: When present, it prevents the PM to idle the module
  during suspend.
- ti,no-reset-on-init: When present, the module should not be reset at init
- ti,no-idle-on-init: When present, the module should not be idled at init
- ti,no-idle: When present, the module is never allowed to idle.
//선택적 속성 :
- ti, no_idle_on_suspend : 일시 중지 중에 PM이 모듈을 유휴하는 것을 방지합니다.
- ti, no-reset-on-init : 모듈이 init에서 초기화되지 않아야합니다.
- ti, no-idle-on-init : 모듈이 init에서 idle 상태가되어서는 안된다.
- ti, no-idle : 모듈이 유휴 상태 일 때 절대 허용되지 않습니다.

Example:

spinlock@1 {
    compatible = "ti,omap4-spinlock";
    ti,hwmods = "spinlock";
};

SoC Type (optional):

- General Purpose devices
  compatible = "ti,gp"
- High Security devices
  compatible = "ti,hs"

SoC Families:

- OMAP2 generic - defaults to OMAP2420
  compatible = "ti,omap2"
- OMAP3 generic - defaults to OMAP3430
  compatible = "ti,omap3"
- OMAP4 generic - defaults to OMAP4430
  compatible = "ti,omap4"
- OMAP5 generic - defaults to OMAP5430
  compatible = "ti,omap5"
- DRA7 generic - defaults to DRA742
  compatible = "ti,dra7"
- AM43x generic - defaults to AM4372
  compatible = "ti,am43"

SoCs:

- OMAP2420
  compatible = "ti,omap2420", "ti,omap2"
- OMAP2430
  compatible = "ti,omap2430", "ti,omap2"

- OMAP3430
  compatible = "ti,omap3430", "ti,omap3"
- AM3517
  compatible = "ti,am3517", "ti,omap3"
- OMAP3630
  compatible = "ti,omap36xx", "ti,omap3"
- AM33xx
  compatible = "ti,am33xx", "ti,omap3"

- OMAP4430
  compatible = "ti,omap4430", "ti,omap4"
- OMAP4460
  compatible = "ti,omap4460", "ti,omap4"

- OMAP5430
  compatible = "ti,omap5430", "ti,omap5"
- OMAP5432
  compatible = "ti,omap5432", "ti,omap5"

- DRA742
  compatible = "ti,dra742", "ti,dra74", "ti,dra7"

- DRA722
  compatible = "ti,dra722", "ti,dra72", "ti,dra7"

- DRA718
  compatible = "ti,dra718", "ti,dra722", "ti,dra72", "ti,dra7"

- AM5728
  compatible = "ti,am5728", "ti,dra742", "ti,dra74", "ti,dra7"

- AM5726
  compatible = "ti,am5726", "ti,dra742", "ti,dra74", "ti,dra7"

- AM5718
  compatible = "ti,am5718", "ti,dra722", "ti,dra72", "ti,dra7"

- AM5716
  compatible = "ti,am5716", "ti,dra722", "ti,dra72", "ti,dra7"

- AM4372
  compatible = "ti,am4372", "ti,am43"

Boards:

- OMAP3 BeagleBoard : Low cost community board
			// 저비용 커뮤니티 보드
  compatible = "ti,omap3-beagle", "ti,omap3"

- OMAP3 Tobi with Overo : Commercial expansion board with daughter board
			//도터 보드가있는 상용 확장 보드
  compatible = "gumstix,omap3-overo-tobi", "gumstix,omap3-overo", "ti,omap3"

- OMAP4 SDP : Software Development Board
		// 소프트웨어 개발위원회
  compatible = "ti,omap4-sdp", "ti,omap4430"

- OMAP4 PandaBoard : Low cost community board
		//저비용 커뮤니티 보드
  compatible = "ti,omap4-panda", "ti,omap4430"

- OMAP4 DuoVero with Parlor : Commercial expansion board with daughter board
			//상업용 확장 보드, 도터 보드 포함
  compatible = "gumstix,omap4-duovero-parlor", "gumstix,omap4-duovero", "ti,omap4430", "ti,omap4";

- OMAP4 VAR-STK-OM44 : Commercial dev kit with VAR-OM44CustomBoard and VAR-SOM-OM44 w/WLAN
			//VAR-OM44CustomBoard 및 VAR-SOM-OM44 w / WLAN을 갖춘 상용 개발 키트
  compatible = "variscite,var-stk-om44", "variscite,var-som-om44", "ti,omap4460", "ti,omap4";

- OMAP4 VAR-DVK-OM44 : Commercial dev kit with VAR-OM44CustomBoard, VAR-SOM-OM44 w/WLAN and LCD touchscreen
			//VAR-OM44CustomBoard, VAR-SOM-OM44 WLAN 및 LCD 터치 스크린을 갖춘 상용 개발 키트
  compatible = "variscite,var-dvk-om44", "variscite,var-som-om44", "ti,omap4460", "ti,omap4";

- OMAP3 EVM : Software Development Board for OMAP35x, AM/DM37x
		//OMAP35x, AM / DM37x 용 소프트웨어 개발 보드
  compatible = "ti,omap3-evm", "ti,omap3"

- AM335X EVM : Software Development Board for AM335x
		// AM335x 용 소프트웨어 개발 보드
  compatible = "ti,am335x-evm", "ti,am33xx", "ti,omap3"

- AM335X Bone : Low cost community board
		//저비용 커뮤니티 보드
  compatible = "ti,am335x-bone", "ti,am33xx", "ti,omap3"

- AM335X OrionLXm : Substation Automation Platform
		//변전소 자동화 플랫폼
  compatible = "novatech,am335x-lxm", "ti,am33xx"

- AM335X phyBOARD-WEGA: Single Board Computer dev kit
			//싱글 보드 컴퓨터 개발 키트
  compatible = "phytec,am335x-wega", "phytec,am335x-phycore-som", "ti,am33xx"

- OMAP5 EVM : Evaluation Module
		// 평가 모듈
  compatible = "ti,omap5-evm", "ti,omap5"

- AM43x EPOS EVM
  compatible = "ti,am43x-epos-evm", "ti,am43", "ti,am438x"

- AM437x GP EVM
  compatible = "ti,am437x-gp-evm", "ti,am4372", "ti,am43"

- AM437x SK EVM: AM437x StarterKit Evaluation Module
		//AM437x StarterKit 평가 모듈
  compatible = "ti,am437x-sk-evm", "ti,am4372", "ti,am43"

- AM5728 GPEVM
  compatible = "ti,am5728-evm", "ti,am5728", "ti,dra742", "ti,dra74", "ti,dra7"

- AM5728 IDK
  compatible = "ti,am5728-idk", "ti,am5728", "ti,dra742", "ti,dra74", "ti,dra7"

- AM5718 IDK
  compatible = "ti,am5718-idk", "ti,am5728", "ti,dra742", "ti,dra74", "ti,dra7"

- DRA742 EVM:  Software Development Board for DRA742
  compatible = "ti,dra7-evm", "ti,dra742", "ti,dra74", "ti,dra7"

- DRA722 EVM: Software Development Board for DRA722
  compatible = "ti,dra72-evm", "ti,dra722", "ti,dra72", "ti,dra7"

- DRA718 EVM: Software Development Board for DRA718
  compatible = "ti,dra718-evm", "ti,dra718", "ti,dra722", "ti,dra72", "ti,dra7"
```

## Doc/DeviceDriver/devicetree/bindings/arm/omap/prcm.txt
```
OMAP PRCM bindings

Power Reset and Clock Manager lists the device clocks and clockdomains under
a DT hierarchy. Each TI SoC can have multiple PRCM entities listed for it,
each describing one module and the clock hierarchy under it. see [1] for
documentation about the individual clock/clockdomain nodes.
//전원 리셋 및 클럭 관리자는 DT 계층 구조 아래에 장치 클럭 및 클록 도메인을 나열합니다.
 각 TI SoC는 여러 개의 PRCM 엔티티를 나열 할 수 있으며 각 엔티티는 하나의 모듈과 그 아래의 클럭 계층을 설명합니다. 
클럭 / 클럭 도메인 노드에 대한 문서는 [1]을 참조하십시오.

[1] Documentation/devicetree/bindings/clock/ti/*

Required properties:
- compatible:	Must be one of:
		"ti,am3-prcm"
		"ti,am4-prcm"
		"ti,omap2-prcm"
		"ti,omap3-prm"
		"ti,omap3-cm"
		"ti,omap4-cm1"
		"ti,omap4-prm"
		"ti,omap4-cm2"
		"ti,omap4-scrm"
		"ti,omap5-prm"
		"ti,omap5-cm-core-aon"
		"ti,omap5-scrm"
		"ti,omap5-cm-core"
		"ti,dra7-prm"
		"ti,dra7-cm-core-aon"
		"ti,dra7-cm-core"
		"ti,dm814-prcm"
		"ti,dm816-prcm"
- reg:		Contains PRCM module register address range
		(base address and length)
- clocks:	clocks for this module
- clockdomains:	clockdomains for this module

Example:

cm: cm@48004000 {
	compatible = "ti,omap3-cm";
	reg = <0x48004000 0x4000>;

	cm_clocks: clocks {
		#address-cells = <1>;
		#size-cells = <0>;
	};

	cm_clockdomains: clockdomains {
	};
}

&cm_clocks {
	omap2_32k_fck: omap_32k_fck {
		#clock-cells = <0>;
		compatible = "fixed-clock";
		clock-frequency = <32768>;
	};
};

&cm_clockdomains {
	core_l3_clkdm: core_l3_clkdm {
		compatible = "ti,clockdomain";
		clocks = <&sdrc_ick>;
	};
};
```

## Doc/DeviceDriver/devicetree/bindings/arm/omap/timer.txt
```
OMAP Timer bindings

Required properties:
- compatible:		Should be set to one of the below. Please note that
			OMAP44xx devices have timer instances that are 100%
			register compatible with OMAP3xxx devices as well as
			newer timers that are not 100% register compatible.
			So for OMAP44xx devices timer instances may use
			different compatible strings.
			//필수 속성 :
			- 호환 : 다음 중 하나로 설정해야합니다.
			 OMAP44xx 디바이스는 OMAP3xxx 디바이스와 100 % 레지스터 호환이 가능한 타이머 인스턴스와 100 % 레지스터와 호환되지 않는 최신 타이머를 가지고 있습니다.
			따라서 OMAP44xx 디바이스의 경우 타이머 인스턴스가 서로 다른 호환 가능한 문자열을 사용할 수 있습니다.

			ti,omap2420-timer (applicable to OMAP24xx devices)
			ti,omap3430-timer (applicable to OMAP3xxx/44xx devices)
			ti,omap4430-timer (applicable to OMAP44xx devices)
			ti,omap5430-timer (applicable to OMAP543x devices)
			ti,am335x-timer	(applicable to AM335x devices)
			ti,am335x-timer-1ms (applicable to AM335x devices)

- reg:			Contains timer register address range (base address and
			length).
- interrupts: 		Contains the interrupt information for the timer. The
			format is being dependent on which interrupt controller
			the OMAP device uses.
- ti,hwmods:		Name of the hwmod associated to the timer, "timer<X>",
			where <X> is the instance number of the timer from the
			HW spec.
//- reg : 타이머 레지스터 주소 범위 (기본 주소 및 길이)를 포함합니다.
- interrupts : 타이머에 대한 인터럽트 정보를 포함합니다. 형식은 OMAP 장치가 사용하는 인터럽트 컨트롤러에 따라 다릅니다.
- ti, hwmods : 타이머에 연결된 hwmod의 이름 인 "timer <X>"입니다. 여기서 <X>는 HW 사양의 타이머 인스턴스 번호입니다.

Optional properties:
- ti,timer-alwon:	Indicates the timer is in an alway-on power domain.
- ti,timer-dsp:		Indicates the timer can interrupt the on-chip DSP in
			addition to the ARM CPU.
- ti,timer-pwm: 	Indicates the timer can generate a PWM output.
- ti,timer-secure: 	Indicates the timer is reserved on a secure OMAP device
			and therefore cannot be used by the kernel.
//선택적 속성 :
- ti, timer-alwon : 타이머가 alway-on power 도메인에 있음을 나타냅니다.
- ti, timer-dsp : 타이머가 ARM CPU 외에도 온칩 DSP를 인터럽트 할 수 있음을 나타냅니다.
- ti, timer-pwm : 타이머가 PWM 출력을 생성 할 수 있음을 나타냅니다.
- ti, timer-secure : 타이머가 보안 OMAP 장치에 예약되어있어 커널에서 사용할 수 없음을 나타냅니다.

Example:

timer12: timer@48304000 {
	compatible = "ti,omap3430-timer";
	reg = <0x48304000 0x400>;
	interrupts = <95>;
	ti,hwmods = "timer12"
	ti,timer-alwon;
	ti,timer-secure;
};
```

## Doc/DeviceDriver/devicetree/bindings/armada/marvell,dove-lcd.txt
```
Device Tree bindings for Armada DRM CRTC driver

Required properties:
 - compatible: value should be "marvell,dove-lcd".
 - reg: base address and size of the LCD controller
 - interrupts: single interrupt number for the LCD controller
 - port: video output port with endpoints, as described by graph.txt

Optional properties:

 - clocks: as described by clock-bindings.txt
 - clock-names: as described by clock-bindings.txt
	"axiclk" - axi bus clock for pixel clock
	"plldivider" - pll divider clock for pixel clock
	"ext_ref_clk0" - external clock 0 for pixel clock
	"ext_ref_clk1" - external clock 1 for pixel clock

Note: all clocks are optional but at least one must be specified.
Further clocks may be added in the future according to requirements of
different SoCs.

Example:

	lcd0: lcd-controller@820000 {
		compatible = "marvell,dove-lcd";
		reg = <0x820000 0x1000>;
		interrupts = <47>;
		clocks = <&si5351 0>;
		clock-names = "ext_ref_clk_1";
	};


/*
Armada DRM CRTC 드라이버의 장치 트리 바인딩

필요한 속성 :
- 호환성 : 값은 "marvell, dove-lcd"로해야합니다.
- reg : LCD 컨트롤러의 기본 주소와 크기
- 인터럽트 : LCD 컨트롤러 단일 인터럽트 번호
- port : graph.txt에서 설명 된 엔드 포인트의 비디오 출력 포트

옵션 속성 :

- clocks : clock-bindings.txt에 설명 된대로
- clock-names : clock-bindings.txt에 설명 된대로
"axiclk"- 픽셀 클럭 axi 버스 클럭
"plldivider"- 픽셀 클럭 용 PLL 분할기 시계
"ext_ref_clk0"- 픽셀 클럭을위한 외부 클럭 0
"ext_ref_clk1"- 픽셀 클럭을위한 외부 클럭 1

참고 : 모든 클럭은 선택 사항이지만 적어도 하나를 지정해야합니다.

다른 SoC의 요구사항에 따라 나중에 클록을 추가할 수도 있다.
*/
```
