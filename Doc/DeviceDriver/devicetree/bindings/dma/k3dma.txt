## Doc/DeviceDriver/devicetree/bindings/dma/nbpfaxi.txt
```
* Renesas "Type-AXI" NBPFAXI* DMA controllers

* DMA controller

Required properties

- compatible:	must be one of
		"renesas,nbpfaxi64dmac1b4"
		"renesas,nbpfaxi64dmac1b8"
		"renesas,nbpfaxi64dmac1b16"
		"renesas,nbpfaxi64dmac4b4"
		"renesas,nbpfaxi64dmac4b8"
		"renesas,nbpfaxi64dmac4b16"
		"renesas,nbpfaxi64dmac8b4"
		"renesas,nbpfaxi64dmac8b8"
		"renesas,nbpfaxi64dmac8b16"
- #dma-cells:	must be 2: the first integer is a terminal number, to which this
		slave is connected, the second one is flags. Flags is a bitmask
		with the following bits defined:

#define NBPF_SLAVE_RQ_HIGH	1
#define NBPF_SLAVE_RQ_LOW	2
#define NBPF_SLAVE_RQ_LEVEL	4

Optional properties:

You can use dma-channels and dma-requests as described in dma.txt, although they
won't be used, this information is derived from the compatibility string.

Example:

	dma: dma-controller@48000000 {
		compatible = "renesas,nbpfaxi64dmac8b4";
		reg = <0x48000000 0x400>;
		interrupts = <0 12 0x4
			      0 13 0x4
			      0 14 0x4
			      0 15 0x4
			      0 16 0x4
			      0 17 0x4
			      0 18 0x4
			      0 19 0x4>;
		#dma-cells = <2>;
		dma-channels = <8>;
		dma-requests = <8>;
	};

* DMA client

Required properties:

dmas and dma-names are required, as described in dma.txt.

Example:

#include <dt-bindings/dma/nbpfaxi.h>

...
		dmas = <&dma 0 (NBPF_SLAVE_RQ_HIGH | NBPF_SLAVE_RQ_LEVEL)
			&dma 1 (NBPF_SLAVE_RQ_HIGH | NBPF_SLAVE_RQ_LEVEL)>;
		dma-names = "rx", "tx";








/*

* 르네사스 "Type-AXI"NBPFAXI * DMA 컨트롤러

* DMA 컨트롤러

필수 속성

- 호환 가능 : 다음 중 하나 여야합니다.
"Renesas, nbpfaxi64dmac1b4"
"renesas, nbpfaxi64dmac1b8"
"renesas, nbpfaxi64dmac1b16"
"renesas, nbpfaxi64dmac4b4"
"renesas, nbpfaxi64dmac4b8"
"renesas, nbpfaxi64dmac4b16"
"renesas, nbpfaxi64dmac8b4"
"renesas, nbpfaxi64dmac8b8"
"renesas, nbpfaxi64dmac8b16"
- # dma-cells : 2이어야합니다 : 첫 번째 정수는이 슬레이브가 연결된 터미널 번호이며, 두 번째는 플래그입니다. Flags는 다음 비트가 정의 된 비트 마스크입니다.

#define NBPF_SLAVE_RQ_HIGH 1
#define NBPF_SLAVE_RQ_LOW 2
#define NBPF_SLAVE_RQ_LEVEL 4

선택적 속성 :

dma.txt에 설명 된대로 dma-channels 및 dma-request를 사용할 수 있지만 사용되지는 않지만 호환성 문자열에서 파생됩니다.

Example:

	dma: dma-controller@48000000 {
		compatible = "renesas,nbpfaxi64dmac8b4";
		reg = <0x48000000 0x400>;
		interrupts = <0 12 0x4
			      0 13 0x4
			      0 14 0x4
			      0 15 0x4
			      0 16 0x4
			      0 17 0x4
			      0 18 0x4
			      0 19 0x4>;
		#dma-cells = <2>;
		dma-channels = <8>;
		dma-requests = <8>;
	};


* DMA 클라이언트

필수 속성 :

dma.txt에 설명 된대로 dmas 및 dma-names가 필요합니다.

Example:

#include <dt-bindings/dma/nbpfaxi.h>

...
		dmas = <&dma 0 (NBPF_SLAVE_RQ_HIGH | NBPF_SLAVE_RQ_LEVEL)
			&dma 1 (NBPF_SLAVE_RQ_HIGH | NBPF_SLAVE_RQ_LEVEL)>;
		dma-names = "rx", "tx";

*/
```

## Doc/DeviceDriver/devicetree/bindings/dma/qcom_adm.txt
```
QCOM ADM DMA Controller

Required properties:
- compatible: must contain "qcom,adm" for IPQ/APQ8064 and MSM8960
- reg: Address range for DMA registers
- interrupts: Should contain one interrupt shared by all channels
- #dma-cells: must be <2>.  First cell denotes the channel number.  Second cell
  denotes CRCI (client rate control interface) flow control assignment.
- clocks: Should contain the core clock and interface clock.
- clock-names: Must contain "core" for the core clock and "iface" for the
  interface clock.
- resets: Must contain an entry for each entry in reset names.
- reset-names: Must include the following entries:
  - clk
  - c0
  - c1
  - c2
- qcom,ee: indicates the security domain identifier used in the secure world.

Example:
		adm_dma: dma@18300000 {
			compatible = "qcom,adm";
			reg = <0x18300000 0x100000>;
			interrupts = <0 170 0>;
			#dma-cells = <2>;

			clocks = <&gcc ADM0_CLK>, <&gcc ADM0_PBUS_CLK>;
			clock-names = "core", "iface";

			resets = <&gcc ADM0_RESET>,
				<&gcc ADM0_C0_RESET>,
				<&gcc ADM0_C1_RESET>,
				<&gcc ADM0_C2_RESET>;
			reset-names = "clk", "c0", "c1", "c2";
			qcom,ee = <0>;
		};

DMA clients must use the format descripted in the dma.txt file, using a three
cell specifier for each channel.

Each dmas request consists of 3 cells:
 1. phandle pointing to the DMA controller
 2. channel number
 3. CRCI assignment, if applicable.  If no CRCI flow control is required, use 0.
    The CRCI is used for flow control.  It identifies the peripheral device that
    is the source/destination for the transferred data.

Example:

	spi4: spi@1a280000 {
		status = "ok";
		spi-max-frequency = <50000000>;

		pinctrl-0 = <&spi_pins>;
		pinctrl-names = "default";

		cs-gpios = <&qcom_pinmux 20 0>;

		dmas = <&adm_dma 6 9>,
			<&adm_dma 5 10>;
		dma-names = "rx", "tx";
	};




/*

QCOM ADM DMA 컨트롤러

필수 속성 :
- 호환 가능 : IPQ / APQ8064 및 MSM8960의 경우 "qcom, adm"을 포함해야합니다.
- reg : DMA 레지스터의 주소 범위
- interrupts : 모든 채널이 공유하는 하나의 인터럽트를 포함해야합니다.
- # dma-cells : <2> 여야합니다. 첫 번째 셀은 채널 번호를 나타냅니다. 두 번째 셀은 CRCI (클라이언트 속도 제어 인터페이스) 흐름 제어 할당을 나타냅니다.
- 클럭 : 코어 클럭 및 인터페이스 클럭을 포함해야합니다.
- clock-names : 코어 클럭의 경우 "core"를, 코어 클럭의 경우 "iface"를 포함해야합니다.
  인터페이스 클럭.
- 재설정 : 재설정 이름의 각 항목에 대한 항목을 포함해야합니다.
- reset-names : 다음 항목을 포함해야합니다.
  - clk
  - c0
  - c1
  - c2
- qcom, ee : 보안 세계에서 사용되는 보안 도메인 식별자를 나타냅니다.

Example:
		adm_dma: dma@18300000 {
			compatible = "qcom,adm";
			reg = <0x18300000 0x100000>;
			interrupts = <0 170 0>;
			#dma-cells = <2>;

			clocks = <&gcc ADM0_CLK>, <&gcc ADM0_PBUS_CLK>;
			clock-names = "core", "iface";

			resets = <&gcc ADM0_RESET>,
				<&gcc ADM0_C0_RESET>,
				<&gcc ADM0_C1_RESET>,
				<&gcc ADM0_C2_RESET>;
			reset-names = "clk", "c0", "c1", "c2";
			qcom,ee = <0>;
		};

DMA 클라이언트는 각 채널에 대해 세 개의 셀 지정자를 사용하여 dma.txt 파일에 설명 된 형식을 사용해야합니다.

각 dmas 요청은 세 개의 셀로 구성됩니다.
 1. DMA 컨트롤러를 가리키는 phandle
 2. 채널 번호
 3. 적용 가능한 경우 CRCI 할당. CRCI 흐름 제어가 필요하지 않으면 0을 사용하십시오.
    CRCI는 흐름 제어에 사용됩니다. 전송 된 데이터의 소스 / 목적지 인 주변 장치를 식별합니다.

Example:

	spi4: spi@1a280000 {
		status = "ok";
		spi-max-frequency = <50000000>;

		pinctrl-0 = <&spi_pins>;
		pinctrl-names = "default";

		cs-gpios = <&qcom_pinmux 20 0>;

		dmas = <&adm_dma 6 9>,
			<&adm_dma 5 10>;
		dma-names = "rx", "tx";
	};

*/
```

## Doc/DeviceDriver/devicetree/bindings/dma/qcom_bam_dma.txt
```
QCOM BAM DMA controller

Required properties:
- compatible: must be one of the following:
 * "qcom,bam-v1.4.0" for MSM8974, APQ8074 and APQ8084
 * "qcom,bam-v1.3.0" for APQ8064, IPQ8064 and MSM8960
 * "qcom,bam-v1.7.0" for MSM8916
- reg: Address range for DMA registers
- interrupts: Should contain the one interrupt shared by all channels
- #dma-cells: must be <1>, the cell in the dmas property of the client device
  represents the channel number
- clocks: required clock
- clock-names: must contain "bam_clk" entry
- qcom,ee : indicates the active Execution Environment identifier (0-7) used in
  the secure world.

Example:

	uart-bam: dma@f9984000 = {
		compatible = "qcom,bam-v1.4.0";
		reg = <0xf9984000 0x15000>;
		interrupts = <0 94 0>;
		clocks = <&gcc GCC_BAM_DMA_AHB_CLK>;
		clock-names = "bam_clk";
		#dma-cells = <1>;
		qcom,ee = <0>;
	};

DMA clients must use the format described in the dma.txt file, using a two cell
specifier for each channel.

Example:
	serial@f991e000 {
		compatible = "qcom,msm-uart";
		reg = <0xf991e000 0x1000>
			<0xf9944000 0x19000>;
		interrupts = <0 108 0>;
		clocks = <&gcc GCC_BLSP1_UART2_APPS_CLK>,
			<&gcc GCC_BLSP1_AHB_CLK>;
		clock-names = "core", "iface";

		dmas = <&uart-bam 0>, <&uart-bam 1>;
		dma-names = "rx", "tx";
	};

/*
QCOM BAM DMA 컨트롤러

필수 속성 :
- compatible : 다음 중 하나 여야합니다.
 * MSQ8974, APQ8074 및 APQ8084의 경우 "qcom, bam-v1.4.0"
 * APQ8064, IPQ8064 및 MSM8960의 경우 "qcom, bam-v1.3.0"
 * MSM8916의 경우 "qcom, bam-v1.7.0"
- reg : DMA 레지스터의 주소 범위
- interrupts : 모든 채널이 공유하는 하나의 interrupt를 포함해야합니다.
- # dma-cells : <1>이어야하며 클라이언트 장치의 dmas 속성에있는 셀은 채널 번호를 나타냅니다
- clock : 필수 clock
- clock-names : "bam_clk"항목을 포함해야합니다.
- qcom, ee : 보안 세계에서 사용되는 활성 실행 환경 식별자 (0-7)를 나타냅니다.

Example:

	uart-bam: dma@f9984000 = {
		compatible = "qcom,bam-v1.4.0";
		reg = <0xf9984000 0x15000>;
		interrupts = <0 94 0>;
		clocks = <&gcc GCC_BAM_DMA_AHB_CLK>;
		clock-names = "bam_clk";
		#dma-cells = <1>;
		qcom,ee = <0>;
	};

DMA 클라이언트는 각 채널에 대해 2 개의 셀 지정자를 사용하여 dma.txt 파일에 설명 된 형식을 사용해야합니다.

Example:
	serial@f991e000 {
		compatible = "qcom,msm-uart";
		reg = <0xf991e000 0x1000>
			<0xf9944000 0x19000>;
		interrupts = <0 108 0>;
		clocks = <&gcc GCC_BLSP1_UART2_APPS_CLK>,
			<&gcc GCC_BLSP1_AHB_CLK>;
		clock-names = "core", "iface";

		dmas = <&uart-bam 0>, <&uart-bam 1>;
		dma-names = "rx", "tx";
	};

*/
```

## Doc/DeviceDriver/devicetree/bindings/dma/renesas,rcar-dmac.txt
```
* Renesas R-Car DMA Controller Device Tree bindings

Renesas R-Car Generation 2 SoCs have multiple multi-channel DMA
controller instances named DMAC capable of serving multiple clients. Channels
can be dedicated to specific clients or shared between a large number of
clients.

Each DMA client is connected to one dedicated port of the DMAC, identified by
an 8-bit port number called the MID/RID. A DMA controller can thus serve up to
256 clients in total. When the number of hardware channels is lower than the
number of clients to be served, channels must be shared between multiple DMA
clients. The association of DMA clients to DMAC channels is fully dynamic and
not described in these device tree bindings.

Required Properties:

- compatible: must contain "renesas,rcar-dmac"

- reg: base address and length of the registers block for the DMAC

- interrupts: interrupt specifiers for the DMAC, one for each entry in
  interrupt-names.
- interrupt-names: one entry per channel, named "ch%u", where %u is the
  channel number ranging from zero to the number of channels minus one.

- clock-names: "fck" for the functional clock
- clocks: a list of phandle + clock-specifier pairs, one for each entry
  in clock-names.
- clock-names: must contain "fck" for the functional clock.

- #dma-cells: must be <1>, the cell specifies the MID/RID of the DMAC port
  connected to the DMA client
- dma-channels: number of DMA channels

Example: R8A7790 (R-Car H2) SYS-DMACs

	dmac0: dma-controller@e6700000 {
		compatible = "renesas,rcar-dmac";
		reg = <0 0xe6700000 0 0x20000>;
		interrupts = <0 197 IRQ_TYPE_LEVEL_HIGH
			      0 200 IRQ_TYPE_LEVEL_HIGH
			      0 201 IRQ_TYPE_LEVEL_HIGH
			      0 202 IRQ_TYPE_LEVEL_HIGH
			      0 203 IRQ_TYPE_LEVEL_HIGH
			      0 204 IRQ_TYPE_LEVEL_HIGH
			      0 205 IRQ_TYPE_LEVEL_HIGH
			      0 206 IRQ_TYPE_LEVEL_HIGH
			      0 207 IRQ_TYPE_LEVEL_HIGH
			      0 208 IRQ_TYPE_LEVEL_HIGH
			      0 209 IRQ_TYPE_LEVEL_HIGH
			      0 210 IRQ_TYPE_LEVEL_HIGH
			      0 211 IRQ_TYPE_LEVEL_HIGH
			      0 212 IRQ_TYPE_LEVEL_HIGH
			      0 213 IRQ_TYPE_LEVEL_HIGH
			      0 214 IRQ_TYPE_LEVEL_HIGH>;
		interrupt-names = "error",
				"ch0", "ch1", "ch2", "ch3",
				"ch4", "ch5", "ch6", "ch7",
				"ch8", "ch9", "ch10", "ch11",
				"ch12", "ch13", "ch14";
		clocks = <&mstp2_clks R8A7790_CLK_SYS_DMAC0>;
		clock-names = "fck";
		#dma-cells = <1>;
		dma-channels = <15>;
	};

	dmac1: dma-controller@e6720000 {
		compatible = "renesas,rcar-dmac";
		reg = <0 0xe6720000 0 0x20000>;
		interrupts = <0 220 IRQ_TYPE_LEVEL_HIGH
			      0 216 IRQ_TYPE_LEVEL_HIGH
			      0 217 IRQ_TYPE_LEVEL_HIGH
			      0 218 IRQ_TYPE_LEVEL_HIGH
			      0 219 IRQ_TYPE_LEVEL_HIGH
			      0 308 IRQ_TYPE_LEVEL_HIGH
			      0 309 IRQ_TYPE_LEVEL_HIGH
			      0 310 IRQ_TYPE_LEVEL_HIGH
			      0 311 IRQ_TYPE_LEVEL_HIGH
			      0 312 IRQ_TYPE_LEVEL_HIGH
			      0 313 IRQ_TYPE_LEVEL_HIGH
			      0 314 IRQ_TYPE_LEVEL_HIGH
			      0 315 IRQ_TYPE_LEVEL_HIGH
			      0 316 IRQ_TYPE_LEVEL_HIGH
			      0 317 IRQ_TYPE_LEVEL_HIGH
			      0 318 IRQ_TYPE_LEVEL_HIGH>;
		interrupt-names = "error",
				"ch0", "ch1", "ch2", "ch3",
				"ch4", "ch5", "ch6", "ch7",
				"ch8", "ch9", "ch10", "ch11",
				"ch12", "ch13", "ch14";
		clocks = <&mstp2_clks R8A7790_CLK_SYS_DMAC1>;
		clock-names = "fck";
		#dma-cells = <1>;
		dma-channels = <15>;
	};

/*
* Renesas R-Car DMA 컨트롤러 디바이스 트리 바인딩

Renesas R-Car Generation 2 SoC에는 다중 채널 DMA가 있습니다.
여러 클라이언트를 지원할 수있는 DMAC라는 컨트롤러 인스턴스 채널은 특정 클라이언트 전용이거나 많은 수의 클라이언트간에 공유 될 수 있습니다.

각 DMA 클라이언트는 MID / RID라고하는 8 비트 포트 번호로 식별되는 DMAC의 하나의 전용 포트에 연결됩니다. 따라서 DMA 컨트롤러는 총 256 개의 클라이언트를 지원할 수 있습니다. 하드웨어 채널 수가 서비스 대상 클라이언트 수보다 낮은 경우 여러 DMA 클라이언트간에 채널을 공유해야합니다. DMAC 채널에 대한 DMA 클라이언트의 연관성은 완전히 동적이며 이러한 장치 트리 바인딩에는 설명되어 있지 않습니다.

필수 등록 정보 :

- compatible : "renesas, rcar-dmac"를 포함해야합니다.

- reg : DMAC에 대한 레지스터 블록의 기본 주소 및 길이

- 인터럽트 : 인터럽트 이름의 각 항목에 대해 하나씩, DMAC에 대한 인터럽트 지정자입니다.
- interrupt-names : "ch % u"라는 이름의 채널 당 하나의 항목. 여기서 % u는 0에서 채널 수에서 1을 뺀 범위의 채널 번호입니다.

- 시계 이름 : 기능 시계의 경우 "fck"
- clocks : clock-names의 각 항목에 대해 하나씩 phandle + clock-specifier 쌍의 목록입니다.
- clock-names : 기능 클럭에 "fck"를 포함해야합니다.

- # dma-cells : <1>이어야하며, 셀은 DMA 클라이언트에 연결된 DMAC 포트의 MID / RID를 지정합니다
- dma-channels : DMA 채널 수



Example: R8A7790 (R-Car H2) SYS-DMACs

	dmac0: dma-controller@e6700000 {
		compatible = "renesas,rcar-dmac";
		reg = <0 0xe6700000 0 0x20000>;
		interrupts = <0 197 IRQ_TYPE_LEVEL_HIGH
			      0 200 IRQ_TYPE_LEVEL_HIGH
			      0 201 IRQ_TYPE_LEVEL_HIGH
			      0 202 IRQ_TYPE_LEVEL_HIGH
			      0 203 IRQ_TYPE_LEVEL_HIGH
			      0 204 IRQ_TYPE_LEVEL_HIGH
			      0 205 IRQ_TYPE_LEVEL_HIGH
			      0 206 IRQ_TYPE_LEVEL_HIGH
			      0 207 IRQ_TYPE_LEVEL_HIGH
			      0 208 IRQ_TYPE_LEVEL_HIGH
			      0 209 IRQ_TYPE_LEVEL_HIGH
			      0 210 IRQ_TYPE_LEVEL_HIGH
			      0 211 IRQ_TYPE_LEVEL_HIGH
			      0 212 IRQ_TYPE_LEVEL_HIGH
			      0 213 IRQ_TYPE_LEVEL_HIGH
			      0 214 IRQ_TYPE_LEVEL_HIGH>;
		interrupt-names = "error",
				"ch0", "ch1", "ch2", "ch3",
				"ch4", "ch5", "ch6", "ch7",
				"ch8", "ch9", "ch10", "ch11",
				"ch12", "ch13", "ch14";
		clocks = <&mstp2_clks R8A7790_CLK_SYS_DMAC0>;
		clock-names = "fck";
		#dma-cells = <1>;
		dma-channels = <15>;
	};

	dmac1: dma-controller@e6720000 {
		compatible = "renesas,rcar-dmac";
		reg = <0 0xe6720000 0 0x20000>;
		interrupts = <0 220 IRQ_TYPE_LEVEL_HIGH
			      0 216 IRQ_TYPE_LEVEL_HIGH
			      0 217 IRQ_TYPE_LEVEL_HIGH
			      0 218 IRQ_TYPE_LEVEL_HIGH
			      0 219 IRQ_TYPE_LEVEL_HIGH
			      0 308 IRQ_TYPE_LEVEL_HIGH
			      0 309 IRQ_TYPE_LEVEL_HIGH
			      0 310 IRQ_TYPE_LEVEL_HIGH
			      0 311 IRQ_TYPE_LEVEL_HIGH
			      0 312 IRQ_TYPE_LEVEL_HIGH
			      0 313 IRQ_TYPE_LEVEL_HIGH
			      0 314 IRQ_TYPE_LEVEL_HIGH
			      0 315 IRQ_TYPE_LEVEL_HIGH
			      0 316 IRQ_TYPE_LEVEL_HIGH
			      0 317 IRQ_TYPE_LEVEL_HIGH
			      0 318 IRQ_TYPE_LEVEL_HIGH>;
		interrupt-names = "error",
				"ch0", "ch1", "ch2", "ch3",
				"ch4", "ch5", "ch6", "ch7",
				"ch8", "ch9", "ch10", "ch11",
				"ch12", "ch13", "ch14";
		clocks = <&mstp2_clks R8A7790_CLK_SYS_DMAC1>;
		clock-names = "fck";
		#dma-cells = <1>;
		dma-channels = <15>;
	};

*/
```
