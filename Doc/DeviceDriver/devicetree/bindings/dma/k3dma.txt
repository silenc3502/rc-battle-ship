## Doc/DeviceDriver/devicetree/bindings/dma/xilinx/xilinx_dma.txt
```
Xilinx AXI DMA engine, it does transfers between memory and AXI4 stream
target devices. It can be configured to have one channel or two channels.
If configured as two channels, one is to transmit to the device and another
is to receive from the device.

Required properties:
- compatible: Should be "xlnx,axi-dma-1.00.a"
- #dma-cells: Should be <1>, see "dmas" property below
- reg: Should contain DMA registers location and length.
- dma-channel child node: Should have atleast one channel and can have upto
	two channels per device. This node specifies the properties of each
	DMA channel (see child node properties below).

Optional properties:
- xlnx,include-sg: Tells whether configured for Scatter-mode in
	the hardware.

Required child node properties:
- compatible: It should be either "xlnx,axi-dma-mm2s-channel" or
	"xlnx,axi-dma-s2mm-channel".
- interrupts: Should contain per channel DMA interrupts.
- xlnx,datawidth: Should contain the stream data width, take values
	{32,64...1024}.

Option child node properties:
- xlnx,include-dre: Tells whether hardware is configured for Data
	Realignment Engine.

Example:
++++++++

axi_dma_0: axidma@40400000 {
	compatible = "xlnx,axi-dma-1.00.a";
	#dma_cells = <1>;
	reg = < 0x40400000 0x10000 >;
	dma-channel@40400000 {
		compatible = "xlnx,axi-dma-mm2s-channel";
		interrupts = < 0 59 4 >;
		xlnx,datawidth = <0x40>;
	} ;
	dma-channel@40400030 {
		compatible = "xlnx,axi-dma-s2mm-channel";
		interrupts = < 0 58 4 >;
		xlnx,datawidth = <0x40>;
	} ;
} ;


* DMA client

Required properties:
- dmas: a list of <[DMA device phandle] [Channel ID]> pairs,
	where Channel ID is '0' for write/tx and '1' for read/rx
	channel.
- dma-names: a list of DMA channel names, one per "dmas" entry

Example:
++++++++

dmatest_0: dmatest@0 {
	compatible ="xlnx,axi-dma-test-1.00.a";
	dmas = <&axi_dma_0 0
		&axi_dma_0 1>;
	dma-names = "dma0", "dma1";
} ;

/*
Xilinx AXI DMA 浚柳篮 皋葛府客 AXI4 胶飘覆 措惑 Device 荤捞甫 傈价钦聪促. 窍唱狼 盲澄 肚绰 滴 俺狼 盲澄阑 爱档废 备己 且 荐 乐嚼聪促.
滴 俺狼 盲澄肺 备己等 版快 窍唱绰 Device肺 傈价窍绊 促弗 窍唱绰 Device俊辑 荐脚钦聪促.

鞘荐 加己 :
- 龋券 : "xlnx, axi-dma-1.00.a"咯具钦聪促.
- # dma-cells : <1>捞绢具窍哥 酒贰狼 "dmas"加己 曼炼
- reg : DMA 饭瘤胶磐 困摹客 辨捞甫 器窃秦具钦聪促.
- dma-channel 磊侥 畴靛 : 利绢档 窍唱狼 盲澄阑 啊廉具窍哥 Device 寸 滴 俺狼 盲澄阑 啊龙 荐 乐嚼聪促. 捞 畴靛绰 阿 DMA 盲澄狼 加己阑 瘤沥钦聪促 (酒贰狼 窍困 畴靛 加己 曼炼).

急琶利 加己 :
- xlnx, include-sg : 窍靛傀绢俊辑 胶 某磐 葛靛肺 备己登菌绰瘤 咯何甫 犬牢钦聪促.

鞘荐 磊侥 畴靛 殿废 沥焊 :
- compatible : "xlnx, axi-dma-mm2s-channel"肚绰 "xlnx, axi-dma-s2mm-channel"吝 窍唱 咯具钦聪促.
- 牢磐反飘 : 盲澄 寸 DMA 牢磐反飘甫 器窃秦具钦聪促.
- xlnx, datawidth : 胶飘覆 单捞磐 气阑 器窃秦具窍哥 蔼篮 {32,64 ... 1024}涝聪促.

可记 窍困 畴靛 殿废 沥焊 :
- xlnx, include-dre : 窍靛傀绢啊 Data Arrangement Engine 侩栏肺 备己登菌绰瘤 咯何甫 犬牢钦聪促.


Example:
++++++++

axi_dma_0: axidma@40400000 {
	compatible = "xlnx,axi-dma-1.00.a";
	#dma_cells = <1>;
	reg = < 0x40400000 0x10000 >;
	dma-channel@40400000 {
		compatible = "xlnx,axi-dma-mm2s-channel";
		interrupts = < 0 59 4 >;
		xlnx,datawidth = <0x40>;
	} ;
	dma-channel@40400030 {
		compatible = "xlnx,axi-dma-s2mm-channel";
		interrupts = < 0 58 4 >;
		xlnx,datawidth = <0x40>;
	} ;
} ;

* DMA 努扼捞攫飘

鞘荐 加己 :
- dmas : <DMA device phandle> [盲澄 ID]> 街狼 格废,
咯扁辑 盲澄 ID绰 静扁 / tx狼 版快 '0'捞绊 佬扁 / rx 盲澄狼 版快 '1'涝聪促.
- dma-names : "dmas"亲格 寸 窍唱究狼 DMA 盲澄 捞抚 格废

Example:
++++++++

dmatest_0: dmatest@0 {
	compatible ="xlnx,axi-dma-test-1.00.a";
	dmas = <&axi_dma_0 0
		&axi_dma_0 1>;
	dma-names = "dma0", "dma1";
} ;


*/
```

## Doc/DeviceDriver/devicetree/bindings/dma/xilinx/xilinx_vdma.txt
```
Xilinx AXI VDMA engine, it does transfers between memory and video devices.
It can be configured to have one channel or two channels. If configured
as two channels, one is to transmit to the video device and another is
to receive from the video device.

Required properties:
- compatible: Should be "xlnx,axi-vdma-1.00.a"
- #dma-cells: Should be <1>, see "dmas" property below
- reg: Should contain VDMA registers location and length.
- xlnx,num-fstores: Should be the number of framebuffers as configured in h/w.
- dma-channel child node: Should have at least one channel and can have up to
	two channels per device. This node specifies the properties of each
	DMA channel (see child node properties below).

Optional properties:
- xlnx,include-sg: Tells configured for Scatter-mode in
	the hardware.
- xlnx,flush-fsync: Tells which channel to Flush on Frame sync.
	It takes following values:
	{1}, flush both channels
	{2}, flush mm2s channel
	{3}, flush s2mm channel

Required child node properties:
- compatible: It should be either "xlnx,axi-vdma-mm2s-channel" or
	"xlnx,axi-vdma-s2mm-channel".
- interrupts: Should contain per channel VDMA interrupts.
- xlnx,datawidth: Should contain the stream data width, take values
	{32,64...1024}.

Optional child node properties:
- xlnx,include-dre: Tells hardware is configured for Data
	Realignment Engine.
- xlnx,genlock-mode: Tells Genlock synchronization is
	enabled/disabled in hardware.

Example:
++++++++

axi_vdma_0: axivdma@40030000 {
	compatible = "xlnx,axi-vdma-1.00.a";
	#dma_cells = <1>;
	reg = < 0x40030000 0x10000 >;
	xlnx,num-fstores = <0x8>;
	xlnx,flush-fsync = <0x1>;
	dma-channel@40030000 {
		compatible = "xlnx,axi-vdma-mm2s-channel";
		interrupts = < 0 54 4 >;
		xlnx,datawidth = <0x40>;
	} ;
	dma-channel@40030030 {
		compatible = "xlnx,axi-vdma-s2mm-channel";
		interrupts = < 0 53 4 >;
		xlnx,datawidth = <0x40>;
	} ;
} ;


* DMA client

Required properties:
- dmas: a list of <[Video DMA device phandle] [Channel ID]> pairs,
	where Channel ID is '0' for write/tx and '1' for read/rx
	channel.
- dma-names: a list of DMA channel names, one per "dmas" entry

Example:
++++++++

vdmatest_0: vdmatest@0 {
	compatible ="xlnx,axi-vdma-test-1.00.a";
	dmas = <&axi_vdma_0 0
		&axi_vdma_0 1>;
	dma-names = "vdma0", "vdma1";
} ;

/*
Xilinx AXI VDMA 浚柳篮 皋葛府客 厚叼坷 厘摹 埃阑 傈价钦聪促.
窍唱狼 盲澄 肚绰 滴 俺狼 盲澄阑 爱档废 备己 且 荐 乐嚼聪促. 滴 俺狼 盲澄肺 备己等 版快 窍唱绰 厚叼坷 厘摹肺 傈价窍绊 促弗 窍唱绰 厚叼坷 厘摹俊辑 荐脚钦聪促.

鞘荐 加己 :
- 龋券 : "xlnx, axi-vdma-1.00.a"咯具钦聪促.
- # dma-cells : <1>捞绢具窍哥 酒贰狼 "dmas"加己 曼炼
- reg : VDMA 饭瘤胶磐 困摹客 辨捞甫 器窃秦具钦聪促.
- xlnx, num-fstores : h / w肺 备己等 橇饭烙 滚欺 荐 咯具钦聪促.
- dma-channel 磊侥 畴靛 : 利绢档 窍唱狼 盲澄捞 乐绢具窍哥 厘摹 寸 弥措 滴 俺狼 盲澄阑 啊龙 荐 乐嚼聪促. 

捞 畴靛绰 阿 DMA 盲澄狼 加己阑 瘤沥钦聪促 (酒贰狼 窍困 畴靛 加己 曼炼).

急琶利 加己 :
- xlnx, include-sg : 窍靛傀绢俊辑 胶 某磐 葛靛肺 备己邓聪促.
- xlnx, flush-fsync : 橇饭烙 教农俊辑 绢恫 盲澄阑 敲矾矫 且瘤甫 舅妨凛聪促.
促澜苞 鞍篮 蔼阑 秒钦聪促.
{1}, 滴 盲澄 葛滴 厚快扁
{2}, mm2s 盲澄 敲矾矫
{3}, s2mm 盲澄 敲矾矫

鞘荐 磊侥 畴靛 殿废 沥焊 :
- compatible : "xlnx, axi-vdma-mm2s-channel"肚绰 "xlnx, axi-vdma-s2mm-channel"吝 窍唱 咯具钦聪促.
- 牢磐反飘 : 盲澄 寸 VDMA 牢磐反飘甫 器窃秦具钦聪促.
- xlnx, datawidth : 胶飘覆 单捞磐 气阑 器窃秦具窍哥 蔼篮 {32,64 ... 1024}涝聪促.

急琶利 磊侥 畴靛 加己 :
- xlnx, include-dre : 窍靛傀绢啊 单捞磐 犁硅摹 浚柳 侩栏肺 备己登菌澜阑 唱鸥忱聪促.
- xlnx, genlock-mode : Genlock 悼扁拳啊 窍靛傀绢俊辑 劝己拳 / 厚劝己拳凳阑 唱鸥忱聪促.


Example:
++++++++

axi_vdma_0: axivdma@40030000 {
	compatible = "xlnx,axi-vdma-1.00.a";
	#dma_cells = <1>;
	reg = < 0x40030000 0x10000 >;
	xlnx,num-fstores = <0x8>;
	xlnx,flush-fsync = <0x1>;
	dma-channel@40030000 {
		compatible = "xlnx,axi-vdma-mm2s-channel";
		interrupts = < 0 54 4 >;
		xlnx,datawidth = <0x40>;
	} ;
	dma-channel@40030030 {
		compatible = "xlnx,axi-vdma-s2mm-channel";
		interrupts = < 0 53 4 >;
		xlnx,datawidth = <0x40>;
	} ;
} ;

* DMA 努扼捞攫飘

鞘荐 加己 :
- dmas : 盲澄 ID啊 静扁 / tx狼 版快 '0'捞绊 佬扁 / rx 盲澄狼 版快 '1'牢 <[Video DMA device phandle] [盲澄 ID]> 街狼 格废涝聪促.
- dma-names : "dmas"亲格 寸 窍唱究狼 DMA 盲澄 捞抚 格废

Example:
++++++++

vdmatest_0: vdmatest@0 {
	compatible ="xlnx,axi-vdma-test-1.00.a";
	dmas = <&axi_vdma_0 0
		&axi_vdma_0 1>;
	dma-names = "vdma0", "vdma1";
} ;

*/
```

## Doc/DeviceDriver/devicetree/bindings/dma/zxdma.txt
```
* ZTE ZX296702 DMA controller

Required properties:
- compatible: Should be "zte,zx296702-dma"
- reg: Should contain DMA registers location and length.
- interrupts: Should contain one interrupt shared by all channel
- #dma-cells: see dma.txt, should be 1, para number
- dma-channels: physical channels supported
- dma-requests: virtual channels supported, each virtual channel
		have specific request line
- clocks: clock required

Example:

Controller:
	dma: dma-controller@0x09c00000{
		compatible = "zte,zx296702-dma";
		reg = <0x09c00000 0x1000>;
		clocks = <&topclk ZX296702_DMA_ACLK>;
		interrupts = <GIC_SPI 66 IRQ_TYPE_LEVEL_HIGH>;
		#dma-cells = <1>;
		dma-channels = <24>;
		dma-requests = <24>;
	};

Client:
Use specific request line passing from dmax
For example, spdif0 tx channel request line is 4
	spdif0: spdif0@0b004000 {
		#sound-dai-cells = <0>;
		compatible = "zte,zx296702-spdif";
		reg = <0x0b004000 0x1000>;
		clocks = <&lsp0clk ZX296702_SPDIF0_DIV>;
		clock-names = "tx";
		interrupts = <GIC_SPI 21 IRQ_TYPE_LEVEL_HIGH>;
		dmas = <&dma 4>;
		dma-names = "tx";
	}


/*


* ZTE ZX296702 DMA 컨트롤러

필수 속성 :
- 호환 : "zte, zx296702-dma"이어야합니다.
- reg : DMA 레지스터 위치와 길이를 포함해야합니다.
- interrupts : 모든 채널이 공유하는 하나의 인터럽트를 포함해야합니다.
- # dma-cells : dma.txt를 참조하십시오. 1, para number 여야합니다.
- dma-channels : 지원되는 물리 채널
- dma-requests : 가상 채널 지원, 각 가상 채널은 특정 요청 라인
- clock : 필요한 클럭



Example:

Controller:
	dma: dma-controller@0x09c00000{
		compatible = "zte,zx296702-dma";
		reg = <0x09c00000 0x1000>;
		clocks = <&topclk ZX296702_DMA_ACLK>;
		interrupts = <GIC_SPI 66 IRQ_TYPE_LEVEL_HIGH>;
		#dma-cells = <1>;
		dma-channels = <24>;
		dma-requests = <24>;
	};

Client:
dmax에서 전달하는 특정 요청 라인 사용
예를 들어, spdif0 tx 채널 요청 줄은 4입니다.

	spdif0: spdif0@0b004000 {
		#sound-dai-cells = <0>;
		compatible = "zte,zx296702-spdif";
		reg = <0x0b004000 0x1000>;
		clocks = <&lsp0clk ZX296702_SPDIF0_DIV>;
		clock-names = "tx";
		interrupts = <GIC_SPI 21 IRQ_TYPE_LEVEL_HIGH>;
		dmas = <&dma 4>;
		dma-names = "tx";
	}




*/
```

## Doc/DeviceDriver/devicetree/bindings/edac/apm-xgene-edac.txt
```
* APM X-Gene SoC EDAC node

EDAC node is defined to describe on-chip error detection and correction.
The follow error types are supported:

  memory controller	- Memory controller
  PMD (L1/L2)		- Processor module unit (PMD) L1/L2 cache
  L3			- L3 cache controller
  SoC			- SoC IP's such as Ethernet, SATA, and etc

The following section describes the EDAC DT node binding.

Required properties:
- compatible		: Shall be "apm,xgene-edac".
- regmap-csw		: Regmap of the CPU switch fabric (CSW) resource.
- regmap-mcba		: Regmap of the MCB-A (memory bridge) resource.
- regmap-mcbb		: Regmap of the MCB-B (memory bridge) resource.
- regmap-efuse		: Regmap of the PMD efuse resource.
- reg			: First resource shall be the CPU bus (PCP) resource.
- interrupts            : Interrupt-specifier for MCU, PMD, L3, or SoC error
			  IRQ(s).

Required properties for memory controller subnode:
- compatible		: Shall be "apm,xgene-edac-mc".
- reg			: First resource shall be the memory controller unit
                          (MCU) resource.
- memory-controller	: Instance number of the memory controller.

Required properties for PMD subnode:
- compatible		: Shall be "apm,xgene-edac-pmd" or
                          "apm,xgene-edac-pmd-v2".
- reg			: First resource shall be the PMD resource.
- pmd-controller	: Instance number of the PMD controller.

Required properties for L3 subnode:
- compatible		: Shall be "apm,xgene-edac-l3" or
                          "apm,xgene-edac-l3-v2".
- reg			: First resource shall be the L3 EDAC resource.

Required properties for SoC subnode:
- compatible		: Shall be "apm,xgene-edac-soc-v1" for revision 1 or
                          "apm,xgene-edac-l3-soc" for general value reporting
                          only.
- reg			: First resource shall be the SoC EDAC resource.

Example:
	csw: csw@7e200000 {
		compatible = "apm,xgene-csw", "syscon";
		reg = <0x0 0x7e200000 0x0 0x1000>;
	};

	mcba: mcba@7e700000 {
		compatible = "apm,xgene-mcb", "syscon";
		reg = <0x0 0x7e700000 0x0 0x1000>;
	};

	mcbb: mcbb@7e720000 {
		compatible = "apm,xgene-mcb", "syscon";
		reg = <0x0 0x7e720000 0x0 0x1000>;
	};

	efuse: efuse@1054a000 {
		compatible = "apm,xgene-efuse", "syscon";
		reg = <0x0 0x1054a000 0x0 0x20>;
	};

	edac@78800000 {
		compatible = "apm,xgene-edac";
		#address-cells = <2>;
		#size-cells = <2>;
		ranges;
		regmap-csw = <&csw>;
		regmap-mcba = <&mcba>;
		regmap-mcbb = <&mcbb>;
		regmap-efuse = <&efuse>;
		reg = <0x0 0x78800000 0x0 0x100>;
		interrupts = <0x0 0x20 0x4>,
			     <0x0 0x21 0x4>,
			     <0x0 0x27 0x4>;

		edacmc@7e800000 {
			compatible = "apm,xgene-edac-mc";
			reg = <0x0 0x7e800000 0x0 0x1000>;
			memory-controller = <0>;
		};

		edacpmd@7c000000 {
			compatible = "apm,xgene-edac-pmd";
			reg = <0x0 0x7c000000 0x0 0x200000>;
			pmd-controller = <0>;
		};

		edacl3@7e600000 {
			compatible = "apm,xgene-edac-l3";
			reg = <0x0 0x7e600000 0x0 0x1000>;
		};

		edacsoc@7e930000 {
			compatible = "apm,xgene-edac-soc-v1";
			reg = <0x0 0x7e930000 0x0 0x1000>;
		};
	};




/*
* APM X-Gene SoC EDAC 노드

EDAC 노드는 온칩 오류 탐지 및 정정을 설명하기 위해 정의됩니다.
다음과 같은 오류 유형이 지원됩니다.

  메모리 컨트롤러 - 메모리 컨트롤러
  PMD (L1 / L2) - 프로세서 모듈 장치 (PMD) L1 / L2 캐시
  L3 - L3 캐시 컨트롤러
  SoC - 이더넷, SATA 등과 같은 SoC IP

다음 절에서는 EDAC DT 노드 바인딩에 대해 설명합니다.

필수 속성 :
- 호환 : "apm, xgene-edac"이어야합니다.
- regmap-csw : CPU 스위치 패브릭 (CSW) 리소스의 Regmap입니다.
- regmap-mcba : MCB-A (메모리 브리지) resource의 Regmap.
- regmap-mcbb : MCB-B (메모리 브리지) resource의 Regmap.
- regmap-efuse : PMD efuse resource의 Regmap입니다.
- reg : 첫 번째 resource은 CPU 버스 (PCP) resource이어야한다.
- 인터럽트 : MCU, PMD, L3 또는 SoC 오류에 대한 인터럽트 지정자 IRQ (들).

메모리 컨트롤러 하위 노드의 필수 속성 :
- 호환 : "apm, xgene-edac-mc"여야합니다.
- reg : 첫 번째 리소스는 메모리 컨트롤러 유닛이어야한다.
                          (MCU) 리소스를 제공합니다.
- memory-controller : 메모리 컨트롤러의 인스턴스 번호.

PMD 하위 노드에 필요한 속성 :
- 호환 가능 : "apm, xgene-edac-pmd"또는
                          "apm, xgene-edac-pmd-v2".
- reg : 첫 번째 resource은 PMD resource이어야한다.
- pmd-controller : PMD 컨트롤러의 인스턴스 번호입니다.

L3 하위 노드에 필요한 속성 :
- 호환 : "apm, xgene-edac-l3"또는
                          "apm, xgene-edac-l3-v2".
- reg : 첫 번째 resource은 L3 EDAC resource이어야한다.

SoC 서브 노드에 필요한 등록 정보 :
- 호환 가능 : 개정판 1의 경우 "apm, xgene-edac-soc-v1"또는
                          일반적인 가치보고를위한 "apm, xgene-edac-l3-soc"만.
- reg : 첫 번째 resource은 SoC EDAC resource이어야한다.

Example:
	csw: csw@7e200000 {
		compatible = "apm,xgene-csw", "syscon";
		reg = <0x0 0x7e200000 0x0 0x1000>;
	};

	mcba: mcba@7e700000 {
		compatible = "apm,xgene-mcb", "syscon";
		reg = <0x0 0x7e700000 0x0 0x1000>;
	};

	mcbb: mcbb@7e720000 {
		compatible = "apm,xgene-mcb", "syscon";
		reg = <0x0 0x7e720000 0x0 0x1000>;
	};

	efuse: efuse@1054a000 {
		compatible = "apm,xgene-efuse", "syscon";
		reg = <0x0 0x1054a000 0x0 0x20>;
	};

	edac@78800000 {
		compatible = "apm,xgene-edac";
		#address-cells = <2>;
		#size-cells = <2>;
		ranges;
		regmap-csw = <&csw>;
		regmap-mcba = <&mcba>;
		regmap-mcbb = <&mcbb>;
		regmap-efuse = <&efuse>;
		reg = <0x0 0x78800000 0x0 0x100>;
		interrupts = <0x0 0x20 0x4>,
			     <0x0 0x21 0x4>,
			     <0x0 0x27 0x4>;

		edacmc@7e800000 {
			compatible = "apm,xgene-edac-mc";
			reg = <0x0 0x7e800000 0x0 0x1000>;
			memory-controller = <0>;
		};

		edacpmd@7c000000 {
			compatible = "apm,xgene-edac-pmd";
			reg = <0x0 0x7c000000 0x0 0x200000>;
			pmd-controller = <0>;
		};

		edacl3@7e600000 {
			compatible = "apm,xgene-edac-l3";
			reg = <0x0 0x7e600000 0x0 0x1000>;
		};

		edacsoc@7e930000 {
			compatible = "apm,xgene-edac-soc-v1";
			reg = <0x0 0x7e930000 0x0 0x1000>;
		};
	};

*/
```
