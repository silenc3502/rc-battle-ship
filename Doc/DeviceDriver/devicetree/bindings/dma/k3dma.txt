## Doc/DeviceDriver/devicetree/bindings/dma/renesas,usb-dmac.txt
```
* Renesas USB DMA Controller Device Tree bindings

Required Properties:
- compatible: must contain "renesas,usb-dmac"
- reg: base address and length of the registers block for the DMAC
- interrupts: interrupt specifiers for the DMAC, one for each entry in
  interrupt-names.
- interrupt-names: one entry per channel, named "ch%u", where %u is the
  channel number ranging from zero to the number of channels minus one.
- clocks: a list of phandle + clock-specifier pairs.
- #dma-cells: must be <1>, the cell specifies the channel number of the DMAC
  port connected to the DMA client.
- dma-channels: number of DMA channels

Example: R8A7790 (R-Car H2) USB-DMACs

	usb_dmac0: dma-controller@e65a0000 {
		compatible = "renesas,usb-dmac";
		reg = <0 0xe65a0000 0 0x100>;
		interrupts = <0 109 IRQ_TYPE_LEVEL_HIGH
			      0 109 IRQ_TYPE_LEVEL_HIGH>;
		interrupt-names = "ch0", "ch1";
		clocks = <&mstp3_clks R8A7790_CLK_USBDMAC0>;
		#dma-cells = <1>;
		dma-channels = <2>;
	};

	usb_dmac1: dma-controller@e65b0000 {
		compatible = "renesas,usb-dmac";
		reg = <0 0xe65b0000 0 0x100>;
		interrupts = <0 110 IRQ_TYPE_LEVEL_HIGH
			      0 110 IRQ_TYPE_LEVEL_HIGH>;
		interrupt-names = "ch0", "ch1";
		clocks = <&mstp3_clks R8A7790_CLK_USBDMAC1>;
		#dma-cells = <1>;
		dma-channels = <2>;
	};

/*

* Renesas USB DMA 컨트롤러 디바이스 트리 바인딩

필수 등록 정보 :
- 호환 : "renesas, usb-dmac"를 포함해야합니다.
- reg : DMAC에 대한 레지스터 블록의 기본 주소 및 길이
- 인터럽트 : DMAC에 대한 인터럽트 지정자, 각 항목에 대한 인터럽트 지정자
  interrupt-names.
- interrupt-names : "ch % u"라는 이름의 채널 당 하나의 항목. 여기서 % u는 0에서 채널 수에서 1을 뺀 범위의 채널 번호입니다.
- clocks : phandle + clock-specifier 쌍의 목록입니다.
- # dma-cells : <1>이어야하며, 셀은 DMAC의 채널 번호를 지정합니다
  포트는 DMA 클라이언트에 연결됩니다.
- dma-channels : DMA 채널 수

Example: R8A7790 (R-Car H2) USB-DMACs

	usb_dmac0: dma-controller@e65a0000 {
		compatible = "renesas,usb-dmac";
		reg = <0 0xe65a0000 0 0x100>;
		interrupts = <0 109 IRQ_TYPE_LEVEL_HIGH
			      0 109 IRQ_TYPE_LEVEL_HIGH>;
		interrupt-names = "ch0", "ch1";
		clocks = <&mstp3_clks R8A7790_CLK_USBDMAC0>;
		#dma-cells = <1>;
		dma-channels = <2>;
	};

	usb_dmac1: dma-controller@e65b0000 {
		compatible = "renesas,usb-dmac";
		reg = <0 0xe65b0000 0 0x100>;
		interrupts = <0 110 IRQ_TYPE_LEVEL_HIGH
			      0 110 IRQ_TYPE_LEVEL_HIGH>;
		interrupt-names = "ch0", "ch1";
		clocks = <&mstp3_clks R8A7790_CLK_USBDMAC1>;
		#dma-cells = <1>;
		dma-channels = <2>;
	};

*/
```

## Doc/DeviceDriver/devicetree/bindings/dma/shdma.txt
```
* SHDMA Device Tree bindings

Sh-/r-mobile and r-car systems often have multiple identical DMA controller
instances, capable of serving any of a common set of DMA slave devices, using
the same configuration. To describe this topology we require all compatible
SHDMA DT nodes to be placed under a DMA multiplexer node. All such compatible
DMAC instances have the same number of channels and use the same DMA
descriptors. Therefore respective DMA DT bindings can also all be placed in the
multiplexer node. Even if there is only one such DMAC instance on a system, it
still has to be placed under such a multiplexer node.

* DMA multiplexer

Required properties:
- compatible:	should be "renesas,shdma-mux"
- #dma-cells:	should be <1>, see "dmas" property below

Optional properties (currently unused):
- dma-channels:	number of DMA channels
- dma-requests:	number of DMA request signals

* DMA controller

Required properties:
- compatible:	should be of the form "renesas,shdma-<soc>", where <soc> should
		be replaced with the desired SoC model, e.g.
		"renesas,shdma-r8a73a4" for the system DMAC on r8a73a4 SoC

Example:
	dmac: dma-multiplexer@0 {
		compatible = "renesas,shdma-mux";
		#dma-cells = <1>;
		dma-channels = <20>;
		dma-requests = <256>;
		#address-cells = <2>;
		#size-cells = <2>;
		ranges;

		dma0: dma-controller@e6700020 {
			compatible = "renesas,shdma-r8a73a4";
			reg = <0 0xe6700020 0 0x89e0>;
			interrupt-parent = <&gic>;
			interrupts = <0 220 4
					0 200 4
					0 201 4
					0 202 4
					0 203 4
					0 204 4
					0 205 4
					0 206 4
					0 207 4
					0 208 4
					0 209 4
					0 210 4
					0 211 4
					0 212 4
					0 213 4
					0 214 4
					0 215 4
					0 216 4
					0 217 4
					0 218 4
					0 219 4>;
			interrupt-names = "error",
					"ch0", "ch1", "ch2", "ch3",
					"ch4", "ch5", "ch6", "ch7",
					"ch8", "ch9", "ch10", "ch11",
					"ch12", "ch13", "ch14", "ch15",
					"ch16", "ch17", "ch18", "ch19";
		};
	};

* DMA client

Required properties:
- dmas:		a list of <[DMA multiplexer phandle] [MID/RID value]> pairs,
		where MID/RID values are fixed handles, specified in the SoC
		manual
- dma-names:	a list of DMA channel names, one per "dmas" entry

Example:
	dmas = <&dmac 0xd1
		&dmac 0xd2>;
	dma-names = "tx", "rx";



/*

* SHDMA 장치 트리 바인딩

Sh- / r-mobile 및 r-car 시스템에는 종종 동일한 DMA 컨트롤러가 여러 개 있습니다
동일한 구성을 사용하여 DMA 슬레이브 장치의 공통 집합 중 하나를 제공 할 수있는 인스턴스입니다. 이 토폴로지를 설명하기 위해 모든 호환 가능한 SHDMA DT 노드를 DMA 멀티플렉서 노드 아래에 두어야합니다. 그러한 호환 가능한 DMAC 인스턴스는 모두 동일한 수의 채널을 가지며 동일한 DMA 디스크립터를 사용합니다. 따라서, 각각의 DMA DT 바인딩은 또한 모두 멀티플렉서 노드에 배치 될 수있다. 시스템에 그러한 DMAC 인스턴스가 하나만있는 경우에도
여전히 멀티플렉서 노드 아래에 위치해야합니다.

* DMA 멀티플렉서

필수 속성 :
- compatible : "renesas, shdma-mux"여야합니다.
- # dma-cells : <1>이어야하며 아래의 "dmas"속성 참조

선택적 속성 (현재 사용되지 않음) :
- dma-channels : DMA 채널 수
- dma-requests : DMA 요청 신호 수

* DMA 컨트롤러

필수 속성 :
- 호환 : "renesas, shdma- <soc>"형식이어야합니다. 여기서 <soc>는 원하는 SoC 모델로 대체되어야합니다. r8a73a4 SoC의 시스템 DMAC 용 "renesas, shdma-r8a73a4"

Example:
	dmac: dma-multiplexer@0 {
		compatible = "renesas,shdma-mux";
		#dma-cells = <1>;
		dma-channels = <20>;
		dma-requests = <256>;
		#address-cells = <2>;
		#size-cells = <2>;
		ranges;

		dma0: dma-controller@e6700020 {
			compatible = "renesas,shdma-r8a73a4";
			reg = <0 0xe6700020 0 0x89e0>;
			interrupt-parent = <&gic>;
			interrupts = <0 220 4
					0 200 4
					0 201 4
					0 202 4
					0 203 4
					0 204 4
					0 205 4
					0 206 4
					0 207 4
					0 208 4
					0 209 4
					0 210 4
					0 211 4
					0 212 4
					0 213 4
					0 214 4
					0 215 4
					0 216 4
					0 217 4
					0 218 4
					0 219 4>;
			interrupt-names = "error",
					"ch0", "ch1", "ch2", "ch3",
					"ch4", "ch5", "ch6", "ch7",
					"ch8", "ch9", "ch10", "ch11",
					"ch12", "ch13", "ch14", "ch15",
					"ch16", "ch17", "ch18", "ch19";
		};
	};

* DMA 클라이언트

필수 속성 :
- dmas : SoC 매뉴얼에 명시된 MID / RID 값이 고정 핸들 인 <[DMA multiplexer phandle] [MID / RID 값]> 쌍의 목록 - dma-names : DMA 채널 이름 목록, dmas "항목

Example:
	dmas = <&dmac 0xd1
		&dmac 0xd2>;
	dma-names = "tx", "rx";


*/
```

## Doc/DeviceDriver/devicetree/bindings/dma/sirfsoc-dma.txt
```
* CSR SiRFSoC DMA controller

See dma.txt first

Required properties:
- compatible: Should be "sirf,prima2-dmac", "sirf,atlas7-dmac" or
  "sirf,atlas7-dmac-v2"
- reg: Should contain DMA registers location and length.
- interrupts: Should contain one interrupt shared by all channel
- #dma-cells: must be <1>. used to represent the number of integer
    cells in the dmas property of client device.
- clocks: clock required

Example:

Controller:
dmac0: dma-controller@b00b0000 {
	compatible = "sirf,prima2-dmac";
	reg = <0xb00b0000 0x10000>;
	interrupts = <12>;
	clocks = <&clks 24>;
	#dma-cells = <1>;
};


Client:
Fill the specific dma request line in dmas. In the below example, spi0 read
channel request line is 9 of the 2nd dma controller, while write channel uses
4 of the 2nd dma controller; spi1 read channel request line is 12 of the 1st
dma controller, while write channel uses 13 of the 1st dma controller:

spi0: spi@b00d0000 {
	compatible = "sirf,prima2-spi";
	dmas = <&dmac1 9>,
		<&dmac1 4>;
	dma-names = "rx", "tx";
};

spi1: spi@b0170000 {
	compatible = "sirf,prima2-spi";
	dmas = <&dmac0 12>,
		<&dmac0 13>;
	dma-names = "rx", "tx";
};



/*
* CSR SiRFSoC DMA 컨트롤러

먼저 dma.txt보기

필수 속성 :
- 호환 : "sirf, prima2-dmac", "sirf, atlas7-dmac"또는 "sirf, atlas7-dmac-v2"이어야합니다.
- reg : DMA 레지스터 위치와 길이를 포함해야합니다.
- interrupts : 모든 채널이 공유하는 하나의 인터럽트를 포함해야합니다.
- # dma-cells : <1>이어야합니다. 클라이언트 장치의 dmas 등록 정보에있는 정수 셀 수를 나타내는 데 사용됩니다.
- clock : 필요한 clock


Example:

Controller:
dmac0: dma-controller@b00b0000 {
	compatible = "sirf,prima2-dmac";
	reg = <0xb00b0000 0x10000>;
	interrupts = <12>;
	clocks = <&clks 24>;
	#dma-cells = <1>;
};


client:
dmas의 특정 dma 요청 행을 채 웁니다. 아래 예에서 쓰기 채널은 두 번째 dma 컨트롤러의 4 개를 사용하는 반면 spi0 읽기 채널 요청 라인은 두 번째 DMA 컨트롤러의 9 개입니다. spi1 읽기 채널 요청 라인은 첫 번째 DMA 컨트롤러의 12 개이며 쓰기 채널은 첫 번째 DMA 컨트롤러의 13 개를 사용합니다.

spi0: spi@b00d0000 {
	compatible = "sirf,prima2-spi";
	dmas = <&dmac1 9>,
		<&dmac1 4>;
	dma-names = "rx", "tx";
};

spi1: spi@b0170000 {
	compatible = "sirf,prima2-spi";
	dmas = <&dmac0 12>,
		<&dmac0 13>;
	dma-names = "rx", "tx";
};

*/
```

## Doc/DeviceDriver/devicetree/bindings/dma/snps-dma.txt
```
* Synopsys Designware DMA Controller

Required properties:
- compatible: "snps,dma-spear1340"
- reg: Address range of the DMAC registers
- interrupt: Should contain the DMAC interrupt number
- dma-channels: Number of channels supported by hardware
- dma-requests: Number of DMA request lines supported, up to 16
- dma-masters: Number of AHB masters supported by the controller
- #dma-cells: must be <3>
- chan_allocation_order: order of allocation of channel, 0 (default): ascending,
  1: descending
- chan_priority: priority of channels. 0 (default): increase from chan 0->n, 1:
  increase from chan n->0
- block_size: Maximum block size supported by the controller
- data_width: Maximum data width supported by hardware per AHB master
  (0 - 8bits, 1 - 16bits, ..., 5 - 256bits)


Optional properties:
- interrupt-parent: Should be the phandle for the interrupt controller
  that services interrupts for this device
- is_private: The device channels should be marked as private and not for by the
  general purpose DMA channel allocator. False if not passed.

Example:

	dmahost: dma@fc000000 {
		compatible = "snps,dma-spear1340";
		reg = <0xfc000000 0x1000>;
		interrupt-parent = <&vic1>;
		interrupts = <12>;

		dma-channels = <8>;
		dma-requests = <16>;
		dma-masters = <2>;
		#dma-cells = <3>;
		chan_allocation_order = <1>;
		chan_priority = <1>;
		block_size = <0xfff>;
		data_width = <3 3>;
	};

DMA clients connected to the Designware DMA controller must use the format
described in the dma.txt file, using a four-cell specifier for each channel.
The four cells in order are:

1. A phandle pointing to the DMA controller
2. The DMA request line number
3. Source master for transfers on allocated channel
4. Destination master for transfers on allocated channel

Example:
	
	serial@e0000000 {
		compatible = "arm,pl011", "arm,primecell";
		reg = <0xe0000000 0x1000>;
		interrupts = <0 35 0x4>;
		status = "disabled";
		dmas = <&dmahost 12 0 1>,
			<&dmahost 13 0 1 0>;
		dma-names = "rx", "rx";
	};




/*

* Synopsys DesignWare DMA 컨트롤러

필수 속성 :
- 호환 : "snps, dma-spear1340"
- reg : DMAC 레지스터의 주소 범위
- interrupt : DMAC 인터럽트 번호를 포함해야합니다.
- dma-channels : 하드웨어가 지원하는 채널 수
- dma-requests : 지원되는 DMA 요청 행 수, 최대 16 개
- dma-masters : 컨트롤러에서 지원하는 AHB 마스터 수
- # dma-cells : <3>이어야합니다.
- chan_allocation_order : 채널 할당 순서, 0 (기본값) : 오름차순,
  1 : 내림차순
- chan_priority : 채널 우선 순위. 0 (기본값) : chan에서 증가 0 -> n, 1 :
  챈 n-> 0에서 증가
- block_size : 컨트롤러가 지원하는 최대 블록 크기
- data_width : AHB 마스터 당 하드웨어가 지원하는 최대 데이터 폭 (0 - 8 비트, 1 - 16 비트, ..., 5 - 256 비트)


선택적 속성 :
- interrupt-parent :이 장치에 대한 인터럽트를 서비스하는 인터럽트 컨트롤러의 phandle이어야합니다.
- is_private : 장치 채널은 일반용 DMA 채널 할당 기가 아닌 개인용으로 표시되어야합니다. 전달되지 않으면 False입니다.

Example:

	dmahost: dma@fc000000 {
		compatible = "snps,dma-spear1340";
		reg = <0xfc000000 0x1000>;
		interrupt-parent = <&vic1>;
		interrupts = <12>;

		dma-channels = <8>;
		dma-requests = <16>;
		dma-masters = <2>;
		#dma-cells = <3>;
		chan_allocation_order = <1>;
		chan_priority = <1>;
		block_size = <0xfff>;
		data_width = <3 3>;
	};

Designware DMA 컨트롤러에 연결된 DMA 클라이언트는 각 채널에 4 셀 지정자를 사용하여 dma.txt 파일에 설명 된 형식을 사용해야합니다.
네 개의 셀은 순서대로 다음과 같습니다.

1. DMA 컨트롤러를 가리키는 phandle
2. DMA 요구 라인 번호
3. 할당 된 채널에서 전송을위한 원본 마스터
4. 할당 된 채널에서의 전송을위한 대상 마스터

Example:
	
	serial@e0000000 {
		compatible = "arm,pl011", "arm,primecell";
		reg = <0xe0000000 0x1000>;
		interrupts = <0 35 0x4>;
		status = "disabled";
		dmas = <&dmahost 12 0 1>,
			<&dmahost 13 0 1 0>;
		dma-names = "rx", "rx";
	};

*/
```

## Doc/DeviceDriver/devicetree/bindings/dma/ste-coh901318.txt
```
ST-Ericsson COH 901 318 DMA Controller

This is a DMA controller which has begun as a fork of the
ARM PL08x PrimeCell VHDL code.

Required properties:
- compatible: should be "stericsson,coh901318"
- reg: register locations and length
- interrupts: the single DMA IRQ
- #dma-cells: must be set to <1>, as the channels on the
  COH 901 318 are simple and identified by a single number
- dma-channels: the number of DMA channels handled

Example:

dmac: dma-controller@c00020000 {
	compatible = "stericsson,coh901318";
	reg = <0xc0020000 0x1000>;
	interrupt-parent = <&vica>;
	interrupts = <2>;
	#dma-cells = <1>;
	dma-channels = <40>;
};

Consumers example:

uart0: serial@c0013000 {
	compatible = "...";
	(...)
	dmas = <&dmac 17 &dmac 18>;
	dma-names = "tx", "rx";
};




/*

ST-Ericsson COH 901 318 DMA 컨트롤러

이것은 DMA 컨트롤러로서 포크로 시작했습니다.
ARM PL08x PrimeCell VHDL 코드.

필수 속성 :
- 호환 가능 : "stericsson, coh901318"이어야합니다.
- 등록 : 위치 및 길이 등록
- 인터럽트 : 단일 DMA IRQ
- # dma-cells : COH 901 318의 채널이 단순하고 단일 번호로 식별되므로 <1>로 설정해야합니다.
- dma-channels : 처리 된 DMA 채널의 수


Example:

dmac: dma-controller@c00020000 {
	compatible = "stericsson,coh901318";
	reg = <0xc0020000 0x1000>;
	interrupt-parent = <&vica>;
	interrupts = <2>;
	#dma-cells = <1>;
	dma-channels = <40>;
};


Consumers example:

uart0: serial@c0013000 {
	compatible = "...";
	(...)
	dmas = <&dmac 17 &dmac 18>;
	dma-names = "tx", "rx";
};

*/
```
