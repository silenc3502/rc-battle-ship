## Doc/DeviceDriver/devicetree/bindings/dma/k3dma.txt
```
* Hisilicon K3 DMA controller

See dma.txt first

Required properties:
- compatible: Should be "hisilicon,k3-dma-1.0"
- reg: Should contain DMA registers location and length.
- interrupts: Should contain one interrupt shared by all channel
- #dma-cells: see dma.txt, should be 1, para number
- dma-channels: physical channels supported
- dma-requests: virtual channels supported, each virtual channel
		have specific request line
- clocks: clock required

Example:

Controller:
		dma0: dma@fcd02000 {
			compatible = "hisilicon,k3-dma-1.0";
			reg = <0xfcd02000 0x1000>;
			#dma-cells = <1>;
			dma-channels = <16>;
			dma-requests = <27>;
			interrupts = <0 12 4>;
			clocks = <&pclk>;
			status = "disable";
		};

Client:
Use specific request line passing from dmax
For example, i2c0 read channel request line is 18, while write channel use 19

		i2c0: i2c@fcb08000 {
			compatible = "snps,designware-i2c";
			dmas =	<&dma0 18          /* read channel */
				 &dma0 19>;        /* write channel */
			dma-names = "rx", "tx";
		};

		i2c1: i2c@fcb09000 {
			compatible = "snps,designware-i2c";
			dmas =	<&dma0 20          /* read channel */
				 &dma0 21>;        /* write channel */
			dma-names = "rx", "tx";
		};


/*
* Hisilicon K3 DMA 컨트롤러

먼저 dma.txt보기

필수 속성 :
- 호환 : "hisilicon, k3-dma-1.0"이어야합니다.
- reg : DMA 레지스터 위치와 길이를 포함해야합니다.
- interrupts : 모든 채널이 공유하는 하나의 인터럽트를 포함해야합니다.
- # dma-cells : dma.txt를 참조하십시오. 1, para number 여야합니다.
- dma-channels : 지원되는 물리 채널
- dma-requests : 가상 채널 지원, 각 가상 채널은 특정 요청 라인
- 클럭 : 필요한 클럭

Example:

Controller:
		dma0: dma@fcd02000 {
			compatible = "hisilicon,k3-dma-1.0";
			reg = <0xfcd02000 0x1000>;
			#dma-cells = <1>;
			dma-channels = <16>;
			dma-requests = <27>;
			interrupts = <0 12 4>;
			clocks = <&pclk>;
			status = "disable";
		};

client:
dmax에서 전달하는 특정 요청 라인 사용
예를 들어, i2c0 읽기 채널 요청 행은 18이고 쓰기 채널 사용은 19

i2c0: i2c@fcb08000 {
			compatible = "snps,designware-i2c";
			dmas =	<&dma0 18          /* read channel */
				 &dma0 19>;        /* write channel */
			dma-names = "rx", "tx";
		};

		i2c1: i2c@fcb09000 {
			compatible = "snps,designware-i2c";
			dmas =	<&dma0 20          /* read channel */
				 &dma0 21>;        /* write channel */
			dma-names = "rx", "tx";
		};

*/
```

## Doc/DeviceDriver/devicetree/bindings/dma/lpc1850-dmamux.txt
```
NXP LPC18xx/43xx DMA MUX (DMA request router)

Required properties:
- compatible:	"nxp,lpc1850-dmamux"
- reg:		Memory map for accessing module
- #dma-cells:	Should be set to <3>.
		* 1st cell contain the master dma request signal
		* 2nd cell contain the mux value (0-3) for the peripheral
		* 3rd cell contain either 1 or 2 depending on the AHB
		  master used.
- dma-requests:	Number of DMA requests for the mux
- dma-masters:	phandle pointing to the DMA controller

The DMA controller node need to have the following poroperties:
- dma-requests:	Number of DMA requests the controller can handle

Example:

dmac: dma@40002000 {
	compatible = "nxp,lpc1850-gpdma", "arm,pl080", "arm,primecell";
	arm,primecell-periphid = <0x00041080>;
	reg = <0x40002000 0x1000>;
	interrupts = <2>;
	clocks = <&ccu1 CLK_CPU_DMA>;
	clock-names = "apb_pclk";
	#dma-cells = <2>;
	dma-channels = <8>;
	dma-requests = <16>;
	lli-bus-interface-ahb1;
	lli-bus-interface-ahb2;
	mem-bus-interface-ahb1;
	mem-bus-interface-ahb2;
	memcpy-burst-size = <256>;
	memcpy-bus-width = <32>;
};

dmamux: dma-mux {
	compatible = "nxp,lpc1850-dmamux";
	#dma-cells = <3>;
	dma-requests = <64>;
	dma-masters = <&dmac>;
};

uart0: serial@40081000 {
	compatible = "nxp,lpc1850-uart", "ns16550a";
	reg = <0x40081000 0x1000>;
	reg-shift = <2>;
	interrupts = <24>;
	clocks = <&ccu2 CLK_APB0_UART0>, <&ccu1 CLK_CPU_UART0>;
	clock-names = "uartclk", "reg";
	dmas = <&dmamux 1 1 2
		&dmamux 2 1 2>;
	dma-names = "tx", "rx";
};

/*
NXP LPC18xx / 43xx DMA MUX (DMA 요청 라우터)

필수 속성 :
- 호환 : "nxp, lpc1850-dmamux"
- reg : 모듈에 접근하기위한 메모리 맵
- # dma-cells : <3>으로 설정해야합니다.
* 첫 번째 셀에는 마스터 dma 요청 신호가 들어 있습니다.
* 두 번째 셀은 주변 장치에 대한 mux 값 (0-3)을 포함합니다.
* 세 번째 셀은 사용 된 AHBmaster에 따라 1 또는 2 중 하나를 포함합니다.
- dma-requests : 멀티플렉서에 대한 DMA 요청 수
- dma-masters : DMA 컨트롤러를 가리키는 phandle

DMA 컨트롤러 노드에는 다음과 같은 속성이 있어야합니다.
- dma-requests : 컨트롤러가 처리 할 수있는 DMA 요청 수

Example:

dmac: dma@40002000 {
	compatible = "nxp,lpc1850-gpdma", "arm,pl080", "arm,primecell";
	arm,primecell-periphid = <0x00041080>;
	reg = <0x40002000 0x1000>;
	interrupts = <2>;
	clocks = <&ccu1 CLK_CPU_DMA>;
	clock-names = "apb_pclk";
	#dma-cells = <2>;
	dma-channels = <8>;
	dma-requests = <16>;
	lli-bus-interface-ahb1;
	lli-bus-interface-ahb2;
	mem-bus-interface-ahb1;
	mem-bus-interface-ahb2;
	memcpy-burst-size = <256>;
	memcpy-bus-width = <32>;
};

dmamux: dma-mux {
	compatible = "nxp,lpc1850-dmamux";
	#dma-cells = <3>;
	dma-requests = <64>;
	dma-masters = <&dmac>;
};

uart0: serial@40081000 {
	compatible = "nxp,lpc1850-uart", "ns16550a";
	reg = <0x40081000 0x1000>;
	reg-shift = <2>;
	interrupts = <24>;
	clocks = <&ccu2 CLK_APB0_UART0>, <&ccu1 CLK_CPU_UART0>;
	clock-names = "uartclk", "reg";
	dmas = <&dmamux 1 1 2
		&dmamux 2 1 2>;
	dma-names = "tx", "rx";
};

*/
```

## Doc/DeviceDriver/devicetree/bindings/dma/mmp-dma.txt
```
* MARVELL MMP DMA controller

Marvell Peripheral DMA Controller
Used platforms: pxa688, pxa910, pxa3xx, etc

Required properties:
- compatible: Should be "marvell,pdma-1.0"
- reg: Should contain DMA registers location and length.
- interrupts: Either contain all of the per-channel DMA interrupts
		or one irq for pdma device

Optional properties:
- #dma-channels: Number of DMA channels supported by the controller (defaults
  to 32 when not specified)

"marvell,pdma-1.0"
Used platforms: pxa25x, pxa27x, pxa3xx, pxa93x, pxa168, pxa910, pxa688.

Examples:

/*
 * Each channel has specific irq
 * ICU parse out irq channel from ICU register,
 * while DMA controller may not able to distinguish the irq channel
 * Using this method, interrupt-parent is required as demuxer
 * For example, pxa688 icu register 0x128, bit 0~15 is PDMA channel irq,
 * 18~21 is ADMA irq
 */
pdma: dma-controller@d4000000 {
	      compatible = "marvell,pdma-1.0";
	      reg = <0xd4000000 0x10000>;
	      interrupts = <0 1 2 3 4 5 6 7 8 9 10 11 12 13 14 15>;
	      interrupt-parent = <&intcmux32>;
	      #dma-channels = <16>;
      };

/*
 * One irq for all channels
 * Dmaengine driver (DMA controller) distinguish irq channel via
 * parsing internal register
 */
pdma: dma-controller@d4000000 {
	      compatible = "marvell,pdma-1.0";
	      reg = <0xd4000000 0x10000>;
	      interrupts = <47>;
	      #dma-channels = <16>;
      };


Marvell Two Channel DMA Controller used specifically for audio
Used platforms: pxa688, pxa910

Required properties:
- compatible: Should be "marvell,adma-1.0" or "marvell,pxa910-squ"
- reg: Should contain DMA registers location and length.
- interrupts: Either contain all of the per-channel DMA interrupts
		or one irq for dma device

"marvell,adma-1.0" used on pxa688
"marvell,pxa910-squ" used on pxa910

Examples:

/* each channel has specific irq */
adma0: dma-controller@d42a0800 {
	      compatible = "marvell,adma-1.0";
	      reg = <0xd42a0800 0x100>;
	      interrupts = <18 19>;
	      interrupt-parent = <&intcmux32>;
      };

/* One irq for all channels */
squ: dma-controller@d42a0800 {
	      compatible = "marvell,pxa910-squ";
	      reg = <0xd42a0800 0x100>;
	      interrupts = <46>;
      };


/*

* MARVELL MMP DMA 컨트롤러

Marvell 주변기기 DMA 컨트롤러
사용 된 플랫폼 : pxa688, pxa910, pxa3xx 등

필수 속성 :
- 호환 : "marvell, pdma-1.0"이어야 함
- reg : DMA 레지스터 위치와 길이를 포함해야합니다.
- 인터럽트 : 모든 채널 당 DMA 인터럽트 또는 pdma 장치에 대한 하나의 irq 포함

선택적 속성 :
- # dma-channels : 컨트롤러가 지원하는 DMA 채널 수 (지정되지 않은 경우 기본값은 32입니다)

"marvell, pdma-1.0"
사용 된 플랫폼 : pxa25x, pxa27x, pxa3xx, pxa93x, pxa168, pxa910, pxa688.

예 :

/ *
 * 각 채널에는 특정 irq가 있습니다.
 * ICU는 ICU 레지스터에서 irq 채널을 분석하고,
 * DMA 컨트롤러가 irq 채널을 구분하지 못할 수 있음
 *이 방법을 사용하면 interrupt-parent가 demuxer로 필요합니다.
 * 예를 들어 pxa688 icu 레지스터 0x128, 비트 0 ~ 15는 PDMA 채널 irq,
 * 18 ~ 21은 ADMA irq입니다.
 * /

pdma: dma-controller@d4000000 {
	      compatible = "marvell,pdma-1.0";
	      reg = <0xd4000000 0x10000>;
	      interrupts = <0 1 2 3 4 5 6 7 8 9 10 11 12 13 14 15>;
	      interrupt-parent = <&intcmux32>;
	      #dma-channels = <16>;
      };

/* 
 * 모든 채널에 대해 하나의 irq
 * Dmaengine 드라이버 (DMA 컨트롤러)를 통해 irq 채널을 구별합니다.
 * 내부 레지스터 분석
 * /
pdma : dma-controller @ d4000000 {
compatible = "marvell, pdma-1.0";
reg = <0xd4000000 0x10000>;
인터럽트 = <47>;
# dma-channels = <16>;
      };


Marvell Two Channel DMA 컨트롤러는 오디오 전용으로 사용됩니다.
사용 플랫폼 : pxa688, pxa910

필수 속성 :
- 호환 : "marvell, adma-1.0"또는 "marvell, pxa910-squ"이어야합니다.
- reg : DMA 레지스터 위치와 길이를 포함해야합니다.
- 인터럽트 : 모든 채널 당 DMA 인터럽트 또는 dma 장치에 대해 하나의 irq 포함

"marvell, adma-1.0"pxa688에 사용됨
"marvell, pxa910-squ"는 pxa910에서 사용되었습니다.


Examples:

/* each channel has specific irq */
adma0: dma-controller@d42a0800 {
	      compatible = "marvell,adma-1.0";
	      reg = <0xd42a0800 0x100>;
	      interrupts = <18 19>;
	      interrupt-parent = <&intcmux32>;
      };

/* One irq for all channels */
squ: dma-controller@d42a0800 {
	      compatible = "marvell,pxa910-squ";
	      reg = <0xd42a0800 0x100>;
	      interrupts = <46>;
      };

*/
```

## Doc/DeviceDriver/devicetree/bindings/dma/moxa,moxart-dma.txt
```
MOXA ART DMA Controller

See dma.txt first

Required properties:

- compatible :	Must be "moxa,moxart-dma"
- reg :		Should contain registers location and length
- interrupts :	Should contain an interrupt-specifier for the sole
		interrupt generated by the device
- #dma-cells :	Should be 1, a single cell holding a line request number

Example:

	dma: dma@90500000 {
		compatible = "moxa,moxart-dma";
		reg = <0x90500080 0x40>;
		interrupts = <24 0>;
		#dma-cells = <1>;
	};


Clients:

DMA clients connected to the MOXA ART DMA controller must use the format
described in the dma.txt file, using a two-cell specifier for each channel:
a phandle plus one integer cells.
The two cells in order are:

1. A phandle pointing to the DMA controller.
2. Peripheral identifier for the hardware handshaking interface.

Example:
Use specific request line passing from dma
For example, MMC request line is 5

	sdhci: sdhci@98e00000 {
		compatible = "moxa,moxart-sdhci";
		reg = <0x98e00000 0x5C>;
		interrupts = <5 0>;
		clocks = <&clk_apb>;
		dmas =  <&dma 5>,
			<&dma 5>;
		dma-names = "tx", "rx";
	};

/*
================================================================================================

MOXA ART DMA 컨트롤러


필수 속성 :

- 호환 가능 : "moxa, moxart-dma"여야합니다.
- reg : 레지스터 위치와 길이를 포함해야합니다.
- 인터럽트 : 장치에 의해 생성 된 유일한 인터럽트에 대한 인터럽트 지정자를 포함해야합니다.
- # dma-cells : 줄 요청 번호를 보유한 단일 셀이어야합니다.

Example:

	dma: dma@90500000 {
		compatible = "moxa,moxart-dma";
		reg = <0x90500080 0x40>;
		interrupts = <24 0>;
		#dma-cells = <1>;
	};



클라이언트 :

MOXA ART DMA 컨트롤러에 연결된 DMA 클라이언트는 각 채널에 2 셀 지정자를 사용하여 dma.txt 파일에 설명 된 형식을 사용해야합니다.
phandle 플러스 하나의 정수 셀.
두 개의 셀은 순서대로 있습니다.

1. DMA 컨트롤러를 가리키는 phandle.
2. 하드웨어 핸드 쉐이킹 인터페이스의 주변 장치 식별자.

예:
DMA에서 전달하는 특정 요청 라인 사용

예를 들어, MMC 요청 줄은 5입니다.


	sdhci: sdhci@98e00000 {
		compatible = "moxa,moxart-sdhci";
		reg = <0x98e00000 0x5C>;
		interrupts = <5 0>;
		clocks = <&clk_apb>;
		dmas =  <&dma 5>,
			<&dma 5>;
		dma-names = "tx", "rx";
	};
```

## Doc/DeviceDriver/devicetree/bindings/dma/mpc512x-dma.txt
```
* Freescale MPC512x and MPC8308 DMA Controller

The DMA controller in Freescale MPC512x and MPC8308 SoCs can move
blocks of memory contents between memory and peripherals or
from memory to memory.

Refer to "Generic DMA Controller and DMA request bindings" in
the dma/dma.txt file for a more detailed description of binding.

Required properties:
- compatible: should be "fsl,mpc5121-dma" or "fsl,mpc8308-dma";
- reg: should contain the DMA controller registers location and length;
- interrupt for the DMA controller: syntax of interrupt client node
	is described in interrupt-controller/interrupts.txt file.
- #dma-cells: the length of the DMA specifier, must be <1>.
	Each channel of this DMA controller has a peripheral request line,
	the assignment is fixed in hardware. This one cell
	in dmas property of a client device represents the channel number.

Example:

	dma0: dma@14000 {
		compatible = "fsl,mpc5121-dma";
		reg = <0x14000 0x1800>;
		interrupts = <65 0x8>;
		#dma-cells = <1>;
	};

DMA clients must use the format described in dma/dma.txt file.


/*

* 프리 스케일 MPC512x 및 MPC8308 DMA 컨트롤러

Freescale MPC512x 및 MPC8308 SoC의 DMA 컨트롤러는 메모리와 주변 장치 사이의 메모리 내용 블록을 이동할 수 있습니다.
메모리에서 메모리로.

바인딩에 대한 자세한 설명은 dma / dma.txt 파일의 "일반 DMA 컨트롤러 및 DMA 요청 바인딩"을 참조하십시오.

필수 속성 :
- 호환 가능 : "fsl, mpc5121-dma"또는 "fsl, mpc8308-dma"여야합니다.
- reg : DMA 컨트롤러 레지스터 위치와 길이를 포함해야합니다.
- DMA 컨트롤러에 대한 인터럽트 : 인터럽트 클라이언트 노드의 구문은 인터럽트 컨트롤러 / 인터럽트 .txt 파일에 설명되어 있습니다.
- # dma-cells : DMA 지정자의 길이는 <1>이어야합니다.
이 DMA 컨트롤러의 각 채널에는 주변 요구 라인이 있으며,
할당은 하드웨어로 고정됩니다. 클라이언트 장치의 dmas 속성에있는이 한 셀은 채널 번호를 나타냅니다.


Example:

	dma0: dma@14000 {
		compatible = "fsl,mpc5121-dma";
		reg = <0x14000 0x1800>;
		interrupts = <65 0x8>;
		#dma-cells = <1>;
	};

DMA 클라이언트는 dma / dma.txt 파일에 설명 된 형식을 사용해야합니다.

*/
```

## Doc/DeviceDriver/devicetree/bindings/dma/mv-xor.txt
```
* Marvell XOR engines

Required properties:
- compatible: Should be "marvell,orion-xor" or "marvell,armada-380-xor"
- reg: Should contain registers location and length (two sets)
    the first set is the low registers, the second set the high
    registers for the XOR engine.
- clocks: pointer to the reference clock

The DT node must also contains sub-nodes for each XOR channel that the
XOR engine has. Those sub-nodes have the following required
properties:
- interrupts: interrupt of the XOR channel

The sub-nodes used to contain one or several of the following
properties, but they are now deprecated:
- dmacap,memcpy to indicate that the XOR channel is capable of memcpy operations
- dmacap,memset to indicate that the XOR channel is capable of memset operations
- dmacap,xor to indicate that the XOR channel is capable of xor operations
- dmacap,interrupt to indicate that the XOR channel is capable of
  generating interrupts

Example:

xor@d0060900 {
	compatible = "marvell,orion-xor";
	reg = <0xd0060900 0x100
	       0xd0060b00 0x100>;
	clocks = <&coreclk 0>;
	status = "okay";

	xor00 {
	      interrupts = <51>;
	};
	xor01 {
	      interrupts = <52>;
	};
};


/*

* Marvell XOR 엔진

필수 속성 :
- compatible : "marvell, orion-xor"또는 "marvell, armada-380-xor"이어야합니다.
- reg : 레지스터 위치와 길이를 포함해야 함 (2 개 세트)
    첫 번째 세트는 로우 레지스터이고, 두 번째 세트는 XOR 엔진의 하이 레지스터입니다.
- 클럭 : 기준 클럭에 대한 포인터

DT 노드는 또한 XOR 엔진에있는 각 XOR 채널에 대한 하위 노드를 포함해야합니다. 이러한 하위 노드에는 다음이 필요합니다.
속성 :
- 인터럽트 : XOR 채널의 인터럽트

다음 중 하나 또는 여러 가지를 포함하는 하위 노드
속성을 사용하지만 더 이상 사용되지 않습니다.
- dmacap, memcpy는 XOR 채널이 memcpy 연산을 할 수 있음을 나타냅니다.
- dmacap, memset - XOR 채널이 memset 작업을 수행 할 수 있음을 나타냅니다.
- dmacap, xor - XOR 채널이 xor 작업을 수행 할 수 있음을 나타냅니다.
- dmacap, XOR 채널이 인터럽트를 생성 할 수 있음을 나타 내기 위해 인터럽트합니다.

Example:

xor@d0060900 {
	compatible = "marvell,orion-xor";
	reg = <0xd0060900 0x100
	       0xd0060b00 0x100>;
	clocks = <&coreclk 0>;
	status = "okay";

	xor00 {
	      interrupts = <51>;
	};
	xor01 {
	      interrupts = <52>;
	};
};

*/
```
