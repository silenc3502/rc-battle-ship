## Doc/DeviceDriver/devicetree/bindings/iio/magnetometer/mmc35240.txt
```
* MEMSIC MMC35240 magnetometer sensor

Required properties:

  - compatible : should be "memsic,mmc35240"
  - reg : the I2C address of the magnetometer

Example:

mmc35240@30 {
        compatible = "memsic,mmc35240";
        reg = <0x30>;
};


/*

* MEMSIC MMC35240 자력계 센서

필수 속성 :

   - 호환 가능 : "memsic, mmc35240"이어야합니다.
   - reg : 자력계의 I2C 주소

Example:

mmc35240@30 {
        compatible = "memsic,mmc35240";
        reg = <0x30>;
};


*/
```

## Doc/DeviceDriver/devicetree/bindings/iio/pressure/bmp085.txt
```
BMP085/BMP18x digital pressure sensors

Required properties:
- compatible: bosch,bmp085

Optional properties:
- chip-id: configurable chip id for non-default chip revisions
- temp-measurement-period: temperature measurement period (milliseconds)
- default-oversampling: default oversampling value to be used at startup,
  value range is 0-3 with rising sensitivity.
- interrupt-parent: should be the phandle for the interrupt controller
- interrupts: interrupt mapping for IRQ

Example:

pressure@77 {
	compatible = "bosch,bmp085";
	reg = <0x77>;
	chip-id = <10>;
	temp-measurement-period = <100>;
	default-oversampling = <2>;
	interrupt-parent = <&gpio0>;
	interrupts = <25 IRQ_TYPE_EDGE_RISING>;
};


/*

BMP085 / BMP18x 디지털 압력 센서

필수 속성 :
- 호환 가능 : bosch, bmp085

선택 속성 :
- chip-id : 기본값이 아닌 chip revision에 대한 구성 가능한 칩 ID
- temp-measurement-period : 온도 측정 기간 (밀리 초)
- default-oversampling : 기동시에 사용되는 디폴트의 오버 샘플링 치로서, 상승하는 감도로 값의 범위는 0 ~ 3입니다.
- interrupt-parent : 인터럽트 컨트롤러의 phandle이어야합니다.
- interrupt : IRQ에 대한 인터럽트 매핑

Example:

pressure@77 {
	compatible = "bosch,bmp085";
	reg = <0x77>;
	chip-id = <10>;
	temp-measurement-period = <100>;
	default-oversampling = <2>;
	interrupt-parent = <&gpio0>;
	interrupts = <25 IRQ_TYPE_EDGE_RISING>;
};

*/
```

## Doc/DeviceDriver/devicetree/bindings/iio/proximity/as3935.txt
```
Austrian Microsystems AS3935 Franklin lightning sensor device driver

Required properties:
	- compatible: must be "ams,as3935"
	- reg: SPI chip select number for the device
	- spi-cpha: SPI Mode 1. Refer to spi/spi-bus.txt for generic SPI
	slave node bindings.
	- interrupt-parent : should be the phandle for the interrupt controller
	- interrupts : the sole interrupt generated by the device

	Refer to interrupt-controller/interrupts.txt for generic
	interrupt client node bindings.

Optional properties:
	- ams,tuning-capacitor-pf: Calibration tuning capacitor stepping
	  value 0 - 120pF. This will require using the calibration data from
	  the manufacturer.

Example:

as3935@0 {
	compatible = "ams,as3935";
	reg = <0>;
	spi-cpha;
	interrupt-parent = <&gpio1>;
	interrupts = <16 1>;
	ams,tuning-capacitor-pf = <80>;
};


/*

오스트리아 마이크로 시스템즈 AS3935 프랭클린 번개 센서 디바이스 드라이버

필수 속성 :
- 호환 가능 : "ams, as3935"여야합니다.
- reg : 장치의 SPI 칩 선택 번호
- spi-cpha : SPI 모드 1. 일반적인 SPI 슬레이브 노드 바인딩에 대해서는 spi / spi-bus.txt를 참조하십시오.
- interrupt-parent : 인터럽트 컨트롤러의 phandle이어야합니다.
- 인터럽트 : 장치에 의해 생성 된 유일한 인터럽트

제네릭 인터럽트 클라이언트 노드 바인딩에 대해서는 interrupt-controller / interrupts.txt를 참조하십시오.

선택 속성 :
- ams, tuning-capacitor-pf : calibration 튜닝 커패시터 스테핑 값 0 - 120pF. 이를 위해서는 제조업체의 보정 데이터를 사용해야합니다.



Example:

as3935@0 {
	compatible = "ams,as3935";
	reg = <0>;
	spi-cpha;
	interrupt-parent = <&gpio1>;
	interrupts = <16 1>;
	ams,tuning-capacitor-pf = <80>;
};


*/
```

## Doc/DeviceDriver/devicetree/bindings/iio/sensorhub.txt
```
Samsung Sensorhub driver

Sensorhub is a MCU which manages several sensors and also plays the role
of a virtual sensor device.

Required properties:
- compatible: "samsung,sensorhub-rinato" or "samsung,sensorhub-thermostat"
- spi-max-frequency: max SPI clock frequency
- interrupt-parent: interrupt parent
- interrupts: communication interrupt
- ap-mcu-gpios: [out] ap to sensorhub line - used during communication
- mcu-ap-gpios: [in] sensorhub to ap - used during communication
- mcu-reset-gpios: [out] sensorhub reset

Example:

	shub_spi: shub {
		compatible = "samsung,sensorhub-rinato";
		spi-max-frequency = <5000000>;
		interrupt-parent = <&gpx0>;
		interrupts = <2 0>;
		ap-mcu-gpios = <&gpx0 0 0>;
		mcu-ap-gpios = <&gpx0 4 0>;
		mcu-reset-gpios = <&gpx0 5 0>;
	};

/*
삼성 센서 허브 드라이버

Sensorhub는 여러 센서를 관리하고 가상 센서 장치의 역할을 담당하는 MCU입니다.

필수 속성 :
- 호환 : "samsung, sensorhub-rinato"또는 "samsung, sensorhub-thermostat"
- spi-max-frequency : 최대 SPI 클럭 주파수
- interrupt-parent : 인터럽트 부모
- 인터럽트 : 통신 인터럽트
- ap-mcu-gpios : 센서 아웃 라인에 대한 [out] - 통신 중에 사용됨
- mcu-ap-gpios : [in] sensorhub to ap - 통신 중에 사용됨
- mcu-reset-gpios : [out] sensorhub 재설정


Example:

	shub_spi: shub {
		compatible = "samsung,sensorhub-rinato";
		spi-max-frequency = <5000000>;
		interrupt-parent = <&gpx0>;
		interrupts = <2 0>;
		ap-mcu-gpios = <&gpx0 0 0>;
		mcu-ap-gpios = <&gpx0 4 0>;
		mcu-reset-gpios = <&gpx0 5 0>;
	};


*/
```

## Doc/DeviceDriver/devicetree/bindings/iio/st-sensors.txt
```
STMicroelectronics MEMS sensors

The STMicroelectronics sensor devices are pretty straight-forward I2C or
SPI devices, all sharing the same device tree descriptions no matter what
type of sensor it is.

Required properties:
- compatible: see the list of valid compatible strings below
- reg: the I2C or SPI address the device will respond to

Optional properties:
- vdd-supply: an optional regulator that needs to be on to provide VDD
  power to the sensor.
- vddio-supply: an optional regulator that needs to be on to provide the
  VDD IO power to the sensor.
- st,drdy-int-pin: the pin on the package that will be used to signal
  "data ready" (valid values: 1 or 2). This property is not configurable
  on all sensors.

Sensors may also have applicable pin control settings, those use the
standard bindings from pinctrl/pinctrl-bindings.txt.

Valid compatible strings:

Accelerometers:
- st,lis3lv02dl-accel
- st,lsm303dlh-accel
- st,lsm303dlhc-accel
- st,lis3dh-accel
- st,lsm330d-accel
- st,lsm330dl-accel
- st,lsm330dlc-accel
- st,lis331dl-accel
- st,lis331dlh-accel
- st,lsm303dl-accel
- st,lsm303dlm-accel
- st,lsm330-accel
- st,lsm303agr-accel

Gyroscopes:
- st,l3g4200d-gyro
- st,lsm330d-gyro
- st,lsm330dl-gyro
- st,lsm330dlc-gyro
- st,l3gd20-gyro
- st,l3g4is-gyro
- st,lsm330-gyro

Magnetometers:
- st,lsm303agr-magn
- st,lsm303dlh-magn
- st,lsm303dlhc-magn
- st,lsm303dlm-magn
- st,lis3mdl-magn

Pressure sensors:
- st,lps001wp-press
- st,lps25h-press
- st,lps331ap-press



/*

STMicroelectronics MEMS 센서

STMicroelectronics 센서 디바이스는 상당히 직선적 인 I2C 또는 SPI 디바이스이며, 모든 센서 유형에 상관없이 동일한 디바이스 트리 설명을 공유합니다.

필수 속성 :
- 호환 : 아래의 유효한 호환 문자열 목록을 참조하십시오.
- reg : 기기가 응답 할 I2C 또는 SPI 주소

선택적 속성 :
- vdd-supply : VDD 전원을 센서에 공급하기 위해 필요한 레귤레이터.
- vddio-supply : 센서에 VDD IO 전원을 공급하기 위해 필요한 옵션 레귤레이터.
- st, drdy-int-pin : "data ready"(유효한 값 : 1 또는 2)를 알리는 데 사용할 패키지 핀. 

이 속성은 모든 센서에서 구성 할 수 없습니다.

센서에는 적용 가능한 핀 제어 설정이있을 수도 있습니다.
pinctrl / pinctrl-bindings.txt의 표준 바인딩

유효한 호환 문자열 :

가속도계 :
- st, lis3lv02dl-accel
- st, lsm303dlh-accel
- st, lsm303dlhc-accel
- st, lis3dh-accel
- st, lsm330d-accel
- st, lsm330dl-accel
- st, lsm330dlc-accel
- st, lis331dl-accel
- st, lis331dlh-accel
- st, lsm303dl-accel
- st, lsm303dlm-accel
- st, lsm330-accel
- st, lsm303agr-accel

자이로 스코프 :
- st, l3g4200d-gyro
- st, lsm330d-gyro
- st, lsm330dl-gyro
- st, lsm330dlc-gyro
- st, l3gd20-gyro
- st, l3g4is-gyro
- st, lsm330-gyro

자력계 :
- st, lsm303agr-magn
- st, lsm303dlh-magn
- st, lsm303dlhc-magn
- st, lsm303dlm-magn
- st, lis3mdl-magn

압력 센서 :
- st, lps001wp-press
- st, lps25h-press
- st, lps331ap-press

*/
```

## Doc/DeviceDriver/devicetree/bindings/iio/temperature/mlx90614.txt
```
* Melexis MLX90614 contactless IR temperature sensor

http://melexis.com/Infrared-Thermometer-Sensors/Infrared-Thermometer-Sensors/MLX90614-615.aspx

Required properties:

  - compatible: should be "melexis,mlx90614"
  - reg: the I2C address of the sensor

Optional properties:

  - wakeup-gpios: device tree identifier of the GPIO connected to the SDA line
      to hold low in order to wake up the device.  In normal operation, the
      GPIO is set as input and will not interfere in I2C communication.  There
      is no need for a GPIO driving the SCL line.  If no GPIO is given, power
      management is disabled.

Example:

mlx90614@5a {
	compatible = "melexis,mlx90614";
	reg = <0x5a>;
	wakeup-gpios = <&gpio0 2 GPIO_ACTIVE_HIGH>;
};



/*

* Melexis MLX90614 비접촉식 IR 온도 센서

http://melexis.com/Infrared-Thermometer-Sensors/Infrared-Thermometer-Sensors/MLX90614-615.aspx

필수 속성 :

   - 호환 가능 : "melexis, mlx90614"여야합니다.
   - reg : 센서의 I2C 주소

선택 속성 :

   - wakeup-gpios : 장치를 깨우기 위해 SDA 라인에 연결된 GPIO의 장치 트리 식별자입니다. 정상 동작에서 GPIO는 입력으로 설정되며 I2C 통신을 방해하지 않습니다.
SCL 라인을 구동하는 GPIO는 필요 없습니다. GPIO가 제공되지 않으면 전원 관리가 비활성화됩니다.

Example:

mlx90614@5a {
	compatible = "melexis,mlx90614";
	reg = <0x5a>;
	wakeup-gpios = <&gpio0 2 GPIO_ACTIVE_HIGH>;
};



*/
```

## Doc/DeviceDriver/devicetree/bindings/ipmi.txt
```
IPMI device

Required properties:
- compatible: should be one of ipmi-kcs, ipmi-smic, or ipmi-bt
- device_type: should be ipmi
- reg: Address and length of the register set for the device

Optional properties:
- interrupts: The interrupt for the device.  Without this the interface
	is polled.
- reg-size - The size of the register.  Defaults to 1
- reg-spacing - The number of bytes between register starts.  Defaults to 1
- reg-shift - The amount to shift the registers to the right to get the data
	into bit zero.

Example:

smic@fff3a000 {
	compatible = "ipmi-smic";
	device_type = "ipmi";
	reg = <0xfff3a000 0x1000>;
	interrupts = <0 24 4>;
	reg-size = <4>;
	reg-spacing = <4>;
};


IPMI 장치

필수 속성 :
- 호환 가능 : ipmi-kcs, ipmi-smic 또는 ipmi-bt 중 하나 여야합니다.
- device_type : ipmi 여야합니다.
- reg : 장치에 설정된 레지스터의 주소와 길이

선택적 속성 :
- interrupts : 장치에 대한 인터럽트입니다. 이것이 없으면 인터페이스가 폴링됩니다.
- reg-size - 레지스터의 크기. 기본값은 1입니다.
- reg-spacing - 레지스터 시작 사이의 바이트 수입니다. 기본값은 1입니다.
- reg-shift - 데이터를 비트 0으로 가져 오기 위해 레지스터를 오른쪽으로 시프트하는 양입니다.

예:

smic @ fff3a000 {
compatible = "ipmi-smic";
device_type = "ipmi";
reg = <0xfff3a000 0x1000>;
interrupts = <0 24 4>;
reg-size = <4>;
reg 간격 = <4>;
};
```
