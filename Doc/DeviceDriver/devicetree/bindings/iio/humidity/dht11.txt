## Doc/DeviceDriver/devicetree/bindings/marvell.txt
```
Marvell Discovery mv64[345]6x System Controller chips
Marvell Discovery mv64 [345] 6x 시스템 컨트롤러 칩
===========================================================

The Marvell mv64[345]60 series of system controller chips contain
many of the peripherals needed to implement a complete computer
system.  In this section, we define device tree nodes to describe
the system controller chip itself and each of the peripherals
which it contains.  Compatible string values for each node are
prefixed with the string "marvell,", for Marvell Technology Group Ltd.
Marvell mv64 [345] 60 시리즈 시스템 컨트롤러 칩은 완벽한 컴퓨터 시스템을 
구현하는 데 필요한 주변 장치를 많이 포함하고 있습니다. 이 섹션에서는 시스템
 컨트롤러 칩과 그 안에 포함 된 각 주변 장치를 설명하는 장치 트리 노드를 정의합니다.
 각 노드의 호환 문자열 값에는 Marvell Technology Group Ltd. 문자열 "marvell"이 접두사로 붙어 있습니다

1) The /system-controller node

  This node is used to represent the system-controller and must be
  present when the system uses a system controller chip. The top-level
  system-controller node contains information that is global to all
  devices within the system controller chip. The node name begins
  with "system-controller" followed by the unit address, which is
  the base address of the memory-mapped register set for the system
  controller chip.
  이 노드는 시스템 제어기를 나타내는 데 사용되며 시스템이 시스템 제어기 
  칩을 사용할 때 있어야합니다. 최상위 시스템 컨트롤러 노드에는 시스템 컨트롤러 
  칩 내의 모든 장치에 대한 전역 정보가 들어 있습니다. 노드 이름은 "system-controller"로 
  시작하여 시스템 컨트롤러 칩에 설정된 메모리 매핑 레지스터 세트의 기본 주소 인 유닛 주소로 시작됩니다.

  Required properties:

    - ranges : Describes the translation of system controller addresses
      for memory mapped registers.
    - clock-frequency: Contains the main clock frequency for the system
      controller chip.
    - reg : This property defines the address and size of the
      memory-mapped registers contained within the system controller
      chip.  The address specified in the "reg" property should match
      the unit address of the system-controller node.
    - #address-cells : Address representation for system controller
      devices.  This field represents the number of cells needed to
      represent the address of the memory-mapped registers of devices
      within the system controller chip.
    - #size-cells : Size representation for the memory-mapped
      registers within the system controller chip.
    - #interrupt-cells : Defines the width of cells used to represent
      interrupts.
필수 속성 :

    - 범위 : 메모리 매핑 된 레지스터의 시스템 컨트롤러 주소 변환을 설명합니다.
  
   - clock-frequency : 시스템 컨트롤러 칩의 주 클럭 주파수를 포함합니다.
  
   - reg :이 속성은 시스템 컨트롤러 칩에 포함 된 메모리 매핑 레지스터의 주소와 크기를 정의합니다. "reg"등록 정보에 지정된 주소는 시스템 제어기 노드의 장치 주소와 일치해야합니다.
  
   - # address-cells : 시스템 제어기 장치의 주소 표현입니다. 이 필드는 시스템 컨트롤러 칩 내의 메모리 매핑 레지스터의 주소를 나타내는 데 필요한 셀 수를 나타냅니다.
  
   - # size-cells : 시스템 컨트롤러 칩 내의 메모리 매핑 레지스터 크기를 나타냅니다.
  
   - # interrupt-cells : 인터럽트를 나타내는 데 사용되는 셀의 너비를 정의합니다.  


  Optional properties:
  선택적 속성 :

    - model : The specific model of the system controller chip.  Such
      as, "mv64360", "mv64460", or "mv64560".
    - compatible : A string identifying the compatibility identifiers
      of the system controller chip.
    - model (모델) : 시스템 컨트롤러 칩의 특정 모델입니다. 예 : "mv64360", "mv64460"또는 "mv64560"
    - compatible : 시스템 컨트롤러 칩의 호환성 식별자를 식별하는 문자열입니다. 

  The system-controller node contains child nodes for each system
  controller device that the platform uses.  Nodes should not be created
  for devices which exist on the system controller chip but are not used
  시스템 제어기 노드에는 플랫폼이 사용하는 각 시스템 제어기 장치에 대한 하위 
  노드가 들어 있습니다. 시스템 컨트롤러 칩에 있지만 사용되지 않는 장치에 대해서는 
  노드를 생성하지 않아야합니다.
 
  Example Marvell Discovery mv64360 system-controller node:
   예 Marvell Discovery mv64360 시스템 제어기 노드 :
    system-controller@f1000000 { /* Marvell Discovery mv64360 */
	    #address-cells = <1>;
	    #size-cells = <1>;
	    model = "mv64360";                      /* Default */
	    compatible = "marvell,mv64360";
	    clock-frequency = <133333333>;
	    reg = <0xf1000000 0x10000>;
	    virtual-reg = <0xf1000000>;
	    ranges = <0x88000000 0x88000000 0x1000000 /* PCI 0 I/O Space */
		    0x80000000 0x80000000 0x8000000 /* PCI 0 MEM Space */
		    0xa0000000 0xa0000000 0x4000000 /* User FLASH */
		    0x00000000 0xf1000000 0x0010000 /* Bridge's regs */
		    0xf2000000 0xf2000000 0x0040000>;/* Integrated SRAM */

	    [ child node definitions... ]
    }

2) Child nodes of /system-controller

   a) Marvell Discovery MDIO bus

   The MDIO is a bus to which the PHY devices are connected.  For each
   device that exists on this bus, a child node should be created.  See
   the definition of the PHY node below for an example of how to define
   a PHY.
   MDIO는 PHY 장치가 연결된 버스입니다. 이 버스에있는 각 장치에 대해 하위
    노드를 만들어야합니다. PHY를 정의하는 방법의 예는 아래 PHY 노드의 정의를 참조하십시오.
   
   Required properties:
     - #address-cells : Should be <1>
     - #size-cells : Should be <0>
     - compatible : Should be "marvell,mv64360-mdio"
     필수 속성 :
      - # address-cells : <1>이어야합니다.
      - # size-cells : <0>이어야합니다.
      - 호환 : "marvell, mv64360-mdio"여야합니다.

   Example:

     mdio {
	     #address-cells = <1>;
	     #size-cells = <0>;
	     compatible = "marvell,mv64360-mdio";

	     ethernet-phy@0 {
		     ......
	     };
     };


   b) Marvell Discovery ethernet controller
   b) Marvell Discovery 이더넷 컨트롤러

   The Discover ethernet controller is described with two levels
   of nodes.  The first level describes an ethernet silicon block
   and the second level describes up to 3 ethernet nodes within
   that block.  The reason for the multiple levels is that the
   registers for the node are interleaved within a single set
   of registers.  The "ethernet-block" level describes the
   shared register set, and the "ethernet" nodes describe ethernet
   port-specific properties.
   Discover 이더넷 컨트롤러는 두 단계의 노드로 설명됩니다. 첫 번째 단계 에서는 이더넷 실리콘 블록을 설명하고 
   두 번째 단계 에서는 해당 블록 내에서 최대 3 개의 이더넷 노드를 설명합니다. 다중 레벨인 이유는 노드에 
   대한 레지스터가 단일 레지스터 세트 내에서 인터리빙( 주 채널 또는 각각의 무선 주파수 채널 및 인접 채널 사이에 추가 채널을 끼워 넣는 것)된다는 것입니다. 
   "ethernet-block"레벨은 공유 레지스터 세트를 설명하고, "ethernet"노드는 이더넷 포트 특정 속성을 설명합니다.

   Ethernet block node

   Required properties:
     - #address-cells : <1>
     - #size-cells : <0>
     - compatible : "marvell,mv64360-eth-block"
     - reg : Offset and length of the register set for this block /*이 블록에 대한 레지스터 세트의 오프셋 및 길이 */

   Optional properties:
     - clocks : Phandle to the clock control device and gate bit /*clock 제어 장치 및 게이트 비트와의 Phandle */

   Example Discovery Ethernet block node:
     ethernet-block@2000 {
	     #address-cells = <1>;
	     #size-cells = <0>;
	     compatible = "marvell,mv64360-eth-block";
	     reg = <0x2000 0x2000>;
	     ethernet@0 {
		     .......
	     };
     };

   Ethernet port node

   Required properties:
     - compatible : Should be "marvell,mv64360-eth".
     - reg : Should be <0>, <1>, or <2>, according to which registers
       within the silicon block the device uses.
     - interrupts : <a> where a is the interrupt number for the port.
     - interrupt-parent : the phandle for the interrupt controller
       that services interrupts for this device.
     - phy : the phandle for the PHY connected to this ethernet
       controller.
     - local-mac-address : 6 bytes, MAC address

      - compatible : "marvell, mv64360-eth"여야합니다.
      - reg : 장치가 사용하는 실리콘 블록 내의 레지스터에 따라 <0>, <1> 또는 <2>이어야합니다.
      - interrupts : <a> 여기서 a는 포트의 인터럽트 번호입니다.
      - interrupt-parent :이 장치에 대한 인터럽트를 서비스하는 인터럽트 컨트롤러의 파들입니다.
      - phy :이 이더넷 컨트롤러에 연결된 PHY의 phandle.
      - local-mac-address : 6 바이트, MAC 주소

   Example Discovery Ethernet port node:
     ethernet@0 {
	     compatible = "marvell,mv64360-eth";
	     reg = <0>;
	     interrupts = <32>;
	     interrupt-parent = <&PIC>;
	     phy = <&PHY0>;
	     local-mac-address = [ 00 00 00 00 00 00 ];
     };



   c) Marvell Discovery PHY nodes

   Required properties:
     - interrupts : <a> where a is the interrupt number for this phy.
     - interrupt-parent : the phandle for the interrupt controller that
       services interrupts for this device.
     - reg : The ID number for the phy, usually a small integer

c) Marvell Discovery PHY 노드

    필수 속성 :
      - interrupts : <a> 여기서 a는이 phy의 인터럽트 번호입니다.
      - interrupt-parent :이 장치에 대한 인터럽트를 서비스하는 인터럽트 컨트롤러의 파들입니다.
      - reg : phy의 ID 번호. 일반적으로 작은 정수입니다.
   

   Example Discovery PHY node:
     ethernet-phy@1 {
	     compatible = "broadcom,bcm5421";
	     interrupts = <76>;      /* GPP 12 */
	     interrupt-parent = <&PIC>;
	     reg = <1>;
     };


   d) Marvell Discovery SDMA nodes

   Represent DMA hardware associated with the MPSC (multiprotocol
   serial controllers).

   Required properties:
     - compatible : "marvell,mv64360-sdma"
     - reg : Offset and length of the register set for this device
     - interrupts : <a> where a is the interrupt number for the DMA
       device.
     - interrupt-parent : the phandle for the interrupt controller
       that services interrupts for this device.
d) Marvell Discovery SDMA 노드

    MPSC (멀티 프로토콜 직렬 컨트롤러)와 관련된 DMA 하드웨어를 나타냅니다.

    필수 속성 :
      - 호환 : "marvell, mv64360-sdma"
      - reg :이 장치에 설정된 레지스터 오프셋 및 길이
      - interrupts : <a> 여기서 a는 DMA 장치의 인터럽트 번호입니다.
      - interrupt-parent :이 장치에 대한 인터럽트를 서비스하는 인터럽트 컨트롤러의 파들입니다.

   Example Discovery SDMA node:
     sdma@4000 {
	     compatible = "marvell,mv64360-sdma";
	     reg = <0x4000 0xc18>;
	     virtual-reg = <0xf1004000>;
	     interrupts = <36>;
	     interrupt-parent = <&PIC>;
     };


   e) Marvell Discovery BRG nodes

   Represent baud rate generator hardware associated with the MPSC
   (multiprotocol serial controllers).

   Required properties:
     - compatible : "marvell,mv64360-brg"
     - reg : Offset and length of the register set for this device
     - clock-src : A value from 0 to 15 which selects the clock
       source for the baud rate generator.  This value corresponds
       to the CLKS value in the BRGx configuration register.  See
       the mv64x60 User's Manual.
     - clock-frequence : The frequency (in Hz) of the baud rate
       generator's input clock.
     - current-speed : The current speed setting (presumably by
       firmware) of the baud rate generator.
e) Marvell Discovery BRG 노드

    MPSC와 관련된 보드 속도 생성기 하드웨어를 나타냅니다.
    (멀티 프로토콜 직렬 컨트롤러).

    필수 속성 :
      - 호환 : "marvell, mv64360-brg"
      - reg :이 장치에 설정된 레지스터 오프셋 및 길이
      - clock-src : 보 레이트 생성기의 클럭 소스를 선택하는 0에서 15 사이의 값. 이 값은 BRGx 구성 레지스터의 CLKS 값에 해당합니다. mv64x60 사용자 설명서를 참조하십시오.
      - clock-frequence : 보레이트 발생기의 입력 클럭 주파수 (Hz)입니다.
      - current-speed : 보레이트 발생기의 현재 속도 설정 (펌웨어 기준).
   
   Example Discovery BRG node:
     brg@b200 {
	     compatible = "marvell,mv64360-brg";
	     reg = <0xb200 0x8>;
	     clock-src = <8>;
	     clock-frequency = <133333333>;
	     current-speed = <9600>;
     };


   f) Marvell Discovery CUNIT nodes

   Represent the Serial Communications Unit device hardware.

   Required properties:
     - reg : Offset and length of the register set for this device
     f) Marvell Discovery CUNIT 노드

    직렬 통신 장치 하드웨어를 나타냅니다.

    필수 속성 :
      - reg :이 장치에 설정된 레지스터 오프셋 및 길이

   Example Discovery CUNIT node:
     cunit@f200 {
	     reg = <0xf200 0x200>;
     };


   g) Marvell Discovery MPSCROUTING nodes

   Represent the Discovery's MPSC routing hardware

   Required properties:
     - reg : Offset and length of the register set for this device
     g) Marvell Discovery MPSCROUTING 노드

    Discovery의 MPSC 라우팅 하드웨어를 나타냅니다.

    필수 속성 :
      - reg :이 장치에 설정된 레지스터 오프셋 및 길이

   Example Discovery CUNIT node:
     mpscrouting@b500 {
	     reg = <0xb400 0xc>;
     };


   h) Marvell Discovery MPSCINTR nodes

   Represent the Discovery's MPSC DMA interrupt hardware registers
   (SDMA cause and mask registers).

   Required properties:
     - reg : Offset and length of the register set for this device
h) Marvell Discovery MPSCINTR 노드

    검색의 MPSC DMA 인터럽트 하드웨어 레지스터를 나타냅니다.
    (SDMA 원인 및 마스크 레지스터).

    필수 속성 :
      - reg :이 장치에 설정된 레지스터 오프셋 및 길이

   Example Discovery MPSCINTR node:
     mpsintr@b800 {
	     reg = <0xb800 0x100>;
     };


   i) Marvell Discovery MPSC nodes

   Represent the Discovery's MPSC (Multiprotocol Serial Controller)
   serial port.

   Required properties:
     - compatible : "marvell,mv64360-mpsc"
     - reg : Offset and length of the register set for this device
     - sdma : the phandle for the SDMA node used by this port
     - brg : the phandle for the BRG node used by this port
     - cunit : the phandle for the CUNIT node used by this port
     - mpscrouting : the phandle for the MPSCROUTING node used by this port
     - mpscintr : the phandle for the MPSCINTR node used by this port
     - cell-index : the hardware index of this cell in the MPSC core
     - max_idle : value needed for MPSC CHR3 (Maximum Frame Length)
       register
     - interrupts : <a> where a is the interrupt number for the MPSC.
     - interrupt-parent : the phandle for the interrupt controller
       that services interrupts for this device.

i) Marvell Discovery MPSC 노드

    Discovery의 MPSC (Multiprotocol Serial Controller) 직렬 포트를 나타냅니다.

    필수 속성 :
      - 호환 : "marvell, mv64360-mpsc"
      - reg :이 장치에 설정된 레지스터 오프셋 및 길이
      - sdma :이 포트가 사용하는 SDMA 노드의 파들
      - brg :이 포트가 사용하는 BRG 노드의 파들
      - cunit :이 포트가 사용하는 CUNIT 노드의 파들
      - mpscrouting :이 포트가 사용하는 MPSCROUTING 노드의 파들
      - mpscintr :이 포트가 사용하는 MPSCINTR 노드의 파들
      - 셀 인덱스 : MPSC 코어에서이 셀의 하드웨어 인덱스
      - max_idle : MPSC CHR3 (최대 프레임 길이) 레지스터에 필요한 값
      - interrupts : <a> 여기서 a는 MPSC의 인터럽트 번호입니다.
      - interrupt-parent :이 장치에 대한 인터럽트를 서비스하는 인터럽트 컨트롤러의 파들입니다.

   Example Discovery MPSCINTR node:
     mpsc@8000 {
	     compatible = "marvell,mv64360-mpsc";
	     reg = <0x8000 0x38>;
	     virtual-reg = <0xf1008000>;
	     sdma = <&SDMA0>;
	     brg = <&BRG0>;
	     cunit = <&CUNIT>;
	     mpscrouting = <&MPSCROUTING>;
	     mpscintr = <&MPSCINTR>;
	     cell-index = <0>;
	     max_idle = <40>;
	     interrupts = <40>;
	     interrupt-parent = <&PIC>;
     };


   j) Marvell Discovery Watch Dog Timer nodes

   Represent the Discovery's watchdog timer hardware

   Required properties:
     - compatible : "marvell,mv64360-wdt"
     - reg : Offset and length of the register set for this device

231/5000
j) Marvell Discovery Watch Dog 타이머 노드

    Discovery의 워치 독 타이머 하드웨어를 나타냅니다.

    필수 속성 :
      - 호환 : "marvell, mv64360-wdt"
      - reg :이 장치에 설정된 레지스터 오프셋 및 길이

   Example Discovery Watch Dog Timer node:
     wdt@b410 {
	     compatible = "marvell,mv64360-wdt";
	     reg = <0xb410 0x8>;
     };


   k) Marvell Discovery I2C nodes

   Represent the Discovery's I2C hardware

   Required properties:
     - device_type : "i2c"
     - compatible : "marvell,mv64360-i2c"
     - reg : Offset and length of the register set for this device
     - interrupts : <a> where a is the interrupt number for the I2C.
     - interrupt-parent : the phandle for the interrupt controller
       that services interrupts for this device.

k) Marvell Discovery I2C 노드

    Discovery의 I2C 하드웨어를 나타냅니다.

    필수 속성 :
      - device_type : "i2c"
      - 호환 : "marvell, mv64360-i2c"
      - reg :이 장치에 설정된 레지스터 오프셋 및 길이
      - interrupts : <a> 여기서 a는 I2C의 인터럽트 번호입니다.
      - interrupt-parent :이 장치에 대한 인터럽트를 서비스하는 인터럽트 컨트롤러의 파들입니다.

   Example Discovery I2C node:
	     compatible = "marvell,mv64360-i2c";
	     reg = <0xc000 0x20>;
	     virtual-reg = <0xf100c000>;
	     interrupts = <37>;
	     interrupt-parent = <&PIC>;
     };


   l) Marvell Discovery PIC (Programmable Interrupt Controller) nodes

   Represent the Discovery's PIC hardware

   Required properties:
     - #interrupt-cells : <1>
     - #address-cells : <0>
     - compatible : "marvell,mv64360-pic"
     - reg : Offset and length of the register set for this device
     - interrupt-controller

l) Marvell Discovery PIC (Programmable Interrupt Controller) 노드

    디스커버리의 PIC 하드웨어 표현

    필수 속성 :
      - # interrupt-cells : <1>
      - # address-cells : <0>
      - 호환 : "marvell, mv64360-pic"
      - reg :이 장치에 설정된 레지스터 오프셋 및 길이
      - 인터럽트 컨트롤러

   Example Discovery PIC node:
     pic {
	     #interrupt-cells = <1>;
	     #address-cells = <0>;
	     compatible = "marvell,mv64360-pic";
	     reg = <0x0 0x88>;
	     interrupt-controller;
     };


   m) Marvell Discovery MPP (Multipurpose Pins) multiplexing nodes

   Represent the Discovery's MPP hardware

   Required properties:
     - compatible : "marvell,mv64360-mpp"
     - reg : Offset and length of the register set for this device

m) 마벨 디스커버리 MPP (Multipurpose Pins) 멀티플렉싱 노드

    Discovery의 MPP 하드웨어를 나타냅니다.

    필수 속성 :
      - 호환 : "marvell, mv64360-mpp"
      - reg :이 장치에 설정된 레지스터 오프셋 및 길이

   Example Discovery MPP node:
     mpp@f000 {
	     compatible = "marvell,mv64360-mpp";
	     reg = <0xf000 0x10>;
     };


   n) Marvell Discovery GPP (General Purpose Pins) nodes

   Represent the Discovery's GPP hardware

   Required properties:
     - compatible : "marvell,mv64360-gpp"
     - reg : Offset and length of the register set for this device

  n) Marvell Discovery GPP (범용 핀) 노드

    Discovery의 GPP 하드웨어를 나타냅니다.

    필수 속성 :
      - 호환 : "marvell, mv64360-gpp"
      - reg :이 장치에 설정된 레지스터 오프셋 및 길이

   Example Discovery GPP node:
     gpp@f000 {
	     compatible = "marvell,mv64360-gpp";
	     reg = <0xf100 0x20>;
     };


   o) Marvell Discovery PCI host bridge node

   Represents the Discovery's PCI host bridge device.  The properties
   for this node conform to Rev 2.1 of the PCI Bus Binding to IEEE
   1275-1994.  A typical value for the compatible property is
   "marvell,mv64360-pci".
   o) Marvell Discovery PCI 호스트 브리지 노드

    검색의 PCI 호스트 브리지 장치를 나타냅니다. 이 노드의 등록 정보는 IEEE 1275-1994에 
대한 PCI 버스 바인딩의 Rev 2.1을 따릅니다. 호환 가능한 속성의 일반적인 값은 "marvell, mv64360-pci"입니다.

   Example Discovery PCI host bridge node
     pci@80000000 {
	     #address-cells = <3>;
	     #size-cells = <2>;
	     #interrupt-cells = <1>;
	     device_type = "pci";
	     compatible = "marvell,mv64360-pci";
	     reg = <0xcf8 0x8>;
	     ranges = <0x01000000 0x0        0x0
			     0x88000000 0x0 0x01000000
		       0x02000000 0x0 0x80000000
			     0x80000000 0x0 0x08000000>;
	     bus-range = <0 255>;
	     clock-frequency = <66000000>;
	     interrupt-parent = <&PIC>;
	     interrupt-map-mask = <0xf800 0x0 0x0 0x7>;
	     interrupt-map = <
		     /* IDSEL 0x0a */
		     0x5000 0 0 1 &PIC 80
		     0x5000 0 0 2 &PIC 81
		     0x5000 0 0 3 &PIC 91
		     0x5000 0 0 4 &PIC 93

		     /* IDSEL 0x0b */
		     0x5800 0 0 1 &PIC 91
		     0x5800 0 0 2 &PIC 93
		     0x5800 0 0 3 &PIC 80
		     0x5800 0 0 4 &PIC 81

		     /* IDSEL 0x0c */
		     0x6000 0 0 1 &PIC 91
		     0x6000 0 0 2 &PIC 93
		     0x6000 0 0 3 &PIC 80
		     0x6000 0 0 4 &PIC 81

		     /* IDSEL 0x0d */
		     0x6800 0 0 1 &PIC 93
		     0x6800 0 0 2 &PIC 80
		     0x6800 0 0 3 &PIC 81
		     0x6800 0 0 4 &PIC 91
	     >;
     };


   p) Marvell Discovery CPU Error nodes

   Represent the Discovery's CPU error handler device.

   Required properties:
     - compatible : "marvell,mv64360-cpu-error"
     - reg : Offset and length of the register set for this device
     - interrupts : the interrupt number for this device
     - interrupt-parent : the phandle for the interrupt controller
       that services interrupts for this device.
  p) Marvell Discovery CPU 오류 노드

    Discovery 의 CPU 오류 핸들러 장치를 나타냅니다.

    필수 속성 :
      - 호환 : "marvell, mv64360-cpu-error"
      - reg :이 장치에 설정된 레지스터 오프셋 및 길이
      - interrupts :이 장치의 인터럽트 번호
      - interrupt-parent :이 장치에 대한 인터럽트를 서비스하는 인터럽트 컨트롤러의 파들입니다.

   Example Discovery CPU Error node:
     cpu-error@0070 {
	     compatible = "marvell,mv64360-cpu-error";
	     reg = <0x70 0x10 0x128 0x28>;
	     interrupts = <3>;
	     interrupt-parent = <&PIC>;
     };


   q) Marvell Discovery SRAM Controller nodes

   Represent the Discovery's SRAM controller device.

   Required properties:
     - compatible : "marvell,mv64360-sram-ctrl"
     - reg : Offset and length of the register set for this device
     - interrupts : the interrupt number for this device
     - interrupt-parent : the phandle for the interrupt controller
       that services interrupts for this device.
q) Marvell Discovery SRAM 컨트롤러 노드

    Discovery의 SRAM 컨트롤러 장치를 나타냅니다.

    필수 속성 :
      - 호환 : "marvell, mv64360-sram-ctrl"
      - reg :이 장치에 설정된 레지스터 오프셋 및 길이
      - interrupts :이 장치의 인터럽트 번호
      - interrupt-parent :이 장치에 대한 인터럽트를 서비스하는 인터럽트 컨트롤러의 파들입니다.

   Example Discovery SRAM Controller node:
     sram-ctrl@0380 {
	     compatible = "marvell,mv64360-sram-ctrl";
	     reg = <0x380 0x80>;
	     interrupts = <13>;
	     interrupt-parent = <&PIC>;
     };


   r) Marvell Discovery PCI Error Handler nodes

   Represent the Discovery's PCI error handler device.

   Required properties:
     - compatible : "marvell,mv64360-pci-error"
     - reg : Offset and length of the register set for this device
     - interrupts : the interrupt number for this device
     - interrupt-parent : the phandle for the interrupt controller
       that services interrupts for this device.
   r) Marvell Discovery PCI 오류 처리기 노드

    Discovery 의 PCI 오류 핸들러 장치를 나타냅니다.

    필수 속성 :
      - 호환 : "marvell, mv64360-pci-error"
      - reg :이 장치에 설정된 레지스터 오프셋 및 길이
      - interrupts :이 장치의 인터럽트 번호
      - interrupt-parent :이 장치에 대한 인터럽트를 서비스하는 인터럽트 컨트롤러의 파들입니다.

   Example Discovery PCI Error Handler node:
     pci-error@1d40 {
	     compatible = "marvell,mv64360-pci-error";
	     reg = <0x1d40 0x40 0xc28 0x4>;
	     interrupts = <12>;
	     interrupt-parent = <&PIC>;
     };


   s) Marvell Discovery Memory Controller nodes

   Represent the Discovery's memory controller device.

   Required properties:
     - compatible : "marvell,mv64360-mem-ctrl"
     - reg : Offset and length of the register set for this device
     - interrupts : the interrupt number for this device
     - interrupt-parent : the phandle for the interrupt controller
       that services interrupts for this device.

  s) Marvell Discovery 메모리 컨트롤러 노드

    검색의 메모리 컨트롤러 장치를 나타냅니다.

    필수 속성 :
      - 호환 : "marvell, mv64360-mem-ctrl"
      - reg :이 장치에 설정된 레지스터 오프셋 및 길이
      - interrupts :이 장치의 인터럽트 번호
      - interrupt-parent :이 장치에 대한 인터럽트를 서비스하는 인터럽트 컨트롤러의 파들입니다.

   Example Discovery Memory Controller node:
     mem-ctrl@1400 {
	     compatible = "marvell,mv64360-mem-ctrl";
	     reg = <0x1400 0x60>;
	     interrupts = <17>;
	     interrupt-parent = <&PIC>;
     };
```
