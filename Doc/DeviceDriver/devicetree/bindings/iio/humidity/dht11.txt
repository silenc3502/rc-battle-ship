## Doc/DeviceDriver/devicetree/bindings/iio/humidity/dht11.txt
```
* DHT11 humidity/temperature sensor (and compatibles like DHT22)

Required properties:
  - compatible: Should be "dht11"
  - gpios: Should specify the GPIO connected to the sensor's data
    line, see "gpios property" in
    Documentation/devicetree/bindings/gpio/gpio.txt.

Example:

humidity_sensor {
	compatible = "dht11";
	gpios = <&gpio0 6 0>;
}


/*

* DHT11 습도 / 온도 센서 (DHT22와 같은 호환 제품)

필수 속성 :
   - 호환 : "dht11"이어야합니다.
   - gpios : 센서의 데이터 라인에 연결된 GPIO를 지정해야합니다. "gpios 속성"을 참조하십시오.

Example:

humidity_sensor {
	compatible = "dht11";
	gpios = <&gpio0 6 0>;
}

*/
```

## Doc/DeviceDriver/devicetree/bindings/iio/iio-bindings.txt
```
This binding is derived from clock bindings, and based on suggestions
from Lars-Peter Clausen [1].

Sources of IIO channels can be represented by any node in the device
tree. Those nodes are designated as IIO providers. IIO consumer
nodes use a phandle and IIO specifier pair to connect IIO provider
outputs to IIO inputs. Similar to the gpio specifiers, an IIO
specifier is an array of one or more cells identifying the IIO
output on a device. The length of an IIO specifier is defined by the
value of a #io-channel-cells property in the IIO provider node.

[1] http://marc.info/?l=linux-iio&m=135902119507483&w=2

==IIO providers==

Required properties:
#io-channel-cells: Number of cells in an IIO specifier; Typically 0 for nodes
		   with a single IIO output and 1 for nodes with multiple
		   IIO outputs.

Example for a simple configuration with no trigger:

	adc: voltage-sensor@35 {
		compatible = "maxim,max1139";
		reg = <0x35>;
		#io-channel-cells = <1>;
	};

Example for a configuration with trigger:

	adc@35 {
		compatible = "some-vendor,some-adc";
		reg = <0x35>;

		adc1: iio-device@0 {
			#io-channel-cells = <1>;
			/* other properties */
		};
		adc2: iio-device@1 {
			#io-channel-cells = <1>;
			/* other properties */
		};
	};

==IIO consumers==

Required properties:
io-channels:	List of phandle and IIO specifier pairs, one pair
		for each IIO input to the device. Note: if the
		IIO provider specifies '0' for #io-channel-cells,
		then only the phandle portion of the pair will appear.

Optional properties:
io-channel-names:
		List of IIO input name strings sorted in the same
		order as the io-channels property. Consumers drivers
		will use io-channel-names to match IIO input names
		with IIO specifiers.
io-channel-ranges:
		Empty property indicating that child nodes can inherit named
		IIO channels from this node. Useful for bus nodes to provide
		and IIO channel to their children.

For example:

	device {
		io-channels = <&adc 1>, <&ref 0>;
		io-channel-names = "vcc", "vdd";
	};

This represents a device with two IIO inputs, named "vcc" and "vdd".
The vcc channel is connected to output 1 of the &adc device, and the
vdd channel is connected to output 0 of the &ref device.

==Example==

	adc: max1139@35 {
		compatible = "maxim,max1139";
		reg = <0x35>;
		#io-channel-cells = <1>;
	};

	...

	iio_hwmon {
		compatible = "iio-hwmon";
		io-channels = <&adc 0>, <&adc 1>, <&adc 2>,
			<&adc 3>, <&adc 4>, <&adc 5>,
			<&adc 6>, <&adc 7>, <&adc 8>,
			<&adc 9>;
	};

	some_consumer {
		compatible = "some-consumer";
		io-channels = <&adc 10>, <&adc 11>;
		io-channel-names = "adc1", "adc2";
	};


/*


이 바인딩은 클럭 바인딩에서 파생되며 Lars-Peter Clausen [1]의 제안을 기반으로합니다.

IIO 채널의 소스는 장치 트리의 모든 노드로 나타낼 수 있습니다. 이러한 노드는 IIO 제공자로 지정됩니다. IIO 소비자 노드는 phandle과 IIO 지정자 쌍을 사용하여 IIO 제공자 출력을 IIO 입력에 연결합니다. gpio 지정자와 마찬가지로 IIO 지정자는 장치에서 IIO 출력을 식별하는 하나 이상의 셀 배열입니다. IIO 지정자의 길이는 IIO 공급자 노드의 # io-channel-cells 속성 값에 의해 정의됩니다.

[1] http://marc.info/?l=linux-iio&m=135902119507483&w=2

== IIO 제공자 ==

필수 속성 :
# io-channel-cells : IIO 지정자의 셀 수. 일반적으로 노드의 경우 0
단일 IIO 출력과 다중 IIO 출력을 갖는 노드에 대해 1이다.

트리거가없는 간단한 구성의 예 :

	adc: voltage-sensor@35 {
		compatible = "maxim,max1139";
		reg = <0x35>;
		#io-channel-cells = <1>;
	};

트리거가있는 구성의 예 :


	adc@35 {
		compatible = "some-vendor,some-adc";
		reg = <0x35>;

		adc1: iio-device@0 {
			#io-channel-cells = <1>;
			/* other properties */
		};
		adc2: iio-device@1 {
			#io-channel-cells = <1>;
			/* other properties */
		};
	};


== IIO 소비자 ==

필수 속성 :
io-channels : 장치에 대한 각 IIO 입력에 대해 한 쌍씩있는 phandle 및 IIO 지정자 쌍 목록입니다. 참고 : IIO 제공자가 # io- 채널 셀에 '0'을 지정하면,
쌍의 phandle 부분 만 나타납니다.

선택적 속성 :
io-channel-names :
io-channels 속성과 같은 순서로 정렬 된 IIO 입력 이름 문자열 목록입니다. 
소비자 드라이버는 IIO 입력 이름과 IIO 지정자를 일치시키기 위해 io-channel-names를 사용합니다.

io-channel-ranges :
아이 노드가이 노드로부터 지정된 IIO 채널을 상속 할 수있는 것을 나타내는 empty property입니다. 
버스 노드가 자녀에게 IIO 채널을 제공하는 데 유용합니다.

For example:

	device {
		io-channels = <&adc 1>, <&ref 0>;
		io-channel-names = "vcc", "vdd";
	};


이것은 "vcc"및 "vdd"라는 두 개의 IIO 입력을 갖는 장치를 나타냅니다.
vcc 채널은 & adc 장치의 출력 1에 연결되고 vdd 채널은 & ref 장치의 출력 0에 연결됩니다.


==Example==

	adc: max1139@35 {
		compatible = "maxim,max1139";
		reg = <0x35>;
		#io-channel-cells = <1>;
	};

	...

	iio_hwmon {
		compatible = "iio-hwmon";
		io-channels = <&adc 0>, <&adc 1>, <&adc 2>,
			<&adc 3>, <&adc 4>, <&adc 5>,
			<&adc 6>, <&adc 7>, <&adc 8>,
			<&adc 9>;
	};

	some_consumer {
		compatible = "some-consumer";
		io-channels = <&adc 10>, <&adc 11>;
		io-channel-names = "adc1", "adc2";
	};


*/
```

## Doc/DeviceDriver/devicetree/bindings/iio/imu/inv_mpu6050.txt
```
InvenSense MPU-6050 Six-Axis (Gyro + Accelerometer) MEMS MotionTracking Device

http://www.invensense.com/mems/gyro/mpu6050.html

Required properties:
 - compatible : should be "invensense,mpu6050"
 - reg : the I2C address of the sensor
 - interrupt-parent : should be the phandle for the interrupt controller
 - interrupts : interrupt mapping for GPIO IRQ

Example:
	mpu6050@68 {
		compatible = "invensense,mpu6050";
		reg = <0x68>;
		interrupt-parent = <&gpio1>;
		interrupts = <18 1>;
	};

/*
InvenSense MPU-6050 6 축 (자이로 + 가속도계) MEMS 모션 트래킹 장치

http://www.invensense.com/mems/gyro/mpu6050.html

필수 속성 :
  - 호환 가능 : "invensense, mpu6050"이어야합니다.
  - reg : 센서의 I2C 주소
  - interrupt-parent : 인터럽트 컨트롤러의 phandle이어야합니다.
  - 인터럽트 : GPIO IRQ에 대한 인터럽트 매핑


Example:
	mpu6050@68 {
		compatible = "invensense,mpu6050";
		reg = <0x68>;
		interrupt-parent = <&gpio1>;
		interrupts = <18 1>;
	};

*/
```

## Doc/DeviceDriver/devicetree/bindings/iio/light/apds9960.txt
```
* Avago APDS9960 gesture/RGB/ALS/proximity sensor

http://www.avagotech.com/docs/AV02-4191EN

Required properties:

  - compatible: must be "avago,apds9960"
  - reg: the I2c address of the sensor
  - interrupt-parent: should be the phandle for the interrupt controller
  - interrupts : the sole interrupt generated by the device

  Refer to interrupt-controller/interrupts.txt for generic interrupt client
  node bindings.

Example:

apds9960@39 {
	compatible = "avago,apds9960";
	reg = <0x39>;
	interrupt-parent = <&gpio1>;
	interrupts = <16 1>;
};

/*
* Avago APDS9960 제스처 / RGB / ALS / 근접 센서

http://www.avagotech.com/docs/AV02-4191EN

필수 속성 :

   - 호환 가능 : "avago, apds9960"이어야합니다.
   - reg : 센서의 I2c 주소
   - interrupt-parent : 인터럽트 컨트롤러의 phandle이어야합니다.
   - 인터럽트 : 장치에 의해 생성 된 유일한 인터럽트

   제네릭 인터럽트 클라이언트 노드 바인딩에 대해서는 interrupt-controller / interrupts.txt를 참조하십시오.

Example:

apds9960@39 {
	compatible = "avago,apds9960";
	reg = <0x39>;
	interrupt-parent = <&gpio1>;
	interrupts = <16 1>;
};

*/
```

## Doc/DeviceDriver/devicetree/bindings/iio/light/cm36651.txt
```
* Capella CM36651 I2C Proximity and Color Light sensor

Required properties:
- compatible: must be "capella,cm36651"
- reg: the I2C address of the device
- interrupts: interrupt-specifier for the sole interrupt
	      generated by the device
- vled-supply: regulator for the IR LED. IR_LED is a part
	      of the cm36651 for proximity detection.
	      As covered in ../../regulator/regulator.txt

Example:

	i2c_cm36651: i2c-gpio {
		/* ... */

		cm36651@18 {
			compatible = "capella,cm36651";
			reg = <0x18>;
			interrupt-parent = <&gpx0>;
			interrupts = <2 0>;
			vled-supply = <&ps_als_reg>;
		};

		/* ... */
	};

/*

* Capella CM36651 I2C 근접 및 컬러 광 센서

필수 속성 :
- 호환 : "capella, cm36651"여야합니다.
- reg : 장치의 I2C 주소
- interrupts : 장치에 의해 생성 된 유일한 인터럽트에 대한 인터럽트 지정자
- vled-supply : IR LED 용 레귤레이터. IR_LED는 근접 감지를 위해 cm36651의 일부입니다.
../../regulator/regulator.txt에 명시된대로


Example:

	i2c_cm36651: i2c-gpio {
		/* ... */

		cm36651@18 {
			compatible = "capella,cm36651";
			reg = <0x18>;
			interrupt-parent = <&gpx0>;
			interrupts = <2 0>;
			vled-supply = <&ps_als_reg>;
		};

		/* ... */
	};


*/
```

## Doc/DeviceDriver/devicetree/bindings/iio/light/gp2ap020a00f.txt
```
* Sharp GP2AP020A00F I2C Proximity/ALS sensor

The proximity detector sensor requires power supply
for its built-in led. It is also defined by this binding.

Required properties:

  - compatible : should be "sharp,gp2ap020a00f"
  - reg : the I2C slave address of the light sensor
  - interrupts : interrupt specifier for the sole interrupt generated
		 by the device
  - vled-supply : VLED power supply, as covered in ../regulator/regulator.txt

Example:

gp2ap020a00f@39 {
	compatible = "sharp,gp2ap020a00f";
	reg = <0x39>;
	interrupts = <2 0>;
	vled-supply = <...>;
};

/*

* 샤프 GP2AP020A00F I2C 근접 / ALS 센서

근접 감지기 센서는 내장 된 전원 공급 장치가 필요합니다. 또한이 바인딩에 의해 정의됩니다.

필수 속성 :

   - 호환 가능 : "sharp, gp2ap020a00f"여야합니다.
   - reg : 광 센서의 I2C 슬레이브 주소
   - 인터럽트 : 장치에 의해 생성 된 유일한 인터럽트에 대한 인터럽트 지정자
   - vled-supply : ../regulator/regulator.txt에 명시된 VLED 전원 공급 장치


Example:

gp2ap020a00f@39 {
	compatible = "sharp,gp2ap020a00f";
	reg = <0x39>;
	interrupts = <2 0>;
	vled-supply = <...>;
};

*/
```

## Doc/DeviceDriver/devicetree/bindings/iio/light/tsl2563.txt
```
* AMS TAOS TSL2563 ambient light sensor

Required properties:

  - compatible : should be "amstaos,tsl2563"
  - reg : the I2C address of the sensor

Optional properties:

  - amstaos,cover-comp-gain : integer used as multiplier for gain
                              compensation (default = 1)

Example:

tsl2563@29 {
	compatible = "amstaos,tsl2563";
	reg = <0x29>;
	amstaos,cover-comp-gain = <16>;
};

/*
* AMS TAOS TSL2563 주변 광선 센서

필수 속성 :

   - 호환 가능 : "amstaos, tsl2563"이어야합니다.
   - reg : 센서의 I2C 주소

선택 속성 :

   - amstaos, cover-comp-gain : 이득을위한 승수로 사용되는 정수
                               보상 (기본값 = 1)

Example:

tsl2563@29 {
	compatible = "amstaos,tsl2563";
	reg = <0x29>;
	amstaos,cover-comp-gain = <16>;
};

*/
```

## Doc/DeviceDriver/devicetree/bindings/iio/light/us5182d.txt
```
* UPISEMI us5182d I2C ALS and Proximity sensor

Required properties:
- compatible: must be "upisemi,usd5182"
- reg: the I2C address of the device

Optional properties:
- upisemi,glass-coef: glass attenuation factor - compensation factor of
                      resolution 1000 for material transmittance.
- upisemi,dark-ths: array of 8 elements containing 16-bit thresholds (adc
                    counts) corresponding to every scale.
- upisemi,upper-dark-gain: 8-bit dark gain compensation factor(4 int and 4
                           fractional bits - Q4.4) applied when light > threshold
- upisemi,lower-dark-gain: 8-bit dark gain compensation factor(4 int and 4
                           fractional bits - Q4.4) applied when light < threshold

If the optional properties are not specified these factors will default to the
values in the below example.
The glass-coef defaults to no compensation for the covering material.
The threshold array defaults to experimental values that work with US5182D
sensor on evaluation board - roughly between 12-32 lux.
There will be no dark-gain compensation by default when ALS > thresh
(0 * dark-gain), and a 1.35 compensation factor when ALS < thresh.

Example:

    usd5182@39 {
                compatible = "upisemi,usd5182";
                reg = <0x39>;
                upisemi,glass-coef = < 1000 >;
                upisemi,dark-ths = /bits/ 16 <170 200 512 512 800 2000 4000 8000>;
                upisemi,upper-dark-gain = /bits/ 8 <0x00>;
                upisemi,lower-dark-gain = /bits/ 8 <0x16>;
    };



/*

* UPISEMI us5182d I2C ALS 및 근접 센서

필수 속성 :
- 호환 : "upisemi, usd5182"여야합니다.
- reg : 장치의 I2C 주소

선택적 속성 :
- upisemi, glass-coef : (glass attenuation factor)유리 감쇠 계수 - 재료 투과율에 대한 분해능 1000의 보상 계수.
- upisemi, dark-ths : 모든 스케일에 해당하는 16 비트 임계 값 (adc 카운트)을 포함하는 8 개 요소의 배열입니다.
- upisemi, upper-dark-gain : light> threshold 일 때 적용되는 8 비트 다크 게인 보정 계수 (4 int 및 4 fractional 비트 - Q4.4)
- upisemi, lower-dark-gain : 8 비트 다크 게인 보정 계수 (4 int 및 4 fractional 비트 - Q4.4)

선택적 속성을 지정하지 않으면 이러한 요소는 기본적으로 아래 예제의 값으로 설정됩니다.
glass-coef는 기본적으로 덮개 재질에 대한 보정을하지 않습니다.
임계 값 배열의 기본값은 평가 보드의 US5182D 센서에서 작동하는 실험 값입니다 (대략 12-32 럭스 사이).
ALS> thresh (0 * dark-gain) 일 때 dark-gain 보상은 없으며 ALS <thresh 일 때 1.35 보정 계수가됩니다.

Example:

    usd5182@39 {
                compatible = "upisemi,usd5182";
                reg = <0x39>;
                upisemi,glass-coef = < 1000 >;
                upisemi,dark-ths = /bits/ 16 <170 200 512 512 800 2000 4000 8000>;
                upisemi,upper-dark-gain = /bits/ 8 <0x00>;
                upisemi,lower-dark-gain = /bits/ 8 <0x16>;
    };


*/
```

## Doc/DeviceDriver/devicetree/bindings/iio/magnetometer/ak8975.txt
```
* AsahiKASEI AK8975 magnetometer sensor

Required properties:

  - compatible : should be "asahi-kasei,ak8975"
  - reg : the I2C address of the magnetometer

Optional properties:

  - gpios : should be device tree identifier of the magnetometer DRDY pin

Example:

ak8975@0c {
        compatible = "asahi-kasei,ak8975";
        reg = <0x0c>;
        gpios = <&gpj0 7 0>;
};

/*

* 아사히 카세이 AK8975 자력계 센서

필수 속성 :

   - 호환 가능 : "asahi-kasei, ak8975"여야합니다.
   - reg : 자력계의 I2C 주소

선택 속성 :

   - gpios : 자력계 DRDY 핀의 장치 트리 식별자 여야합니다.

Example:

ak8975@0c {
        compatible = "asahi-kasei,ak8975";
        reg = <0x0c>;
        gpios = <&gpj0 7 0>;
};

*/
```

## Doc/DeviceDriver/devicetree/bindings/iio/magnetometer/bmc150_magn.txt
```
* Bosch BMC150 magnetometer sensor

http://ae-bst.resource.bosch.com/media/products/dokumente/bmc150/BST-BMC150-DS000-04.pdf

Required properties:

  - compatible : should be "bosch,bmc150_magn"
  - reg : the I2C address of the magnetometer

Optional properties:

  - interrupt-parent : phandle to the parent interrupt controller
  - interrupts : interrupt mapping for GPIO IRQ

Example:

bmc150_magn@12 {
        compatible = "bosch,bmc150_magn";
        reg = <0x12>;
        interrupt-parent = <&gpio1>;
        interrupts = <0 1>;
};

/*
* Bosch BMC150 자력계 센서

http://ae-bst.resource.bosch.com/media/products/dokumente/bmc150/BST-BMC150-DS000-04.pdf

필수 속성 :

   - 호환 가능 : "bosch, bmc150_magn"이어야합니다.
   - reg : 자력계의 I2C 주소

선택 속성 :

   --interrupt-parent : 부모 인터럽트 컨트롤러와 연결
   - 인터럽트 : GPIO IRQ에 대한 인터럽트 매핑

Example:

bmc150_magn@12 {
        compatible = "bosch,bmc150_magn";
        reg = <0x12>;
        interrupt-parent = <&gpio1>;
        interrupts = <0 1>;
};


*/
```

## Doc/DeviceDriver/devicetree/bindings/iio/magnetometer/hmc5843.txt
```
* Honeywell HMC5843 magnetometer sensor

Required properties:

  - compatible : should be "honeywell,hmc5843"
  Other models which are supported with driver are:
	"honeywell,hmc5883"
	"honeywell,hmc5883l"
	"honeywell,hmc5983"
  - reg : the I2C address of the magnetometer - typically 0x1e

Optional properties:

  - gpios : should be device tree identifier of the magnetometer DRDY pin

Example:

hmc5843@1e {
        compatible = "honeywell,hmc5843"
        reg = <0x1e>;
};



/*

* Honeywell HMC5843 자력계 센서

필수 속성 :

   - 호환 가능 : "honeywell, hmc5843"이어야합니다.
   드라이버로 지원되는 다른 모델은 다음과 같습니다.
"하니웰, hmc5883"
"하니웰, hmc5883l"
"하니웰, hmc5983"
   - reg : 자력계의 I2C 주소 - 일반적으로 0x1e

선택 속성 :

   - gpios : 자력계 DRDY 핀의 장치 트리 식별자 여야합니다.

Example:

hmc5843@1e {
        compatible = "honeywell,hmc5843"
        reg = <0x1e>;
};

*/
```
