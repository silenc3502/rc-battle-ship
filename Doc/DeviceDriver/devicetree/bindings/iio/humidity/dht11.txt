## Doc/DeviceDriver/devicetree/bindings/metag/meta.txt
```
* Meta Processor Binding

This binding specifies what properties must be available in the device tree
representation of a Meta Processor Core, which is the root node in the tree.

Required properties:

    - compatible: Specifies the compatibility list for the Meta processor.
      The type shall be <string> and the value shall include "img,meta".

Optional properties:

    - clocks: Clock consumer specifiers as described in
      Documentation/devicetree/bindings/clock/clock-bindings.txt

    - clock-names: Clock consumer names as described in
      Documentation/devicetree/bindings/clock/clock-bindings.txt.

Clocks are identified by name. Valid clocks are:

    - "core": The Meta core clock from which the Meta timers are derived.

* 메타 프로세서 바인딩

이 바인딩은 트리의 루트 노드 인 메타 프로세서 코어의 장치 트리 표현에서 사용할 수 있어야하는 속성을 지정합니다.

필수 속성 :

     - compatible : 메타 프로세서의 호환성 목록을 지정합니다.
       유형은 <string>이고 값은 "img, meta"를 포함해야합니다.

선택적 속성 :

     - clocks : Documentation / devicetree / bindings / clock / clock-bindings.txt에 설명 된  Clock consumer specifiers

     - clock-names : Documentation / devicetree / bindings / clock / clock-bindings.txt에 설명 된  Clock consumer names

Clocks는 이름으로 식별됩니다. 유효한 Clocks는 다음과 같습니다.

     - "코어": 메타 타이머가 파생 된 메타 코어 클럭.




* Examples

/ {
	compatible = "toumaz,tz1090", "img,meta";

	clocks = <&meta_core_clk>;
	clock-names = "core";
};
```

## Doc/DeviceDriver/devicetree/bindings/misc/arm-charlcd.txt
```
ARM Versatile Character LCD
-----------------------------------------------------
This binding defines the character LCD interface found on ARM Versatile AB
and PB reference platforms.

Required properties:
- compatible : "arm,versatile-clcd"
- reg : Location and size of character LCD registers

Optional properties:
- interrupts - single interrupt for character LCD. The character LCD can
  operate in polled mode without an interrupt.

ARM 다용도 문자 LCD
-------------------------------------------------- ---
이 바인딩은 ARM Versatile AB 및 PB 참조 플랫폼에서 발견되는 문자 LCD 인터페이스를 정의합니다.

필수 속성 :
- 호환 가능 : "arm, versatile-clcd"
- reg : 문자 LCD 레지스터의 위치와 크기

선택적 속성 :
- 인터럽트 - 문자 LCD의 단일 인터럽트. 문자 LCD는 인터럽트없이 폴링 모드로 작동 할 수 있습니다.



Example:
	lcd@10008000 {
		compatible = "arm,versatile-lcd";
		reg = <0x10008000 0x1000>;
	};
```

## Doc/DeviceDriver/devicetree/bindings/misc/atmel-ssc.txt
```
* Atmel SSC driver.
* Atmel SSC 드라이버.

Required properties:
- compatible: "atmel,at91rm9200-ssc" or "atmel,at91sam9g45-ssc"
	- atmel,at91rm9200-ssc: support pdc transfer
	- atmel,at91sam9g45-ssc: support dma transfer
- reg: Should contain SSC registers location and length
- interrupts: Should contain SSC interrupt
- clock-names: tuple listing input clock names.
	Required elements: "pclk"
- clocks: phandles to input clocks.
필수 속성 :
- 호환 : "atmel, at91rm9200-ssc"또는 "atmel, at91sam9g45-ssc"
- atmel, at91rm9200-ssc : pdc 전송 지원
- atmel, at91sam9g45-ssc : dma transfer 지원
- reg : SSC 레지스터 위치와 길이를 포함해야 함
- 인터럽트 : SSC 인터럽트를 포함해야합니다.
- clock-names : 튜플에 입력 클럭 이름을 나열합니다.
필수 요소 : "pclk"
- clocks : 입력 클락에 대한 phandles.

Required properties for devices compatible with "atmel,at91sam9g45-ssc":
- dmas: DMA specifier, consisting of a phandle to DMA controller node,
  the memory interface and SSC DMA channel ID (for tx and rx).
  See Documentation/devicetree/bindings/dma/atmel-dma.txt for details.
- dma-names: Must be "tx", "rx".
"atmel, at91sam9g45-ssc"와 호환되는 장치의 필수 속성 :
- dmas : DMA 컨트롤러 노드에 대한 phandle, 메모리 인터페이스 및 SSC DMA 채널 ID (tx 및 rx의 경우)로 구성된 DMA 지정자입니다. 자세한 내용은 Documentation / devicetree / bindings / dma / atmel-dma.txt를 참조하십시오.
- dma-names : "tx", "rx"여야합니다.

Optional properties:
  - atmel,clk-from-rk-pin: bool property.
     - When SSC works in slave mode, according to the hardware design, the
       clock can get from TK pin, and also can get from RK pin. So, add
       this parameter to choose where the clock from.
     - By default the clock is from TK pin, if the clock from RK pin, this
       property is needed.
선택적 속성 :
   - atmel, clk-from-rk-pin : bool 속성.
      - SSC가 슬레이브 모드로 동작 할 때, 하드웨어 설계에 따라 clock는 TK 핀으로부터 얻을 수 있고 RK 핀으로부터도 얻을 수 있습니다. 따라서이 매개 변수를 추가하여 clock의 위치를  선택하십시오.
      - 기본적으로 클록은 TK 핀에서 나오며, RK 핀의 클럭 인 경우이 속성이 필요합니다.



Examples:
- PDC transfer:
ssc0: ssc@fffbc000 {
	compatible = "atmel,at91rm9200-ssc";
	reg = <0xfffbc000 0x4000>;
	interrupts = <14 4 5>;
	clocks = <&ssc0_clk>;
	clock-names = "pclk";
};

- DMA transfer:
ssc0: ssc@f0010000 {
      compatible = "atmel,at91sam9g45-ssc";
      reg = <0xf0010000 0x4000>;
      interrupts = <28 4 5>;
      dmas = <&dma0 1 13>,
	     <&dma0 1 14>;
      dma-names = "tx", "rx";
      pinctrl-names = "default";
      pinctrl-0 = <&pinctrl_ssc0_tx &pinctrl_ssc0_rx>;
      status = "disabled";
};
```

## Doc/DeviceDriver/devicetree/bindings/misc/brcm,kona-smc.txt
```
Broadcom Secure Monitor Bounce buffer
-----------------------------------------------------
This binding defines the location of the bounce buffer
used for non-secure to secure communications.

Required properties:
- compatible : "brcm,kona-smc"
- DEPRECATED: compatible : "bcm,kona-smc"
- reg : Location and size of bounce buffer

Broadcom Secure Monitor 바운스 버퍼
-------------------------------------------------- ---
이 바인딩은 보안되지 않은 통신에 사용되는 바운스 버퍼의 위치를 정의합니다.

필수 속성 :
- 호환 : "brcm, kona-smc"
- 사용 불능 : 호환 : "bcm, kona-smc"
- reg : 바운스 버퍼의 위치와 크기

Example:
	smc@0x3404c000 {
		compatible = "brcm,bcm11351-smc", "brcm,kona-smc";
		reg = <0x3404c000 0x400>; //1 KiB in SRAM
	};
```

## Doc/DeviceDriver/devicetree/bindings/misc/dra7xx-debugss.txt
```
Texas Instruments Debug Sub-System (DebugSS) module for DRA7xx devices

Required properties:
- compatible : Should be "ti,dra7xx-debugss"

Optional properties:
- clocks : the clocks feeding the Debug sub-system.
- clocks-names : clock name strings correspond to the clocks
		 defined above. These strings are used inside
		 module source code to identify the respective
                 clocks

Documentation:
http://www.ti.com/lit/ds/symlink/dra746.pdf


DRA7xx 디바이스 용 Texas Instruments 디버그 서브 시스템 (DebugSS) 모듈

필수 속성 :
- 호환 : "ti, dra7xx-debugss"여야합니다.

선택적 속성 :
- clocks : Debug 서브 시스템에 공급되는 clocks.
- clocks-names : clock name strings 은 위에 정의 된 clock 에 해당합니다. 이 문자열은 모듈 소스 코드 내에서 각각의 클럭을 식별하는 데 사용됩니다


Examples:

debugss: debugss {
        compatible = "ti,dra7xx-debugss";
        clocks = <&sys_clkin1>;
        clock-names = "sysclockin1";
};
```

## Doc/DeviceDriver/devicetree/bindings/misc/fsl,qoriq-mc.txt
```
* Freescale Management Complex

The Freescale Management Complex (fsl-mc) is a hardware resource
manager that manages specialized hardware objects used in
network-oriented packet processing applications. After the fsl-mc
block is enabled, pools of hardware resources are available, such as
queues, buffer pools, I/O interfaces. These resources are building
blocks that can be used to create functional hardware objects/devices
such as network interfaces, crypto accelerator instances, L2 switches,
etc.
Freescale Management Complex (fsl-mc)는 네트워크 지향 패킷 처리 어플리케이션에 사용되는 특수 하드웨어 오브젝트를 관리하는 하드웨어 자원 관리자입니다. fsl-mc 블록이 사용 가능 해지면 대기열, 버퍼 풀, I / O 인터페이스와 같은 하드웨어 자원의 풀을 사용할 수 있습니다. 이러한 리소스는 네트워크 인터페이스, 암호 가속기 인스턴스, L2 스위치 등과 같은 기능 하드웨어 개체 / 장치를 만드는 데 사용할 수있는 구성 요소입니다.

Required properties:

    - compatible
        Value type: <string>
        Definition: Must be "fsl,qoriq-mc".  A Freescale Management Complex
                    compatible with this binding must have Block Revision
                    Registers BRR1 and BRR2 at offset 0x0BF8 and 0x0BFC in
                    the MC control register region.

    - reg
        Value type: <prop-encoded-array>
        Definition: A standard property.  Specifies one or two regions
                    defining the MC's registers:

                       -the first region is the command portal for the
                        this machine and must always be present

                       -the second region is the MC control registers. This
                        region may not be present in some scenarios, such
                        as in the device tree presented to a virtual machine.
필수 속성 :

     - 호환 가능
         값 유형 : <문자열>
         정의 : "fsl, qoriq-mc"여야합니다. 이 바인딩과 호환되는 Freescale Management Complex는 블록 제어 레지스터 BRR1과 BRR2가 오프셋 0x0BF8에 있고
         0x0BFC가 MC 제어 레지스터 영역에 있어야합니다.

     - reg
         값 유형 : <prop-encoded-array>
         정의 : 표준 속성. MC의 레지스터를 정의하는 하나 또는 두 개의 영역을 지정합니다.

                        - 첫 번째 영역은이 시스템의 명령 포털이며 항상 존재해야합니다

                        - 두 번째 영역은 MC 제어 레지스터입니다. 이 영역은 가상 시스템에 제공된 장치 트리와 같이 일부 시나리오에는 나타나지 않을 수 있습니다.
Example:

        fsl_mc: fsl-mc@80c000000 {
                compatible = "fsl,qoriq-mc";
                reg = <0x00000008 0x0c000000 0 0x40>,    /* MC portal base */
                      <0x00000000 0x08340000 0 0x40000>; /* MC control reg */
        };
```
