## Doc/DeviceDriver/devicetree/bindings/cpufreq/arm_big_little_dt.txt
```
Generic ARM big LITTLE cpufreq driver's DT glue
-----------------------------------------------

This is DT specific glue layer for generic cpufreq driver for big LITTLE
systems.

Both required and optional properties listed below must be defined
under node /cpus/cpu@x. Where x is the first cpu inside a cluster.

FIXME: Cpus should boot in the order specified in DT and all cpus for a cluster
must be present contiguously. Generic DT driver will check only node 'x' for
cpu:x.

Required properties:
- operating-points: Refer to Documentation/devicetree/bindings/power/opp.txt
  for details

Optional properties:
- clock-latency: Specify the possible maximum transition latency for clock,
  in unit of nanoseconds.

//이것은 큰 LITTLE 시스템을위한 일반적인 cpufreq 드라이버를위한 DT 특정 접착제 레이어입니다.

아래에 나열된 필수 속성과 선택적 속성은 모두 노드 / cpus / cpu @ x에 정의해야합니다. 여기서 x는 클러스터 내의 첫 x 째 CPU입니다.

FIXME : Cpus는 DT에 지정된 순서대로 부팅해야하며 클러스터에 대한 모든 CPU는 연속적으로 존재해야합니다. 일반 DT 드라이버는 cpu : x 노드 'x'만 검사합니다.

필수 속성 :
- 작동 포인트 : 자세한 내용은 Documentation / devicetree / bindings / power / opp.txt를 참조하십시오.

선택적 속성 :
- clock-latency : 시계에 가능한 최대 천이 대기 시간을 나노초 단위로 지정합니다.

Examples:

cpus {
	#address-cells = <1>;
	#size-cells = <0>;

	cpu@0 {
		compatible = "arm,cortex-a15";
		reg = <0>;
		next-level-cache = <&L2>;
		operating-points = <
			/* kHz    uV */
			792000  1100000
			396000  950000
			198000  850000
		>;
		clock-latency = <61036>; /* two CLK32 periods */
	};

	cpu@1 {
		compatible = "arm,cortex-a15";
		reg = <1>;
		next-level-cache = <&L2>;
	};

	cpu@100 {
		compatible = "arm,cortex-a7";
		reg = <100>;
		next-level-cache = <&L2>;
		operating-points = <
			/* kHz    uV */
			792000  950000
			396000  750000
			198000  450000
		>;
		clock-latency = <61036>; /* two CLK32 periods */
	};

	cpu@101 {
		compatible = "arm,cortex-a7";
		reg = <101>;
		next-level-cache = <&L2>;
	};
};
```

## Doc/DeviceDriver/devicetree/bindings/cpufreq/cpufreq-dt.txt
```
Generic cpufreq driver

It is a generic DT based cpufreq driver for frequency management.  It supports
both uniprocessor (UP) and symmetric multiprocessor (SMP) systems which share
clock and voltage across all CPUs.

Both required and optional properties listed below must be defined
under node /cpus/cpu@0.
//빈도 관리를위한 범용 DT 기반 cpufreq 드라이버입니다. 모든 CPU에서 클럭 및 전압을 공유하는 단일 프로세서 (UP) 및 대칭 다중 프로세서 (SMP) 시스템을 모두 지원합니다.

아래 나열된 필수 및 선택 속성 둘 다 노드 / cpus / cpu @ 0에 정의해야합니다.

Required properties:
- None

Optional properties:
- operating-points: Refer to Documentation/devicetree/bindings/power/opp.txt for
  details. OPPs *must* be supplied either via DT, i.e. this property, or
  populated at runtime.
- clock-latency: Specify the possible maximum transition latency for clock,
  in unit of nanoseconds.
- voltage-tolerance: Specify the CPU voltage tolerance in percentage.
- #cooling-cells:
- cooling-min-level:
- cooling-max-level:
     Please refer to Documentation/devicetree/bindings/thermal/thermal.txt.
//필수 속성 :
- 없음

선택적 속성 :
- 작동 포인트 : 자세한 내용은 Documentation / devicetree / bindings / power / opp.txt를 참조하십시오. OPP *는 DT, 즉이 속성을 통해 제공되거나 런타임에 채워 져야합니다.
- clock-latency : 시계에 가능한 최대 천이 대기 시간을 나노초 단위로 지정합니다.
- 전압 허용 오차 : CPU 전압 허용 오차를 백분율로 지정하십시오.
- 냉각 셀 # 개 :
- 냉각 min 수준 :
- 냉각 최대 온도 :
      Documentation / devicetree / bindings / thermal / thermal.txt를 참조하십시오.

Examples:

cpus {
	#address-cells = <1>;
	#size-cells = <0>;

	cpu@0 {
		compatible = "arm,cortex-a9";
		reg = <0>;
		next-level-cache = <&L2>;
		operating-points = <
			/* kHz    uV */
			792000  1100000
			396000  950000
			198000  850000
		>;
		clock-latency = <61036>; /* two CLK32 periods */
		#cooling-cells = <2>;
		cooling-min-level = <0>;
		cooling-max-level = <2>;
	};

	cpu@1 {
		compatible = "arm,cortex-a9";
		reg = <1>;
		next-level-cache = <&L2>;
	};

	cpu@2 {
		compatible = "arm,cortex-a9";
		reg = <2>;
		next-level-cache = <&L2>;
	};

	cpu@3 {
		compatible = "arm,cortex-a9";
		reg = <3>;
		next-level-cache = <&L2>;
	};
};
```

## Doc/DeviceDriver/devicetree/bindings/cpufreq/cpufreq-exynos5440.txt
```
Exynos5440 cpufreq driver
-------------------

Exynos5440 SoC cpufreq driver for CPU frequency scaling.

Required properties:
- interrupts: Interrupt to know the completion of cpu frequency change.
- operating-points: Table of frequencies and voltage CPU could be transitioned into,
	in the decreasing order. Frequency should be in KHz units and voltage
	should be in microvolts.

Optional properties:
- clock-latency: Clock monitor latency in microsecond.

All the required listed above must be defined under node cpufreq.
//CPU 주파수 조정을위한 Exynos5440 SoC cpufreq 드라이버

필수 속성 :
- interrupts : CPU 주파수 변경 완료를 알리는 인터럽트입니다.
- 작동 점 : CPU가 감소 할 수있는 주파수 및 전압 표. 주파수는 KHz 단위이어야하며 전압은 마이크로 볼트 단위 여야합니다.

선택적 속성 :
- clock-latency : 마이크로 초 단위의 클럭 모니터 대기 시간.

위에 나열된 모든 요구 사항은 노드 cpufreq에서 정의되어야합니다.

Example:
--------
	cpufreq@160000 {
		compatible = "samsung,exynos5440-cpufreq";
		reg = <0x160000 0x1000>;
		interrupts = <0 57 0>;
		operating-points = <
				1000000 975000
				800000  925000>;
		clock-latency = <100000>;
	};
```

## Doc/DeviceDriver/devicetree/bindings/cpufreq/cpufreq-spear.txt
```
SPEAr cpufreq driver
-------------------

SPEAr SoC cpufreq driver for CPU frequency scaling.
It supports both uniprocessor (UP) and symmetric multiprocessor (SMP) systems
which share clock across all CPUs.

Required properties:
- cpufreq_tbl: Table of frequencies CPU could be transitioned into, in the
  increasing order.

Optional properties:
- clock-latency: Specify the possible maximum transition latency for clock, in
  unit of nanoseconds.

Both required and optional properties listed above must be defined under node
/cpus/cpu@0.

//SPEAr CPU 주파수 스케일링을위한 SoC cpufreq 드라이버.
모든 CPU에서 클럭을 공유하는 단일 프로세서 (UP) 및 대칭 다중 프로세서 (SMP) 시스템을 모두 지원합니다.

필수 속성 :
- cpufreq_tbl : CPU가 증가 할 수있는 주파수 테이블.

선택적 속성 :
- clock-latency : 시계에 가능한 최대 천이 대기 시간을 나노초 단위로 지정합니다.

위에 나열된 필수 속성과 선택적 속성은 모두 노드 / cpus / cpu @ 0에 정의해야합니다.


Examples:
--------
cpus {

	<...>

	cpu@0 {
		compatible = "arm,cortex-a9";
		reg = <0>;

		<...>

		cpufreq_tbl = < 166000
				200000
				250000
				300000
				400000
				500000
				600000 >;
	};

	<...>

};
```

## Doc/DeviceDriver/devicetree/bindings/cpufreq/tegra124-cpufreq.txt
```
Tegra124 CPU frequency scaling driver bindings
----------------------------------------------

Both required and optional properties listed below must be defined
under node /cpus/cpu@0.

Required properties:
- clocks: Must contain an entry for each entry in clock-names.
  See ../clocks/clock-bindings.txt for details.
- clock-names: Must include the following entries:
  - cpu_g: Clock mux for the fast CPU cluster.
  - cpu_lp: Clock mux for the low-power CPU cluster.
  - pll_x: Fast PLL clocksource.
  - pll_p: Auxiliary PLL used during fast PLL rate changes.
  - dfll: Fast DFLL clocksource that also automatically scales CPU voltage.
- vdd-cpu-supply: Regulator for CPU voltage

//아래 나열된 필수 및 선택 속성 둘 다 노드 / cpus / cpu @ 0에 정의해야합니다.

필수 속성 :
- clocks : clock-name의 각 항목에 대한 항목을 포함해야합니다.
   자세한 내용은 ../clocks/clock-bindings.txt를 참조하십시오.
- clock-names : 다음 항목을 포함해야합니다.
   - cpu_g : 빠른 CPU 클러스터를위한 클럭 멀티플렉서.
   - cpu_lp : 저전력 CPU 클러스터 용 클럭 mux.
   - pll_x : 빠른 PLL 클럭 소스.
   - pll_p : 빠른 PLL 속도 변경 중에 사용되는 보조 PLL입니다.
   - dfll : CPU 전압을 자동으로 조정하는 고속 DFLL 클럭 소스.
- vdd-cpu-supply : CPU 전압 조정기

Optional properties:
- clock-latency: Specify the possible maximum transition latency for clock,
  in unit of nanoseconds.
//선택적 속성 :
- clock-latency : 시계에 가능한 최대 천이 대기 시간을 나노초 단위로 지정합니다.

Example:
--------
cpus {
	#address-cells = <1>;
	#size-cells = <0>;

	cpu@0 {
		device_type = "cpu";
		compatible = "arm,cortex-a15";
		reg = <0>;

		clocks = <&tegra_car TEGRA124_CLK_CCLK_G>,
			 <&tegra_car TEGRA124_CLK_CCLK_LP>,
			 <&tegra_car TEGRA124_CLK_PLL_X>,
			 <&tegra_car TEGRA124_CLK_PLL_P>,
			 <&dfll>;
		clock-names = "cpu_g", "cpu_lp", "pll_x", "pll_p", "dfll";
		clock-latency = <300000>;
		vdd-cpu-supply: <&vdd_cpu>;
	};

	<...>
};
```

## Doc/DeviceDriver/devicetree/bindings/cpufreq/ti-cpufreq.txt
```
Bindings for TI's CPUFreq driver
================================

The ti-cpufreq driver works with the operating-points-v2 binding described
at [../opp/opp.txt] to make sure the proper OPPs for a platform get enabled
and then creates a "cpufreq-dt" platform device to leverage the cpufreq-dt
driver described in [cpufreq-dt.txt].

The ti-cpufreq driver uses the revision and an efuse value from an SoC to
provide the OPP framework with supported hardware information that is used
to determine which OPPs from the operating-points-v2 table get enabled. If
this information is not provided the driver simply skips providing it
but still creates the "cpufreq-dt" platform device, and if a different
operating-points table has been provided the system will use that and
function as normal, otherwise it is likely no OPPs will be available due
to the system being unable to determine safe values.
//ti-cpufreq 드라이버는 [../opp/opp.txt]에 설명 된 operating-points-v2 바인딩을 사용하여 플랫폼에 대한 올바른 OPP가 활성화되었는지 확인한 다음이를 활용할 수있는 "cpufreq-dt"플랫폼 장치를 만듭니다 cpufreq-dt 드라이버는 [cpufreq-dt.txt]에 설명되어 있습니다.

ti-cpufreq 드라이버는 SoC의 개정 및 efuse 값을 사용하여 OPP 프레임 워크에 지원되는 하드웨어 정보를 제공하며,이 하드웨어 정보는 operating-point-v2 테이블의 OPP가 활성화되었는지 확인하는 데 사용됩니다. 이 정보가 제공되지 않으면 드라이버는 단순히 제공을 건너 뛰지 만 "cpufreq-dt"플랫폼 장치를 생성하고 다른 작동 점 테이블이 제공되면 시스템은이를 사용하고 정상적으로 기능 할 것입니다. 그렇지 않으면 가능성이 없습니다 OPP는 시스템이 안전한 값을 결정할 수 없기 때문에 사용할 수 있습니다.

Required properties:
--------------------
In 'cpus' nodes:
- operating-points-v2: Phandle to the operating-points-v2 table to use
- ti,syscon-efuse: Syscon phandle, offset to efuse register, efuse register
		   mask, and efuse register shift to get the relevant bits
		   that describe OPP availability
- ti,syscon-rev: Syscon and offset used to look up revision value on SoC

In 'operating-points-v2' table:
- opp-supported-hw: Two bitfields indicating:
	1. Which revision of the SoC the OPP is supported by
	2. Which eFuse bits indicate this OPP is available

	A bitwise and is performed against these values and if any bit
	matches, the OPP gets enabled.
//필수 속성 :
--------------------
'cpus'노드 :
- 작동 점 -v2 : 사용할 작동 점 -v2 테이블로 파들링합니다.
- ti, syscon-efuse : OPP 가용성을 설명하는 관련 비트를 얻기 위해 Syscon phandle, efuse 레지스터 오프셋, efuse 레지스터 마스크 및 efuse 레지스터 시프트
- ti, syscon-rev : SoC에서 개정 값을 찾기 위해 사용되는 Syscon 및 오프셋

'운영 점 -v2'표에서
- opp-supported-hw : 다음을 나타내는 두 비트 필드 :
1. OPP가 지원하는 SoC의 개정판
2.이 OPP가 사용 가능한 것으로 나타내는 eFuse 비트

A 비트 및이 값에 대해 수행되며 비트가 일치하면 OPP가 활성화됩니다.

NOTE: Without the above, platform-device for "cpufreq-dt" is still created
      but no determination of which OPPs should be available is done, but this
      allows for use of a v1 operating-points table or operating-points-v2
      with no opp-supported-hw values set.
//참고 : 위 항목이 없으면 "cpufreq-dt"에 대한 플랫폼 장치가 생성되지만 어떤 OPP가 사용 가능해야하는지에 대한 결정은 수행되지 않지만 v1 작동 점 표나 작동 점 -v2를 사용할 수 있습니다 opp-supported-hw 값이 설정됩니다.

Example:
--------

/* From arch/arm/boot/dts/am4372.dtsi */
cpus {
	cpu: cpu@0 {
		...

		operating-points-v2 = <&cpu0_opp_table>;

		ti,syscon-efuse = <&scm_conf 0x610 0x3f 0>;
		ti,syscon-rev = <&scm_conf 0x600>;

		...
	};
};

cpu0_opp_table: opp_table0 {
	compatible = "operating-points-v2";
	opp50@300000000 {
		opp-hz = /bits/ 64 <300000000>;
		opp-microvolt = <950000>;
		opp-supported-hw = <0xFF 0x01>;
		opp-suspend;
	};

	opp100@600000000 {
		opp-hz = /bits/ 64 <600000000>;
		opp-microvolt = <1100000>;
		opp-supported-hw = <0xFF 0x04>;
	};

	opp120@720000000 {
		opp-hz = /bits/ 64 <720000000>;
		opp-microvolt = <1200000>;
		opp-supported-hw = <0xFF 0x08>;
	};

	oppturbo@800000000 {
		opp-hz = /bits/ 64 <800000000>;
		opp-microvolt = <1260000>;
		opp-supported-hw = <0xFF 0x10>;
	};

	oppnitro@1000000000 {
		opp-hz = /bits/ 64 <1000000000>;
		opp-microvolt = <1325000>;
		opp-supported-hw = <0xFF 0x20>;
	};
};
```

## Doc/DeviceDriver/devicetree/bindings/cris/axis.txt
```
Axis Communications AB
ARTPEC series SoC Device Tree Bindings
ARTPEC 시리즈 SoC 디바이스 트리 바인딩

CRISv32 based SoCs are ETRAX FS and ARTPEC-3:
CRISv32 기반 SoC는 ETRAX FS 및 ARTPEC-3 :

    - compatible = "axis,crisv32";
```

## Doc/DeviceDriver/devicetree/bindings/crypto/amd-ccp.txt
```
* AMD Cryptographic Coprocessor driver (ccp)

Required properties:
- compatible: Should be "amd,ccp-seattle-v1a"
- reg: Address and length of the register set for the device
- interrupt-parent: Should be the phandle for the interrupt controller
  that services interrupts for this device
- interrupts: Should contain the CCP interrupt

Optional properties:
- dma-coherent: Present if dma operations are coherent

* AMD Cryptographic Coprocessor 드라이버 (ccp)

필수 속성 :
- 호환 : "amd, ccp-seattle-v1a"여야합니다.
- reg : 장치에 설정된 레지스터의 주소와 길이
- interrupt-parent :이 장치에 대한 인터럽트를 서비스하는 인터럽트 컨트롤러의 phandle이어야합니다.
- interrupts : CCP 인터럽트를 포함해야합니다.

선택적 속성 :
- dma-coherent : dma 작업이 일관성이 있다면 제시하십시오.





Example:
	ccp@e0100000 {
		compatible = "amd,ccp-seattle-v1a";
		reg = <0 0xe0100000 0 0x10000>;
		interrupt-parent = <&gic>;
		interrupts = <0 3 4>;
	};
```

## Doc/DeviceDriver/devicetree/bindings/crypto/atmel-crypto.txt
```
* Atmel HW cryptographic accelerators

These are the HW cryptographic accelerators found on some Atmel products.

* Advanced Encryption Standard (AES)

Required properties:
- compatible : Should be "atmel,at91sam9g46-aes".
- reg: Should contain AES registers location and length.
- interrupts: Should contain the IRQ line for the AES.
- dmas: List of two DMA specifiers as described in
        atmel-dma.txt and dma.txt files.
- dma-names: Contains one identifier string for each DMA specifier
             in the dmas property.

Atmel HW 암호화 가속기

이들은 일부 Atmel 제품에서 발견 된 HW 암호화 가속기입니다.

* 고급 암호화 표준 (AES)

필수 속성 :
- 호환 : "atmel, at91sam9g46-aes"여야합니다.
- reg : AES 레지스터 위치와 길이를 포함해야합니다.
- 인터럽트 : AES 용 IRQ 라인을 포함해야합니다.
- dmas : atmel-dma.txt 및 dma.txt 파일에 설명 된대로 두 개의 DMA 지정자 목록입니다.
- dma-names : dmas 속성의 각 DMA 지정자에 대한 하나의 식별자 문자열을 포함합니다.

Example:
aes@f8038000 {
	compatible = "atmel,at91sam9g46-aes";
	reg = <0xf8038000 0x100>;
	interrupts = <43 4 0>;
	dmas = <&dma1 2 18>,
	       <&dma1 2 19>;
	dma-names = "tx", "rx";

* Triple Data Encryption Standard (Triple DES)

Required properties:
- compatible : Should be "atmel,at91sam9g46-tdes".
- reg: Should contain TDES registers location and length.
- interrupts: Should contain the IRQ line for the TDES.

Optional properties:
- dmas: List of two DMA specifiers as described in
        atmel-dma.txt and dma.txt files.
- dma-names: Contains one identifier string for each DMA specifier
             in the dmas property.

필수 속성 :
- 호환 : "atmel, at91sam9g46-tdes"여야합니다.
- reg : TDES 레지스터 위치와 길이를 포함해야합니다.
- 인터럽트 : TDES에 대한 IRQ 라인을 포함해야합니다.

선택적 속성 :
- dmas : atmel-dma.txt 및 dma.txt 파일에 설명 된대로 두 개의 DMA 지정자 목록입니다.
- dma-names : dmas 속성의 각 DMA 지정자에 대한 하나의 식별자 문자열을 포함합니다.




Example:
tdes@f803c000 {
	compatible = "atmel,at91sam9g46-tdes";
	reg = <0xf803c000 0x100>;
	interrupts = <44 4 0>;
	dmas = <&dma1 2 20>,
	       <&dma1 2 21>;
	dma-names = "tx", "rx";
};

* Secure Hash Algorithm (SHA)

Required properties:
- compatible : Should be "atmel,at91sam9g46-sha".
- reg: Should contain SHA registers location and length.
- interrupts: Should contain the IRQ line for the SHA.

Optional properties:
- dmas: One DMA specifiers as described in
        atmel-dma.txt and dma.txt files.
- dma-names: Contains one identifier string for each DMA specifier
             in the dmas property. Only one "tx" string needed.

필수 속성 :
- 호환 : "atmel, at91sam9g46-sha"여야합니다.
- reg : SHA 레지스터 위치와 길이를 포함해야합니다.
- 인터럽트 : SHA에 대한 IRQ 라인을 포함해야합니다.

선택적 속성 :
- dmas : atmel-dma.txt 및 dma.txt 파일에 설명 된대로 하나의 DMA 지정자.
- dma-names : dmas 속성의 각 DMA 지정자에 대한 하나의 식별자 문자열을 포함합니다. 하나의 "tx"문자열 만 필요합니다.


Example:
sha@f8034000 {
	compatible = "atmel,at91sam9g46-sha";
	reg = <0xf8034000 0x100>;
	interrupts = <42 4 0>;
	dmas = <&dma1 2 17>;
	dma-names = "tx";
};
```
