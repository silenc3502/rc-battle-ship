## Doc/DeviceDriver/devicetree/bindings/bus/omap-ocp2scp.txt
```
	* OMAP OCP2SCP - ocp interface to scp interface

properties:
- compatible : Should be "ti,am437x-ocp2scp" for AM437x processor
	       Should be "ti,omap-ocp2scp" for all others
- reg : Address and length of the register set for the device
- #address-cells, #size-cells : Must be present if the device has sub-nodes
- ranges : the child address space are mapped 1:1 onto the parent address space
- ti,hwmods : must be "ocp2scp_usb_phy"

Sub-nodes:
All the devices connected to ocp2scp are described using sub-node to ocp2scp



* OMAP OCP2SCP - scp 인터페이스에 대한 ocp 인터페이스

속성 :
- 호환 : AM437x 프로세서의 경우 "ti, am437x-ocp2scp"여야합니다. 다른 모든 경우에는 "ti, omap-ocp2scp"여야합니다.
- reg : 장치에 설정된 레지스터의 주소와 길이
- # address-cells, # size-cells : 장치에 하위 노드가있는 경우에 있어야합니다.
- 범위 : 하위 주소 공간이 상위 주소 공간에 1 : 1로 매핑됩니다.
- ti, hwmods : "ocp2scp_usb_phy"여야합니다.

하위 노드 :
ocp2scp에 연결된 모든 장치는 ocp2scp에 대한 하위 노드를 사용하여 설명됩니다.


ocp2scp@4a0ad000 {
	compatible = "ti,omap-ocp2scp";
	reg = <0x4a0ad000 0x1f>;
	#address-cells = <1>;
	#size-cells = <1>;
	ranges;
	ti,hwmods = "ocp2scp_usb_phy";

	subnode1 {
	...
	};

	subnode2 {
	...
	};
};
```

## Doc/DeviceDriver/devicetree/bindings/bus/renesas,bsc.txt
```
renesas,bsc.txtRenesas Bus State Controller (BSC)
==================================

The Renesas Bus State Controller (BSC, sometimes called "LBSC within Bus
Bridge", or "External Bus Interface") can be found in several Renesas ARM SoCs.
It provides an external bus for connecting multiple external devices to the
SoC, driving several chip select lines, for e.g. NOR FLASH, Ethernet and USB.

While the BSC is a fairly simple memory-mapped bus, it may be part of a PM
domain, and may have a gateable functional clock.
Before a device connected to the BSC can be accessed, the PM domain
containing the BSC must be powered on, and the functional clock
driving the BSC must be enabled.

 Renesas 버스 상태 컨트롤러 (BSC, 때로는 "LBSC 버스 브리지"또는 "외부 버스 인터페이스")는 여러  Renesas ARM SoC에서 찾을 수 있습니다. SoC에 여러 외부 장치를 연결하고, e.g. NOR FLASH, Ethernet 및 USB를 위해 여러 개의 칩 선택 라인을 구동하는 외부 버스를 제공합니다.



The bindings for the BSC extend the bindings for "simple-pm-bus".


Required properties
  - compatible: Must contain an SoC-specific value, and "renesas,bsc" and
		"simple-pm-bus" as fallbacks.
                SoC-specific values can be:
		"renesas,bsc-r8a73a4" for R-Mobile APE6 (r8a73a4)
		"renesas,bsc-sh73a0" for SH-Mobile AG5 (sh73a0)
  - #address-cells, #size-cells, ranges: Must describe the mapping between
		parent address and child address spaces.
  - reg: Must contain the base address and length to access the bus controller.

Optional properties:
  - interrupts: Must contain a reference to the BSC interrupt, if available.
  - clocks: Must contain a reference to the functional clock, if available.
  - power-domains: Must contain a reference to the PM domain, if available.

BSC의 바인딩은 "simple-pm-bus"의 바인딩을 확장합니다.

필수 속성
   - 호환 : SoC 전용 값이 있어야하며 "renesas, bsc"및 "simple-pm-bus"가 폴백이어야합니다.
                 SoC 특정 값은 다음과 같습니다.
R-Mobile APE6 용 "renesas, bsc-r8a73a4"(r8a73a4)
SH-Mobile AG5 (sh73a0) 용 "renesas, bsc-sh73a0"

   - # address-cells, # size-cells, ranges : 상위 주소와 하위 주소 공간 사이의 매핑을 설명해야합니다.
   - reg : 버스 컨트롤러에 액세스하기위한 기본 주소와 길이를 포함해야합니다.

선택적 속성 :
   - 인터럽트 : 가능한 경우 BSC 인터럽트에 대한 참조를 포함해야합니다.
   - 클럭 : 가능한 경우 기능 클럭에 대한 참조를 포함해야합니다.
   - power-domains : 가능한 경우 PM 도메인에 대한 참조를 포함해야합니다.

Example:

	bsc: bus@fec10000 {
		compatible = "renesas,bsc-sh73a0", "renesas,bsc",
			     "simple-pm-bus";
		#address-cells = <1>;
		#size-cells = <1>;
		ranges = <0 0 0x20000000>;
		reg = <0xfec10000 0x400>;
		interrupts = <0 39 IRQ_TYPE_LEVEL_HIGH>;
		clocks = <&zb_clk>;
		power-domains = <&pd_a4s>;
	};
```

## Doc/DeviceDriver/devicetree/bindings/bus/simple-pm-bus.txt
```
Simple Power-Managed Bus
========================

A Simple Power-Managed Bus is a transparent bus that doesn't need a real
driver, as it's typically initialized by the boot loader.

However, its bus controller is part of a PM domain, or under the control of a
functional clock.  Hence, the bus controller's PM domain and/or clock must be
enabled for child devices connected to the bus (either on-SoC or externally)
to function.

While "simple-pm-bus" follows the "simple-bus" set of properties, as specified
in ePAPR, it is not an extension of "simple-bus".


Required properties:
  - compatible: Must contain at least "simple-pm-bus".
		Must not contain "simple-bus".
		It's recommended to let this be preceded by one or more
		vendor-specific compatible values.
  - #address-cells, #size-cells, ranges: Must describe the mapping between
		parent address and child address spaces.

Optional platform-specific properties for clock or PM domain control (at least
one of them is required):
  - clocks: Must contain a reference to the functional clock(s),
  - power-domains: Must contain a reference to the PM domain.
Please refer to the binding documentation for the clock and/or PM domain
providers for more details.

단순 전원 관리 버스
============

단순 전원 관리 버스는 일반적으로 부트 로더에 의해 초기화되므로 실제 드라이버가 필요없는 transparent bus입니다.

그러나 버스 컨트롤러는 PM 도메인의 일부이거나 기능 클록의 제어를받습니다. 따라서 버스 컨트롤러 (PM 컨트롤러)의 PM 도메인 및 / 또는 클럭은 버스에 연결된 (SoC 또는 외부에서) 하위 장치가 작동하도록 활성화되어야합니다.

"simple-pm-bus"는 ePAPR에 지정된 "단simple-bus"속성 집합을 따르지만 "simple-bus"의 확장은 아닙니다.

필수 속성 :
   - 호환 : 적어도 "simple-pm-bus"를 포함해야합니다.
"simple-bus"를 포함해서는 안됩니다.
하나 이상의 공급 업체별 호환 가능 값이 선행되도록하는 것이 좋습니다.
   - # address-cells, # size-cells, ranges : 상위 주소와 하위 주소 공간 사이의 매핑을 설명해야합니다.

클럭 또는 PM 도메인 제어를위한 플랫폼 별 등록 정보 (적어도 하나는 필수) :
   - 클럭 : 기능 클럭에 대한 참조를 포함해야하며,
   - power-domains : PM 도메인에 대한 참조를 포함해야합니다.
자세한 내용은 클럭 및 / 또는 PM 도메인 공급자의 바인딩 설명서를 참조하십시오.





Example:

	bsc: bus@fec10000 {
		compatible = "renesas,bsc-sh73a0", "renesas,bsc",
			     "simple-pm-bus";
		#address-cells = <1>;
		#size-cells = <1>;
		ranges = <0 0 0x20000000>;
		reg = <0xfec10000 0x400>;
		interrupts = <0 39 IRQ_TYPE_LEVEL_HIGH>;
		clocks = <&zb_clk>;
		power-domains = <&pd_a4s>;
	};
```

## Doc/DeviceDriver/devicetree/bindings/bus/sunxi-rsb.txt
```
Allwinner Reduced Serial Bus (RSB) controller

The RSB controller found on later Allwinner SoCs is an SMBus like 2 wire
serial bus with 1 master and up to 15 slaves. It is represented by a node
for the controller itself, and child nodes representing the slave devices.

Required properties :

 - reg             : Offset and length of the register set for the controller.
 - compatible      : Shall be "allwinner,sun8i-a23-rsb".
 - interrupts      : The interrupt line associated to the RSB controller.
 - clocks          : The gate clk associated to the RSB controller.
 - resets          : The reset line associated to the RSB controller.
 - #address-cells  : shall be 1
 - #size-cells     : shall be 0

Optional properties :

 - clock-frequency : Desired RSB bus clock frequency in Hz. Maximum is 20MHz.
		     If not set this defaults to 3MHz.

Child nodes:

An RSB controller node can contain zero or more child nodes representing
slave devices on the bus.  Child 'reg' properties should contain the slave
device's hardware address. The hardware address is hardwired in the device,
which can normally be found in the datasheet.


Allwinner RSB (Reduced Serial Bus) 컨트롤러

최신 Allwinner SoC에서 발견되는 RSB 컨트롤러는 1 개의 마스터와 최대 15 개의 슬레이브가있는 2 와이어 직렬 버스와 같은 SMBus입니다. 제어기 자체의 노드와 슬레이브 장치를 나타내는 하위 노드로 표시됩니다.

필수 속성 :

  - reg : 컨트롤러에 설정된 레지스터 오프셋 및 길이.
  - 호환 : "allwinner, sun8i-a23-rsb"이어야합니다.
  - interrupts : RSB 컨트롤러와 관련된 인터럽트 라인.
  - clocks : RSB 컨트롤러에 연결된 게이트 클럭입니다.
  - reset : RSB 컨트롤러에 연결된 재설정 행.
  - # address-cells : 1이어야합니다.
  - # size-cells : 0이어야합니다.

선택적 속성 :

  - 클록 주파수 : 원하는 RSB 버스 클럭 주파수 (Hz). 최대는 20MHz입니다. 설정되지 않은 경우 기본값은 3MHz입니다.

자식 노드 :

RSB 컨트롤러 노드는 버스에 슬레이브 장치를 나타내는 0 개 이상의 자식 노드를 포함 할 수 있습니다. 하위 'reg'속성은 슬레이브 장치의 하드웨어 주소를 포함해야합니다. 하드웨어 주소는 일반적으로 데이터 시트에서 찾을 수 있는 장치에 내장되어 있습니다.

Example:

	rsb@01f03400 {
		compatible = "allwinner,sun8i-a23-rsb";
		reg = <0x01f03400 0x400>;
		interrupts = <0 39 4>;
		clocks = <&apb0_gates 3>;
		clock-frequency = <3000000>;
		resets = <&apb0_rst 3>;
		#address-cells = <1>;
		#size-cells = <0>;

		pmic@3e3 {
			compatible = "...";
			reg = <0x3e3>;

			/* ... */
		};
	};
```

## Doc/DeviceDriver/devicetree/bindings/can/Kconfig
```kconfig
#
# Controller Area Network (CAN) network layer core configuration
#컨트롤러 영역 네트워크 (CAN) 네트워크 계층 코어 구성
#

menuconfig CAN
	depends on NET
	tristate "CAN bus subsystem support"
	---help---
	  Controller Area Network (CAN) is a slow (up to 1Mbit/s) serial
#컨트롤러 영역 네트워크 (CAN)는 느린 (최대 1Mbit / s) 직렬

	  communications protocol which was developed by Bosch in
	  1991, mainly for automotive, but now widely used in marine
	  (NMEA2000), industrial, and medical applications.
	  More information on the CAN network protocol family PF_CAN
	  is contained in <Documentation/networking/can.txt>.

	  If you want CAN support you should say Y here and also to the
	  specific driver for your controller(s) below.
#CAN 지원을 원한다면 여기서 Y를 말하고
#아래 컨트롤러에 맞는 드라이버를 선택하십시오.

if CAN

config CAN_RAW
	tristate "Raw CAN Protocol (raw access with CAN-ID filtering)"
	default y
	---help---
	  The raw CAN protocol option offers access to the CAN bus via
	  the BSD socket API. You probably want to use the raw socket in
	  most cases where no higher level protocol is being used. The raw
	  socket has several filter options e.g. ID masking / error frames.
	  To receive/send raw CAN messages, use AF_CAN with protocol CAN_RAW.
#원시 CAN 프로토콜 옵션을 통해 CAN 버스에 액세스 할 수 있습니다.
#BSD 소켓 API. 당신은 아마 원시 소켓을 다음과 같이 사용하고 싶을 것이다.
#대부분의 경우 더 높은 수준의 프로토콜이 사용되지 않습니다. 원시
#소켓에는 몇 가지 필터 옵션이 있습니다. ID 마스킹 / 오류 프레임.
#원시 CAN 메시지를 받거나 보내려면 프로토콜 CAN_RAW로 AF_CAN을 사용하십시오.

config CAN_BCM
	tristate "Broadcast Manager CAN Protocol (with content filtering)"
	default y
	---help---
	  The Broadcast Manager offers content filtering, timeout monitoring,
	  sending of RTR frames, and cyclic CAN messages without permanent user
	  interaction. The BCM can be 'programmed' via the BSD socket API and
	  informs you on demand e.g. only on content updates / timeouts.
	  You probably want to use the bcm socket in most cases where cyclic
	  CAN messages are used on the bus (e.g. in automotive environments).
	  To use the Broadcast Manager, use AF_CAN with protocol CAN_BCM.
#Broadcast Manager는 컨텐츠 필터링, 시간 초과 모니터링,
#영구 사용자가없는 RTR 프레임 전송 및 주기적 CAN 메시지
#상호 작용. BCM은 BSD 소켓 API를 통해 '프로그래밍'될 수 있으며
#예를 들어 당신에게 알려줍니다. 콘텐츠 업데이트 / 시간 제한에만 적용됩니다.
#대부분의 경우 bcm 소켓을 사용하기를 원할 것입니다.
#CAN 메시지는 버스 (예 : 자동차 환경)에서 사용됩니다.
#브로드 캐스트 관리자를 사용하려면 AF_CAN을 프로토콜 CAN_BCM과 함께 사용하십시오.
#
config CAN_GW
	tristate "CAN Gateway/Router (with netlink configuration)"
	default y
	---help---
	  The CAN Gateway/Router is used to route (and modify) CAN frames.
	  It is based on the PF_CAN core infrastructure for msg filtering and
	  msg sending and can optionally modify routed CAN frames on the fly.
	  CAN frames can be routed between CAN network interfaces (one hop).
	  They can be modified with AND/OR/XOR/SET operations as configured
	  by the netlink configuration interface known e.g. from iptables.
#CAN 게이트웨이 / 라우터는 CAN 프레임을 라우팅 (및 수정)하는 데 사용됩니다.
#이것은 msg 필터링을위한 PF_CAN 핵심 인프라와
#msg를 보내고 선택적으로 라우팅 된 CAN 프레임을 즉시 수정할 수 있습니다.
#CAN 프레임은 CAN 네트워크 인터페이스간에 라우팅 될 수 있습니다 (1 홉).
#구성된대로 AND / OR / XOR / SET 조작으로 수정할 수 있습니다
#예를 들어, 알려진 넷 링크 구성 인터페이스에 의해. iptables에서.

source "drivers/net/can/Kconfig"

endif
```

## Doc/DeviceDriver/devicetree/bindings/connector/analog-tv-connector.txt
```
Analog TV Connector
===================

Required properties:
- compatible: "composite-video-connector" or "svideo-connector"

Optional properties:
- label: a symbolic name for the connector

Required nodes:
- Video port for TV input

Example
-------

tv: connector {
	compatible = "composite-video-connector";
	label = "tv";

	port {
		tv_connector_in: endpoint {
			remote-endpoint = <&venc_out>;
		};
	};
};

/*
아날로그 TV 커넥터
===========

필수 속성 :
- 호환 가능 : "복합 비디오 커넥터"또는 "svideo 커넥터"

선택적 속성 :
- label : 커넥터의 기호 이름

필수 노드 :
- TV 입력 용 비디오 포트

Example
-------

tv: connector {
	compatible = "composite-video-connector";
	label = "tv";

	port {
		tv_connector_in: endpoint {
			remote-endpoint = <&venc_out>;
		};
	};
};

*/
```

## Doc/DeviceDriver/devicetree/bindings/connector/dvi-connector.txt
```
DVI Connector
==============

Required properties:
- compatible: "dvi-connector"

Optional properties:
- label: a symbolic name for the connector
- ddc-i2c-bus: phandle to the i2c bus that is connected to DVI DDC
- analog: the connector has DVI analog pins
- digital: the connector has DVI digital pins
- dual-link: the connector has pins for DVI dual-link

Required nodes:
- Video port for DVI input

Note: One (or both) of 'analog' or 'digital' must be set.

Example
-------

dvi0: connector@0 {
	compatible = "dvi-connector";
	label = "dvi";

	digital;

	ddc-i2c-bus = <&i2c3>;

	port {
		dvi_connector_in: endpoint {
			remote-endpoint = <&tfp410_out>;
		};
	};
};

/*
DVI 커넥터
==============

필수 속성 :
- 호환 : "dvi-connector"

선택적 속성 :
- label : 커넥터의 기호 이름
- ddc-i2c-bus : DVI DDC에 연결된 i2c 버스로 연결합니다.
- 아날로그 : DVI 아날로그 핀이있는 커넥터
- 디지털 : 커넥터에 DVI 디지털 핀이 있음
- 듀얼 링크 : DVI 듀얼 링크 용 핀이 커넥터에 있습니다.

필수 노드 :
- DVI 입력 용 비디오 포트

참고 : '아날로그'또는 '디지털'중 하나 (또는 둘 다)를 설정해야합니다.

Example
-------

dvi0: connector@0 {
	compatible = "dvi-connector";
	label = "dvi";

	digital;

	ddc-i2c-bus = <&i2c3>;

	port {
		dvi_connector_in: endpoint {
			remote-endpoint = <&tfp410_out>;
		};
	};
};

*/
```

## Doc/DeviceDriver/devicetree/bindings/connector/hdmi-connector.txt
```
HDMI Connector
==============

Required properties:
- compatible: "hdmi-connector"
- type: the HDMI connector type: "a", "b", "c", "d" or "e"

Optional properties:
- label: a symbolic name for the connector
- hpd-gpios: HPD GPIO number

Required nodes:
- Video port for HDMI input

Example
-------

hdmi0: connector@1 {
	compatible = "hdmi-connector";
	label = "hdmi";

	type = "a";

	port {
		hdmi_connector_in: endpoint {
			remote-endpoint = <&tpd12s015_out>;
		};
	};
};

/*
HDMI 커넥터
==============

필수 속성 :
- 호환 : "hdmi-connector"
- 유형 : HDMI 커넥터 유형 : "a", "b", "c", "d"또는 "e"

선택적 속성 :
- label : 커넥터의 기호 이름
- hpd-gpios : HPD GPIO 번호

필수 노드 :
- HDMI 입력 용 비디오 포트


Example
-------

hdmi0: connector@1 {
	compatible = "hdmi-connector";
	label = "hdmi";

	type = "a";

	port {
		hdmi_connector_in: endpoint {
			remote-endpoint = <&tpd12s015_out>;
		};
	};
};


*/
```
