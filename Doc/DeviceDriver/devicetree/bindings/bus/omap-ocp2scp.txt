## Doc/DeviceDriver/devicetree/bindings/crypto/fsl-sec6.txt
```
SEC 6 is as Freescale's Cryptographic Accelerator and Assurance Module (CAAM).
Currently Freescale powerpc chip C29X is embedded with SEC 6.
SEC 6 device tree binding include:
   -SEC 6 Node
   -Job Ring Node
   -Full Example
SEC 6은 프리 스케일의 암호화 가속기 및 보증 모듈 (CAAM)입니다.
현재 Freescale의 powerpc 칩 C29X는 SEC 6에 내장되어있다.
SEC 6 장치 트리 바인딩에는 다음이 포함됩니다.
    -SEC 6 Node
   -Job Ring Node
   -Full Example
=====================================================================
SEC 6 Node

Description

    Node defines the base address of the SEC 6 block.
    This block specifies the address range of all global
    configuration registers for the SEC 6 block.
    For example, In C293, we could see three SEC 6 node.
노드는 SEC 6 블록의 기본 주소를 정의합니다.
     이 블록은 SEC 6 블록에 대한 모든 전역 구성 레지스터의 주소 범위를 지정합니다.
     예를 들어, C293에서는 세 개의 SEC 6 노드를 볼 수있었습니다.

PROPERTIES

   - compatible
      Usage: required
      Value type: <string>
      Definition: Must include "fsl,sec-v6.0".
- compatible
       사용법 : 필수
       값 유형 : <문자열>
       정의 : "fsl, sec-v6.0"을 포함해야합니다.

   - fsl,sec-era
      Usage: optional
      Value type: <u32>
      Definition: A standard property. Define the 'ERA' of the SEC
          device.
    - fsl, sec-era
       사용법 : 선택 사항
       값 유형 : <u32>
       정의 : 표준 속성. SEC 장치의 'ERA'을 정의하십시오.

   - #address-cells
       Usage: required
       Value type: <u32>
       Definition: A standard property.  Defines the number of cells
           for representing physical addresses in child nodes.
  - # address-cells
        사용법 : 필수
        값 유형 : <u32>
        정의 : 표준 속성. 자식 노드의 물리적 주소를 나타내는 셀의 수를 정의합니다.

   - #size-cells
       Usage: required
       Value type: <u32>
       Definition: A standard property.  Defines the number of cells
           for representing the size of physical addresses in
           child nodes.
- #size-cells
        사용법 : 필수
        값 유형 : <u32>
        정의 : 표준 속성. 자식 노드의 물리적 주소 크기를 나타내는 셀 수를 정의합니다.

   - reg
      Usage: required
      Value type: <prop-encoded-array>
      Definition: A standard property.  Specifies the physical
          address and length of the SEC 6 configuration registers.
- reg
       사용법 : 필수
       값 유형 : <prop-encoded-array>
       정의 : 표준 속성. SEC 6 구성 레지스터의 실제 주소와 길이를 지정합니다.

   - ranges
       Usage: required
       Value type: <prop-encoded-array>
       Definition: A standard property.  Specifies the physical address
           range of the SEC 6.0 register space (-SNVS not included).  A
           triplet that includes the child address, parent address, &
           length.
- ranges
        사용법 : 필수
        값 유형 : <prop-encoded-array>
        정의 : 표준 속성. SEC 6.0 레지스터 공간의 물리적 주소 범위를 지정합니다 (-SNVS는 포함되지 않음). 하위 주소, 상위 주소 및 길이를 포함하는 세 쌍.

   Note: All other standard properties (see the ePAPR) are allowed
   but are optional.
    참고 : 다른 모든 표준 속성 (ePAPR 참조)은 허용되지만 선택 사항입니다.

EXAMPLE
	crypto@a0000 {
		compatible = "fsl,sec-v6.0";
		fsl,sec-era = <6>;
		#address-cells = <1>;
		#size-cells = <1>;
		reg = <0xa0000 0x20000>;
		ranges = <0 0xa0000 0x20000>;
	};

=====================================================================
Job Ring (JR) Node

    Child of the crypto node defines data processing interface to SEC 6
    across the peripheral bus for purposes of processing
    cryptographic descriptors. The specified address
    range can be made visible to one (or more) cores.
    The interrupt defined for this node is controlled within
    the address range of this node.
 Child of the crypto node은 cryptographic descriptors 를 처리하기 위해 주변 버스를 통해 SEC 6에 대한 데이터 처리 인터페이스를 정의합니다. 지정된 주소 범위는 하나 이상의 (또는 그 이상의) 코어에서 볼 수 있습니다. 이 노드에 대해 정의 된 인터럽트는이 노드의 주소 범위 내에서 제어됩니다.

  - compatible
      Usage: required
      Value type: <string>
      Definition: Must include "fsl,sec-v6.0-job-ring".

- compatible
       사용법 : 필수
       값 유형 : <문자열>
       정의 : "fsl, sec-v6.0-job-ring"을 포함해야합니다.

  - reg
      Usage: required
      Value type: <prop-encoded-array>
      Definition: Specifies a two JR parameters:  an offset from
           the parent physical address and the length the JR registers.
  - reg
       사용법 : 필수
       값 유형 : <prop-encoded-array>
       정의 : 두 개의 JR 매개 변수를 지정합니다 : 부모의 실제 주소로부터의 오프셋과 JR이 등록하는 길이.

   - interrupts
      Usage: required
      Value type: <prop_encoded-array>
      Definition:  Specifies the interrupts generated by this
           device.  The value of the interrupts property
           consists of one interrupt specifier. The format
           of the specifier is defined by the binding document
           describing the node's interrupt parent.
  -  interrupts
       사용법 : 필수
       값 유형 : <prop_encoded-array>
       정의 :이 장치에서 생성 된 인터럽트를 지정합니다. interrupts 속성의 값은 하나의 인터럽트 지정자로 구성됩니다. 
        지정자의 형식은 노드의 인터럽트 상위를 설명하는 바인딩 문서에 의해 정의됩니다.

EXAMPLE
	jr@1000 {
		compatible = "fsl,sec-v6.0-job-ring";
		reg = <0x1000 0x1000>;
		interrupts = <49 2 0 0>;
	};

===================================================================
Full Example

Since some chips may contain more than one SEC, the dtsi contains
only the node contents, not the node itself.  A chip using the SEC
should include the dtsi inside each SEC node. 
일부 칩에는 둘 이상의 SEC가 포함될 수 있으므로 dtsi에는 노드 내용 만 포함되며
 노드 자체는 포함하지 않습니다. SEC를 사용하는 칩은 각 SEC 노드 내에 dtsi를 포함해야합니다. 

 Example:

In qoriq-sec6.0.dtsi:

	compatible = "fsl,sec-v6.0";
	fsl,sec-era = <6>;
	#address-cells = <1>;
	#size-cells = <1>;

	jr@1000 {
		compatible = "fsl,sec-v6.0-job-ring",
			     "fsl,sec-v5.2-job-ring",
			     "fsl,sec-v5.0-job-ring",
			     "fsl,sec-v4.4-job-ring",
			     "fsl,sec-v4.0-job-ring";
		reg	   = <0x1000 0x1000>;
	};

	jr@2000 {
		compatible = "fsl,sec-v6.0-job-ring",
			     "fsl,sec-v5.2-job-ring",
			     "fsl,sec-v5.0-job-ring",
			     "fsl,sec-v4.4-job-ring",
			     "fsl,sec-v4.0-job-ring";
		reg	   = <0x2000 0x1000>;
	};

In the C293 device tree, we add the include of public property:
C293 장치 트리에서 공용 속성 인 include를 추가합니다.

	crypto@a0000 {
		/include/ "qoriq-sec6.0.dtsi"
	}

	crypto@a0000 {
		reg = <0xa0000 0x20000>;
		ranges = <0 0xa0000 0x20000>;

		jr@1000 {
			interrupts = <49 2 0 0>;
		};

		jr@2000 {
			interrupts = <50 2 0 0>;
		};
	};
```

## Doc/DeviceDriver/devicetree/bindings/crypto/img-hash.txt
```
Imagination Technologies hardware hash accelerator

The hash accelerator provides hardware hashing acceleration for
SHA1, SHA224, SHA256 and MD5 hashes

Required properties:

- compatible : "img,hash-accelerator"
- reg : Offset and length of the register set for the module, and the DMA port
- interrupts : The designated IRQ line for the hashing module.
- dmas : DMA specifier as per Documentation/devicetree/bindings/dma/dma.txt
- dma-names : Should be "tx"
- clocks : Clock specifiers
- clock-names : "sys" Used to clock the hash block registers
		"hash" Used to clock data through the accelerator






Imagination Technologies hardware hash accelerator

해시 가속기는 SHA1, SHA224, SHA256 및 MD5 해시에 대한 하드웨어 해싱 가속을 제공합니다.


필수 속성 :

- compatible : "img, hash-accelerator"
- reg : 모듈에 대해 설정된 레지스터 오프셋 및 길이 및 DMA 포트
- interrupts : 해시 모듈에 지정된 IRQ 라인입니다.
- dmas : Documentation / devicetree / bindings / dma / dma.txt에 따른 DMA 지정자
- dma-names : "tx"여야합니다.
- clocks : Clock specifiers
- clock-names : "sys"해시 블록 레지스터 "해시"를 클록하는 데 사용됩니다. 액셀러레이터를 통해 데이터 클럭에 사용됩니다.


Example:

	hash: hash@18149600 {
	compatible = "img,hash-accelerator";
		reg = <0x18149600 0x100>, <0x18101100 0x4>;
		interrupts = <GIC_SHARED 59 IRQ_TYPE_LEVEL_HIGH>;
		dmas = <&dma 8 0xffffffff 0>;
		dma-names = "tx";
		clocks = <&cr_periph SYS_CLK_HASH>, <&clk_periph PERIPH_CLK_ROM>;
		clock-names = "sys", "hash";
	};
```

## Doc/DeviceDriver/devicetree/bindings/crypto/marvell-cesa.txt
```
Marvell Cryptographic Engines And Security Accelerator

Required properties:
- compatible: should be one of the following string
	      "marvell,orion-crypto"
	      "marvell,kirkwood-crypto"
	      "marvell,dove-crypto"
	      "marvell,armada-370-crypto"
	      "marvell,armada-xp-crypto"
	      "marvell,armada-375-crypto"
	      "marvell,armada-38x-crypto"
- reg: base physical address of the engine and length of memory mapped
       region. Can also contain an entry for the SRAM attached to the CESA,
       but this representation is deprecated and marvell,crypto-srams should
       be used instead
- reg-names: "regs". Can contain an "sram" entry, but this representation
	     is deprecated and marvell,crypto-srams should be used instead
- interrupts: interrupt number
- clocks: reference to the crypto engines clocks. This property is not
	  required for orion and kirkwood platforms
- clock-names: "cesaX" and "cesazX", X should be replaced by the crypto engine
	       id.
	       This property is not required for the orion and kirkwoord
	       platforms.
	       "cesazX" clocks are not required on armada-370 platforms
- marvell,crypto-srams: phandle to crypto SRAM definitions

Optional properties:
- marvell,crypto-sram-size: SRAM size reserved for crypto operations, if not
			    specified the whole SRAM is used (2KB)







Marvell Cryptographic Engines And Security Accelerator

필수 속성 :
- compatible : 다음 문자열 중 하나 여야합니다.
  		  "marvell,orion-crypto"
	      "marvell,kirkwood-crypto"
	      "marvell,dove-crypto"
	      "marvell,armada-370-crypto"
	      "marvell,armada-xp-crypto"
	      "marvell,armada-375-crypto"
	      "marvell,armada-38x-crypto"

- reg : 엔진의 기본 물리적 주소와 메모리 매핑 된 영역의 길이. CESA에 부착 된 SRAM에 대한 항목을 포함 할 수도 있지만이 표현은 더 이상 사용되지 않으며 marvell 대신 crypto-srams를 사용해야합니다.

- reg-names : "regs". "sram"항목을 포함 할 수 있지만이 표현은 더 이상 사용되지 않으며 marvell 대신 crypto-srams를 사용해야합니다.

- 인터럽트 : 인터럽트 번호
- clocks : 암호 엔진 클럭에 대한 참조입니다. 오리온 및 커크 우드 플랫폼에는이 속성이 필요하지 않습니다.
- clock-names : "cesaX"및 "cesazX", X는 암호 엔진 ID로 바꿔야합니다.
이 속성은 orion 및 kirkwoord 플랫폼에는 필요하지 않습니다.
"cesazX"클럭은 armada-370 플랫폼에서 필요하지 않습니다.

- marvell, crypto-srams : phandle에서 crypto SRAM 정의

선택적 속성 :
- marvell, crypto-sram-size : 암호화 연산을 위해 예약 된 SRAM 크기, 지정되지 않은 경우 전체 SRAM이 사용됨 (2KB)



Examples:

	crypto@90000 {
		compatible = "marvell,armada-xp-crypto";
		reg = <0x90000 0x10000>;
		reg-names = "regs";
		interrupts = <48>, <49>;
		clocks = <&gateclk 23>, <&gateclk 23>;
		clock-names = "cesa0", "cesa1";
		marvell,crypto-srams = <&crypto_sram0>, <&crypto_sram1>;
		marvell,crypto-sram-size = <0x600>;
		status = "okay";
	};
```

## Doc/DeviceDriver/devicetree/bindings/crypto/mv_cesa.txt
```
Marvell Cryptographic Engines And Security Accelerator

Required properties:
- compatible: should be one of the following string
	      "marvell,orion-crypto"
	      "marvell,kirkwood-crypto"
	      "marvell,dove-crypto"
- reg: base physical address of the engine and length of memory mapped
       region. Can also contain an entry for the SRAM attached to the CESA,
       but this representation is deprecated and marvell,crypto-srams should
       be used instead
- reg-names: "regs". Can contain an "sram" entry, but this representation
	     is deprecated and marvell,crypto-srams should be used instead
- interrupts: interrupt number
- clocks: reference to the crypto engines clocks. This property is only
	  required for Dove platforms
- marvell,crypto-srams: phandle to crypto SRAM definitions

Optional properties:
- marvell,crypto-sram-size: SRAM size reserved for crypto operations, if not
			    specified the whole SRAM is used (2KB)


필수 속성 :
- compatible : 다음 문자열 중 하나 여야합니다.
		  "marvell,orion-crypto"
	      "marvell,kirkwood-crypto"
	      "marvell,dove-crypto"

- reg : 엔진의 기본 물리적 주소와 메모리 매핑 된 영역의 길이. CESA에 부착 된 SRAM에 대한 항목을 포함 할 수도 있지만이 표현은 더 이상 사용되지 않으며 marvell 대신 crypto-srams를 사용해야합니다.

- reg-names : "regs". "sram"항목을 포함 할 수 있지만이 표현은 더 이상 사용되지 않으며 marvell 대신 crypto-srams를 사용해야합니다 
- interrupts : interrupt number
- clocks : 암호 엔진 클럭에 대한 참조입니다. 이 속성은 Dove platforms에서만 필요합니다.
- marvell, crypto-srams : phandle에서 crypto SRAM 정의

선택적 속성 :
- marvell, crypto-sram-size : 암호화 연산을 위해 예약 된 SRAM 크기, 지정되지 않은 경우 전체 SRAM이 사용됨 (2KB)


Examples:

	crypto@30000 {
		compatible = "marvell,orion-crypto";
		reg = <0x30000 0x10000>;
		reg-names = "regs";
		interrupts = <22>;
		marvell,crypto-srams = <&crypto_sram>;
		marvell,crypto-sram-size = <0x600>;
		status = "okay";
	};
```
