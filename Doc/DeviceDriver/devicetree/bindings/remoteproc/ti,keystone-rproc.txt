## Doc/DeviceDriver/devicetree/bindings/reset/sirf,rstc.txt
```
CSR SiRFSoC Reset Controller
======================================

Please also refer to reset.txt in this directory for common reset
controller binding usage.

Required properties:
- compatible: Should be "sirf,prima2-rstc" or "sirf,marco-rstc"
- reg: should be register base and length as documented in the
  datasheet
- #reset-cells: 1, see below

CSR SiRFSoC 리셋 컨트롤러
========================

common reset controller binding 사용에 대해서는이 디렉토리의 reset.txt를 참조하십시오.

필수 속성 :
- 호환 가능 : "sirf, prima2-rstc"또는 "sirf, marco-rstc"여야합니다.
- reg : 데이터 시트에 문서화 된대로 레지스터 기본 및 길이 여야합니다.
- # reset-cells : 1, 아래 참조



example:

rstc: reset-controller@88010000 {
	compatible = "sirf,prima2-rstc";
	reg = <0x88010000 0x1000>;
	#reset-cells = <1>;
};

Specifying reset lines connected to IP modules
==============================================

The reset controller(rstc) manages various reset sources. This module provides
reset signals for most blocks in system. Those device nodes should specify the
reset line on the rstc in their resets property, containing a phandle to the
rstc device node and a RESET_INDEX specifying which module to reset, as described
in reset.txt.

For SiRFSoC, RESET_INDEX is just reset_bit defined in SW_RST0 and SW_RST1 registers.
For modules whose rest_bit is in SW_RST0, its RESET_INDEX is 0~31. For modules whose
rest_bit is in SW_RST1, its RESET_INDEX is 32~63.

IP 모듈에 연결된 리셋 라인 지정하기
==================================

리셋 컨트롤러 (rstc)는 다양한 리셋 소스를 관리합니다. 이 모듈은 시스템의 대부분 블록에 리셋 신호를 제공합니다. 이러한 장치 노드는 reset.txt에 설명 된대로 rstc 장치 노드에 대한 phandle과 재설정 할 모듈을 지정하는 RESET_INDEX를 포함하는 resets 속성의 rstc에 재설정 줄을 지정해야합니다.

SiRFSoC의 경우 RESET_INDEX는 SW_RST0 및 SW_RST1 레지스터에 정의 된 reset_bit 일뿐입니다.
rest_bit이 SW_RST0 인 모듈의 경우 RESET_INDEX는 0 ~ 31입니다. rest_bit이 SW_RST1 인 모듈의 RESET_INDEX는 32 ~ 63입니다.



example:

vpp@90020000 {
	compatible = "sirf,prima2-vpp";
	reg = <0x90020000 0x10000>;
	interrupts = <31>;
	clocks = <&clks 35>;
	resets = <&rstc 6>;
};
```

## Doc/DeviceDriver/devicetree/bindings/reset/socfpga-reset.txt
```
Altera SOCFPGA Reset Manager

Required properties:
- compatible : "altr,rst-mgr"
- reg : Should contain 1 register ranges(address and length)
- altr,modrst-offset : Should contain the offset of the first modrst register.
- #reset-cells: 1

필수 속성 :
- 호환 가능 : "altr, rst-mgr"
- reg : 1 개의 레지스터 범위 (주소와 길이)를 포함해야 함.
- altr, modrst-offset : 첫 번째 modrst 레지스터의 오프셋을 포함해야합니다.
- # reset-cells : 1



Example:
	 rstmgr@ffd05000 {
		#reset-cells = <1>;
		compatible = "altr,rst-mgr";
		reg = <0xffd05000 0x1000>;
		altr,modrst-offset = <0x10>;
	};
```

## Doc/DeviceDriver/devicetree/bindings/reset/st,sti-picophyreset.txt
```
STMicroelectronics STi family Sysconfig Picophy SoftReset Controller
=============================================================================

This binding describes a reset controller device that is used to enable and
disable on-chip PicoPHY USB2 phy(s) using "softreset" control bits found in
the STi family SoC system configuration registers.

The actual action taken when softreset is asserted is hardware dependent.
However, when asserted it may not be possible to access the hardware's
registers and after an assert/deassert sequence the hardware's previous state
may no longer be valid.

Please refer to Documentation/devicetree/bindings/reset/reset.txt
for common reset controller binding usage.

Required properties:
- compatible: Should be "st,stih407-picophyreset"
- #reset-cells: 1, see below

STMicroelectronics STi 제품군 Sysconfig Picophy SoftReset 컨트롤러
========================================================================================================================== ===============

이 바인딩은 STi 제품군 SoC 시스템 구성 레지스터에있는 "softreset"제어 비트를 사용하여 온칩 PicoPHY USB2 phy (s)를 활성화 및 비활성화하는 데 사용되는 리셋 컨트롤러 장치를 설명합니다.

소프트 리셋이 asserted 될 때 수행되는 실제 작업은 하드웨어에 따라 다릅니다. 그러나 asserted되면 하드웨어 레지스터에 액세스 할 수 없으며 asserted / 비활성화 시퀀스 후에 하드웨어의 이전 상태가 더 이상 유효하지 않을 수 있습니다.

일반적인 재설정 컨트롤러 바인딩 사용법은 Documentation / devicetree / bindings / reset / reset.txt를 참조하십시오.

필수 속성 :
- 호환 : "st, stih407-picophyreset"이어야합니다.
- # reset-cells : 1, 아래 참조


Example:

	picophyreset: picophyreset-controller {
		compatible = "st,stih407-picophyreset";
		#reset-cells = <1>;
	};

Specifying picophyreset control of devices
=======================================

Device nodes should specify the reset channel required in their "resets"
property, containing a phandle to the picophyreset device node and an
index specifying which channel to use, as described in
Documentation/devicetree/bindings/reset/reset.txt.

장치 노드는 Documentation / devicetree / bindings / reset / reset.txt에 설명 된대로 picophyreset 장치 노드에 대한 phandle과 사용할 채널을 지정하는 색인을 포함하는 "reset"속성에 필요한 재설정 된 채널을 지정해야합니다.


Example:

	usb2_picophy0: usbpicophy@0 {
		resets = <&picophyreset STIH407_PICOPHY0_RESET>;
	};

Macro definitions for the supported reset channels can be found in:
include/dt-bindings/reset/stih407-resets.h
지원되는 재설정 채널에 대한 매크로 정의는 다음에서 찾을 수 있습니다.
/ dt-bindings / reset / stih407-resets.h를 포함하십시오.
```

## Doc/DeviceDriver/devicetree/bindings/reset/st,sti-powerdown.txt
```
STMicroelectronics STi family Sysconfig Peripheral Powerdown Reset Controller
=============================================================================

This binding describes a reset controller device that is used to enable and
disable on-chip peripheral controllers such as USB and SATA, using
"powerdown" control bits found in the STi family SoC system configuration
registers. These have been grouped together into a single reset controller
device for convenience.

The actual action taken when powerdown is asserted is hardware dependent.
However, when asserted it may not be possible to access the hardware's
registers and after an assert/deassert sequence the hardware's previous state
may no longer be valid.

Please refer to reset.txt in this directory for common reset
controller binding usage.

Required properties:
- compatible: Should be "st,<chip>-powerdown"
	ex: "st,stih415-powerdown", "st,stih416-powerdown"
- #reset-cells: 1, see below

STMicroelectronics STi 제품군 Sysconfig 주변기기 파워 다운 리셋 컨트롤러
========================================================================================================================== ===============

이 바인딩은 STi 제품군 SoC 시스템 구성 레지스터에있는 "powerdown"제어 비트를 사용하여 USB 및 SATA와 같은 온칩 주변 장치 컨트롤러를 활성화 및 비활성화하는 데 사용되는 리셋 컨트롤러 장치를 설명합니다. 이들은 편의를 위해 단일 리셋 컨트롤러 장치로 함께 그룹화되었습니다.

파워 다운이 선언 될 때 취해지는 실제 동작은 하드웨어에 따라 다릅니다.
그러나 asserted 되면 하드웨어 레지스터에 액세스 할 수 없으며 assert / 비활성화 시퀀스 후에 하드웨어의 이전 상태가 더 이상 유효하지 않을 수 있습니다.

일반적인 재설정 제어기 바인딩 사용에 대해서는이 디렉토리의 reset.txt를 참조하십시오.


example:

	powerdown: powerdown-controller {
		#reset-cells = <1>;
		compatible = "st,stih415-powerdown";
	};


Specifying powerdown control of devices
=======================================

Device nodes should specify the reset channel required in their "resets"
property, containing a phandle to the powerdown device node and an
index specifying which channel to use, as described in reset.txt

장치 노드는 reset.txt에 설명 된대로 전원 차단 장치 노드에 대한 파들을 포함하는 
"reset"속성에 필요한 재설정 된 채널과 사용할 채널을 지정하는 색인을 지정해야합니다

example:

	usb1: usb@fe200000 {
		resets	= <&powerdown STIH41X_USB1_POWERDOWN>;
	};

Macro definitions for the supported reset channels can be found in:
지원되는 재설정 채널에 대한 매크로 정의는 다음에서 찾을 수 있습니다.

include/dt-bindings/reset/stih415-resets.h
include/dt-bindings/reset/stih416-resets.h
```

## Doc/DeviceDriver/devicetree/bindings/reset/st,sti-softreset.txt
```
STMicroelectronics STi family Sysconfig Peripheral SoftReset Controller
=============================================================================

This binding describes a reset controller device that is used to enable and
disable on-chip peripheral controllers such as USB and SATA, using
"softreset" control bits found in the STi family SoC system configuration
registers.

The actual action taken when softreset is asserted is hardware dependent.
However, when asserted it may not be possible to access the hardware's
registers and after an assert/deassert sequence the hardware's previous state
may no longer be valid.

Please refer to reset.txt in this directory for common reset
controller binding usage.

Required properties:
- compatible: Should be "st,<chip>-softreset" example:
	"st,stih415-softreset" or "st,stih416-softreset";
- #reset-cells: 1, see below

STMicroelectronics STi 제품군 Sysconfig 주변 장치 SoftReset 컨트롤러
========================================================================================================================== ===============

이 바인딩은 STi 제품군 SoC 시스템 구성 레지스터에있는 "softreset"제어 비트를 사용하여 USB 및 SATA와 같은 온칩 주변 장치 컨트롤러를 활성화 및 비활성화하는 데 사용되는 리셋 컨트롤러 장치를 설명합니다.

소프트 리셋이 asserted 될 때 수행되는 실제 작업은 하드웨어에 따라 다릅니다.
그러나 asserted 되면 하드웨어 레지스터에 액세스 할 수 없으며 assert / 비활성화 시퀀스 후에 하드웨어의 이전 상태가 더 이상 유효하지 않을 수 있습니다.

일반적인 재설정 제어기 바인딩 사용에 대해서는이 디렉토리의 reset.txt를 참조하십시오.

필수 속성 :
- 호환 : "st, <chip> -softreset"이어야 함 예 :
"st, stih415-softreset"또는 "st, stih416-softreset";
- # reset-cells : 1, 아래 참조



example:

	softreset: softreset-controller {
		#reset-cells = <1>;
		compatible = "st,stih415-softreset";
	};


Specifying softreset control of devices
=======================================

Device nodes should specify the reset channel required in their "resets"
property, containing a phandle to the softreset device node and an
index specifying which channel to use, as described in reset.txt
장치 노드는 reset.txt에 설명 된대로 softreset 장치 노드에 대한 phandle과 사용할 채널을 지정하는 색인을 포함하는 "reset"속성에 필요한 재설정 된 채널을 지정해야합니다

example:

	ethernet0{
		resets			= <&softreset STIH415_ETH0_SOFTRESET>;
	};

Macro definitions for the supported reset channels can be found in:
지원되는 재설정 채널에 대한 매크로 정의는 다음에서 찾을 수 있습니다.

include/dt-bindings/reset/stih415-resets.h
include/dt-bindings/reset/stih416-resets.h
```

## Doc/DeviceDriver/devicetree/bindings/reset/syscon-reset.txt
```
SysCon Reset Controller
=======================

Almost all SoCs have hardware modules that require reset control in addition
to clock and power control for their functionality. The reset control is
typically provided by means of memory-mapped I/O registers. These registers are
sometimes a part of a larger register space region implementing various
functionalities. This register range is best represented as a syscon node to
allow multiple entities to access their relevant registers in the common
register space.

A SysCon Reset Controller node defines a device that uses a syscon node
and provides reset management functionality for various hardware modules
present on the SoC.

SysCon 재설정 컨트롤러
===========

거의 모든 SoC에는 기능에 클록 및 전력 제어 외에도 리셋 제어가 필요한 하드웨어 모듈이있다. 리셋 제어는 일반적으로 메모리 매핑 I / O 레지스터를 통해 제공됩니다. 이러한 레지스터는 때로는 다양한 기능을 구현하는 더 큰 레지스터 공간 영역의 일부입니다. 이 레지스터 범위는 여러 엔티티가 공통 레지스터 공간에서 관련 레지스터에 액세스 할 수있게 해주는 syscon 노드로 가장 잘 표현됩니다.

SysCon 재설정 제어기 노드는 syscon 노드를 사용하고 SoC에있는 다양한 하드웨어 모듈에 대한 재설정 관리 기능을 제공하는 장치를 정의합니다.

SysCon Reset Controller Node
============================
Each of the reset provider/controller nodes should be a child of a syscon
node and have the following properties.
리셋 공급자 / 컨트롤러 노드는 각각 syscon 노드의 하위 노드 여야하며 다음과 같은 속성을 가져야합니다.

Required properties:
--------------------
 - compatible		: Should be "syscon-reset"
 - #reset-cells		: Should be 1. Please see the reset consumer node below
			  for usage details
 - #address-cells	: Should be 1
 - #size-cells		: Should be 0

SysCon Reset Child Node
============================
Each reset provider/controller node should have a child node for each reset
it would like to expose to consumers.
각 재설정 공급자 / 컨트롤러 노드에는 소비자에게 표시 할 재설정마다 자식 노드가 있어야합니다.

Required properties:
--------------------
 - reg			: Reset's logical number, this value will be used by
			  consumers of this reset as their reset specifier value
			  리셋의 논리 번호는 리셋의 소비자가 값을 리셋 지정자 값으로 사용합니다

 - reset-control	: Contains the reset control register information,
			  Should contain 3 cells defined as:
			    Cell #1 : register offset of the reset
			              control/status register from the syscon
			              register base
			    Cell #2 : bit shift value for the reset in the
			              respective reset control/status register
			    Cell #3 : polarity of the reset bit, should use the
				      definitions defined in the DT include file
					include/dt-bindings/reset/syscon.h
				      Should be RESET_ASSERT_SET for resets
				      that are asserted when the bit is set,
				      and RESET_ASSERT_CLEAR for resets that
				      are asserted when the bit is cleared.

- 리셋 제어 : 리셋 제어 레지스터 정보를 포함하고, 3 개의 셀을 다음과 같이 정의해야합니다.

셀#1 : syscon 레지스터베이스에서 리셋 제어 / 상태 레지스터의 레지스터 오프셋

셀 # 2 : 각 리셋 제어 / 상태 레지스터의 리셋 비트 시프트 값

셀 # 3 :: polarity of the reset bit, DT include 파일에 정의 된 정의를 사용해야합니다. include / dt-bindings / reset / syscon.h 비트가 설정되면 리셋을위한 RESET_ASSERT_SET이어야하고, 리셋 비트는 리셋되어야합니다 .



Optional properties:
--------------------
 - reset-status		: Contains the reset status register information. The
			  contents of this property are the equivalent to
			  reset-control as defined above. If this property is
			  not present and the toggle flag is not set, the
			  reset register is assumed to be the same as the
			  control register
 - toggle		: Mark this reset as a toggle only reset, this is used
			  when no status register is available.

선택적 속성 :
--------------------
  - reset-status : 재설정 상태 레지스터 정보를 포함합니다. 이 속성의 내용은 위에 정의 된 reset-control과 동일합니다. 이 속성이없고 토글 플래그가 설정되지 않은 경우 재설정 레지스터는 제어 레지스터와 동일한 것으로 간주됩니다
  - 토글 (Toggle) :이 리셋을 토글 리셋만으로 표시합니다. 이것은 상태 레지스터가 사용 가능하지 않을 때 사용됩니다.



SysCon Reset Consumer Nodes
===========================
Each of the reset consumer nodes should have the following properties,
in addition to their own properties.

Required properties:
--------------------
 - resets	: A phandle and a reset specifier, the reset specifier should
		  be a numerical address matching the desired reset as set
		  by the reg property defined above.

Please also refer to Documentation/devicetree/bindings/reset/reset.txt for
common reset controller usage by consumers.


SysCon 재설정 소비자 노드
===============
재설정 된 각 소비자 노드는 자신의 속성 외에도 다음과 같은 속성을 가져야합니다.

필수 속성 :
--------------------
  - 리셋 : phandle 과 리셋 지정자 인 경우 리셋 지정자는 위에 정의 된 reg 속성에 설정된대로 원하는 리셋과 일치하는 숫자 주소 여야합니다.

또한 소비자가 공통적으로 리셋 컨트롤러를 사용하는 방법에 대해서는 Documentation / devicetree / bindings / reset / reset.txt를 참조하십시오.




Example:
--------
The following example demonstrates a syscon node, the reset controller node
using the syscon node, and a consumer (a DSP device) on the TI Keystone 2
Edison SoC.
다음 예에서는 syscon 노드, syscon 노드를 사용하는 리셋 컨트롤러 노드 및 TI Keystone 2 Edison SoC의 소비자 (DSP 장치)를 보여줍니다.

/ {
	soc {
		psc: power-sleep-controller@02350000 {
			compatible = "syscon", "simple-mfd";
			reg = <0x02350000 0x1000>;

			pscrst: psc-reset {
				compatible = "syscon-reset";
				#reset-cells = <1>;
				#address-cells = <1>;
				#size-cells = <0>;

				dsp@0 {
					reg = <0>;
					reset-control = <0xa3c 8 RESET_ASSERT_CLEAR>;
					reset-status = <0x83c 8 RESET_ASSERT_CLEAR>;
				};
			};
		};

		dsp0: dsp0 {
			...
			resets = <&pscrst 0>;
			...
		};
	};
};
```
