## Doc/DeviceDriver/devicetree/bindings/reset/ti,sci-reset.txt
```
Texas Instruments System Control Interface (TI-SCI) Reset Controller
=====================================================================

Some TI SoCs contain a system controller (like the Power Management Micro
Controller (PMMC) on Keystone K2G SoC) that are responsible for controlling
the state of the various hardware modules present on the SoC. Communication
between the host processor running an OS and the system controller happens
through a protocol called TI System Control Interface (TI-SCI protocol).
For TI SCI details, please refer to the document,
Documentation/devicetree/bindings/arm/keystone/ti,sci.txt

Texas Instruments 시스템 제어 인터페이스 (TI-SCI) 리셋 컨트롤러
=======================================================================

일부 TI SoC에는 SoC에있는 다양한 하드웨어 모듈의 상태를 제어하는 시스템 컨트롤러 (Keystone K2G SoC의 PMMC (Power Management Micro Controller))가 포함되어 있습니다. 운영 체제를 실행하는 호스트 프로세서와 시스템 컨트롤러 간의 통신은 TI 시스템 제어 인터페이스 (TI-SCI 프로토콜)라는 프로토콜을 통해 이루어집니다. TI SCI에 대한 자세한 내용은 Documentation / devicetree / bindings / arm / keystone / ti, sci.txt 문서를 참조하십시오.




TI-SCI Reset Controller Node
============================
This reset controller node uses the TI SCI protocol to perform the reset
management of various hardware modules present on the SoC.

TI-SCI 리셋 컨트롤러 노드
================
이 리셋 컨트롤러 노드는 TI SCI 프로토콜을 사용하여 SoC에있는 다양한 하드웨어 모듈의 리셋 관리를 수행합니다.


Required properties:
--------------------
 - compatible	: Should be "ti,sci-reset"
 - ti,sci	: phandle to the TI SCI device to use for managing resets
 - #reset-cells	: Should be 2. Please see the reset consumer node below for
		  usage details.

필수 속성 :
--------------------
  - 호환 : "ti, sci-reset"이어야합니다.
  - ti, sci : 리셋 관리에 TI SCI 디바이스를 사용하십시오.
  - # reset-cells : 2 여야합니다. 자세한 내용은 아래의 리셋 소비자 노드를 참조하십시오.



TI-SCI Reset Consumer Nodes
TI-SCI 리셋 소비자 노드
===========================
Each of the reset consumer nodes should have the following properties,
in addition to their own properties.

재설정 된 각 소비자 노드는 자신의 속성 외에도 다음과 같은 속성을 가져야합니다.

Required properties:
--------------------
 - resets	: A phandle and reset specifier pair, one pair for each reset
		  signal that affects the device, or that the device manages.
		  The phandle should point to the TI-SCI reset controller node,
		  and the reset specifier should have 2 cell-values. The first
		  cell should contain the device ID, the values of which are
		  specified in the <dt-bindings/genpd/<soc>.h> include file.
		  The second cell should contain the reset mask value used by
		  system controller, the values of which are specified in the
		  include file <dt-bindings/reset/<soc>.h>, where <soc> is the
		  name of the SoC involved, for example 'k2g'.

필수 속성 :
--------------------
  - 재설정 : 장치에 영향을주는 각 재설정 신호에 대한 한 쌍 또는 장치가 관리하는 phandle 및 재설정 지정자 쌍.
  phandle은 TI-SCI 리셋 컨트롤러 노드를 가리켜 야하고 리셋 지정자는 2 개의 셀 값을 가져야한다. 첫 번째 셀에는 값이 <dt-bindings / genpd / <soc> .h> 포함 파일에 지정된 장치 ID가 있어야합니다.

  두 번째 셀은 포함 된 파일 <dt-bindings / reset / <soc> .h>에 지정된 값으로 시스템 컨트롤러에서 사용되는 재설정 마스크 값을 포함해야합니다. 여기서 <soc>는 관련된 SoC의 이름입니다.
 예 : 'k2g'.


Please also refer to Documentation/devicetree/bindings/reset/reset.txt for
common reset controller usage by consumers.
또한 소비자가 공통적으로 리셋 컨트롤러를 사용하는 방법에 대해서는 Documentation / devicetree / bindings / reset / reset.txt를 참조하십시오.

Example:
--------
The following example demonstrates both a TI-SCI reset controller node and a
consumer (a DSP device) on the K2G SoC.
다음 예는 TI-SCI 리셋 컨트롤러 노드와 K2G SoC의 소비자 (DSP 장치)를 보여줍니다.

#include <dt-bindings/genpd/k2g.h>
#include <dt-bindings/reset/k2g.h>

/ {
	soc {
		k2g_reset: k2g_reset {
			compatible = "ti,sci-reset";
			ti,sci = <&pmmc>;
			#reset-cells = <2>;
		};

		dsp0: dsp0 {
			...
			resets = <&k2g_reset K2G_DEV_CGEM0 K2G_DEV_CGEM0_DSP0_RESET>;
			...
		};
	};
};
```

## Doc/DeviceDriver/devicetree/bindings/resource-names.txt
```
Some properties contain an ordered list of 1 or more datum which are
normally accessed by index.  However, some devices will have multiple
values which are more naturally accessed by name.  Device nodes can
include a supplemental property for assigning names to each of the list
items.  The names property consists of a list of strings in the same
order as the data in the resource property.
일부 속성에는 일반적으로 인덱스에 의해 액세스되는 1 개 이상의 데이텀의 정렬 된 목록이 포함됩니다.
그러나 일부 장치는 더 자연스럽게 name으로 액세스되는 여러 값을 갖습니다. 장치 노드는 각 목록 항목에
 name을 할당하기위한 보충 속성을 포함 할 수 있습니다. names 속성은 리소스 속성의 데이터와 같은 순서로 문자열 목록으로 구성됩니다.

The following supplemental names properties are defined.
다음 보조 이름 속성이 정의되어 있습니다.

Resource Property	Supplemental Names Property
-----------------	---------------------------
reg			reg-names
clocks			clock-names
interrupts		interrupt-names

Usage:

The -names property must be used in conjunction with the normal resource
property. If not it will be ignored.

-names 특성은 일반적으로 자원 등록 정보와 함께 사용할 필요가 있습니다.
그렇지 않으면 무시됩니다.

Examples:

l4-abe {
	compatible = "simple-bus";
	#address-cells = <2>;
	#size-cells = <1>;
	ranges = <0 0 0x48000000 0x00001000>, /* MPU path */
		 <1 0 0x49000000 0x00001000>; /* L3 path */
	mcasp {
		compatible = "ti,mcasp";
		reg = <0 0x10 0x10>, <0 0x20 0x10>,
		      <1 0x10 0x10>, <1 0x20 0x10>;
		reg-names = "mpu", "dat",
			    "dma", "dma_dat";
		interrupts = <11>, <12>;
		interrupt-names = "rx", "tx";
	};

	timer {
		compatible = "ti,timer";
		reg = <0 0x40 0x10>, <1 0x40 0x10>;
		reg-names = "mpu", "dma";
	};
};


usb {
	compatible = "ti,usb-host";
	reg = <0x4a064000 0x800>, <0x4a064800 0x200>,
	      <0x4a064c00 0x200>;
	reg-names = "config", "ohci", "ehci";
	interrupts = <14>, <15>;
	interrupt-names = "ohci", "ehci";
};
```

## Doc/DeviceDriver/devicetree/bindings/security/tmp/st33zp24-i2c.txt
```
* STMicroelectronics SAS. ST33ZP24 TPM SoC

Required properties:
- compatible: Should be "st,st33zp24-i2c".
- clock-frequency: I²C work frequency.
- reg: address on the bus

필수 속성 :
- 호환 : "st, st33zp24-i2c"이어야합니다.
- 클럭 주파수 : I²C 작업 주파수.
- reg : 버스의 주소


Optional ST33ZP24 Properties:
- interrupt-parent: phandle for the interrupt gpio controller
- interrupts: GPIO interrupt to which the chip is connected
- lpcpd-gpios: Output GPIO pin used for ST33ZP24 power management D1/D2 state.
If set, power must be present when the platform is going into sleep/hibernate mode.
옵션 ST33ZP24 등록 정보 :
- interrupt-parent : 인터럽트 GPIO 컨트롤러의 phandle
- 인터럽트 : 칩이 연결된 GPIO 인터럽트
- lpcpd-gpios : ST33ZP24 전원 관리 D1 / D2 상태에 사용되는 출력 GPIO 핀. 설정된 경우 플랫폼이 절전 / 최대 절전 모드로 전환 될 때 전원이 있어야합니다.

Optional SoC Specific Properties:
- pinctrl-names: Contains only one value - "default".
- pintctrl-0: Specifies the pin control groups used for this controller.
선택적 SoC 특정 등록 정보 :
- pinctrl-names : 하나의 값만 포함합니다 - "default".
- pintctrl-0 :이 컨트롤러에 사용되는 핀 컨트롤 그룹을 지정합니다.

Example (for ARM-based BeagleBoard xM with ST33ZP24 on I2C2):
예제 (I2C2에 ST33ZP24가있는 ARM 기반 BeagleBoard xM의 경우) :

&i2c2 {

        status = "okay";

        st33zp24: st33zp24@13 {

                compatible = "st,st33zp24-i2c";

                reg = <0x13>;
                clock-frequency = <400000>;

                interrupt-parent = <&gpio5>;
                interrupts = <7 IRQ_TYPE_LEVEL_HIGH>;

                lpcpd-gpios = <&gpio5 15 GPIO_ACTIVE_HIGH>;
        };
};
```

## Doc/DeviceDriver/devicetree/bindings/security/tmp/st33zp24-spi.txt
```
* STMicroelectronics SAS. ST33ZP24 TPM SoC

Required properties:
- compatible: Should be "st,st33zp24-spi".
- spi-max-frequency: Maximum SPI frequency (<= 10000000).
필수 속성 :
- 호환 : "st, st33zp24-spi"여야합니다.
- spi-max-frequency : 최대 SPI 주파수 (<= 10000000).

Optional ST33ZP24 Properties:
- interrupt-parent: phandle for the interrupt gpio controller
- interrupts: GPIO interrupt to which the chip is connected
- lpcpd-gpios: Output GPIO pin used for ST33ZP24 power management D1/D2 state.
If set, power must be present when the platform is going into sleep/hibernate mode.
옵션 ST33ZP24 등록 정보 :
- interrupt-parent : 인터럽트 GPIO 컨트롤러의 phandle
- 인터럽트 : 칩이 연결된 GPIO 인터럽트
- lpcpd-gpios : ST33ZP24 전원 관리 D1 / D2 상태에 사용되는 출력 GPIO 핀. 설정된 경우 플랫폼이 절전 / 최대 절전 모드로 전환 될 때 전원이 있어야합니다.

Optional SoC Specific Properties:
- pinctrl-names: Contains only one value - "default".
- pintctrl-0: Specifies the pin control groups used for this controller.
선택적 SoC 특정 등록 정보 :
- pinctrl-names : 하나의 값만 포함합니다 - "default".
- pintctrl-0 :이 컨트롤러에 사용되는 핀 컨트롤 그룹을 지정합니다.

Example (for ARM-based BeagleBoard xM with ST33ZP24 on SPI4):
예제 (SPI4에 ST33ZP24가있는 ARM 기반 BeagleBoard xM의 경우) :

&mcspi4 {

        status = "okay";

        st33zp24@0 {

                compatible = "st,st33zp24-spi";

                spi-max-frequency = <10000000>;

                interrupt-parent = <&gpio5>;
                interrupts = <7 IRQ_TYPE_LEVEL_HIGH>;

                lpcpd-gpios = <&gpio5 15 GPIO_ACTIVE_HIGH>;
        };
};
```

## Doc/DeviceDriver/devicetree/bindings/submitting-patches.txt
```
  Submitting devicetree (DT) binding patches
  devicetree (DT) 바인딩 패치 제출

I. For patch submitters
I. 패치 제출자의 경우

  0) Normal patch submission rules from Documentation/SubmittingPatches
     applies.
  0) Documentation / SubmittingPatches의 일반적인 패치 제출 규칙이 적용됩니다.

  1) The Documentation/ portion of the patch should be a separate patch.
   1) 패치의 문서 / 부분은 별도의 패치 여야합니다.

  2) Submit the entire series to the devicetree mailinglist at
    2) 전체 시리즈를 devicetree 메일 링리스트에 제출하십시오

       devicetree@vger.kernel.org
        devicetree@vger.kernel.org

     and Cc: the DT maintainers. Use scripts/get_maintainer.pl to identify
     all of the DT maintainers.
    Cc : DT 관리자. scripts / get_maintainer.pl을 사용하여 모든 DT 관리자를 식별하십시오.

  3) The Documentation/ portion of the patch should come in the series before
     the code implementing the binding.
  3) 패치의 문서 / 부분은 바인딩을 구현하는 코드 앞에있는 시리즈에 나와야합니다.

  4) Any compatible strings used in a chip or board DTS file must be
     previously documented in the corresponding DT binding text file
     in Documentation/devicetree/bindings.  This rule applies even if
     the Linux device driver does not yet match on the compatible
     string.  [ checkpatch will emit warnings if this step is not
     followed as of commit bff5da4335256513497cc8c79f9a9d1665e09864
     ("checkpatch: add DT compatible string documentation checks"). ]
  4) 칩 또는 보드 DTS 파일에 사용되는 호환 문자열은 Documentation / devicetree / bindings 해당 DT binding text file 이전에 문서화되어 있어야합니다. 이 규칙은 Linux 장치 드라이버가 호환 가능한 문자열과 아직 일치하지 않는 경우에도 적용됩니다. [checkpatch는이 단계를 커밋 bff5da4335256513497cc8c79f9a9d1665e09864로 따르지 않으면 경고를 내 보냅니다.
      ( "checkpatch : DT 호환 문자열 문서 검사 추가"). ]
  
  5) The wildcard "<chip>" may be used in compatible strings, as in
     the following example:
  5) 와일드 카드 "<chip>"은 호환 가능한 문자열에서 다음 예제와 같이 사용될 수 있습니다.

         - compatible: Must contain '"nvidia,<chip>-pcie",
           "nvidia,tegra20-pcie"' where <chip> is tegra30, tegra132, ...
         - 호환 : nvidia, <chip> -pcie ","nvidia, tegra20-pcie " '를 포함해야합니다. <chip>은 tegra30, tegra132입니다.
     
     As in the above example, the known values of "<chip>" should be
     documented if it is used.
      위의 예에서와 같이 "<chip>"의 알려진 값을 사용하면 문서화해야합니다.

  6) If a documented compatible string is not yet matched by the
     driver, the documentation should also include a compatible
     string that is matched by the driver (as in the "nvidia,tegra20-pcie"
     example above).
  6) 문서화 된 호환 문자열이 아직 드라이버와 일치하지 않으면 문서에 드라이버와 일치하는 호환 가능한 문자열이 포함되어야합니다 (위의 "nvidia, tegra20-pcie"예제에서와 같이).

II. For kernel maintainers
II. 커널 유지 관리자의 경우

  1) If you aren't comfortable reviewing a given binding, reply to it and ask
     the devicetree maintainers for guidance.  This will help them prioritize
     which ones to review and which ones are ok to let go.
  1) 지정된 구속력을 검토하는 것이 불편한 경우, 구속력있는 관리자에게 구속을 요청하십시오.
 이렇게하면 검토 할 항목과 검토 할 항목을 우선적으로 지정할 수 있습니다.
  2) For driver (not subsystem) bindings: If you are comfortable with the
     binding, and it hasn't received an Acked-by from the devicetree
     maintainers after a few weeks, go ahead and take it.
 2) 드라이버 (하위 시스템이 아님) 바인딩 : 바인딩에 익숙하고 몇 주 후에 devicetree 관리자로부터 Acked-by를받지 못한 경우 계속 진행하십시오.

     Subsystem bindings (anything affecting more than a single device)
     then getting a devicetree maintainer to review it is required.
    서브 시스템 바인딩 (하나 이상의 장치에 영향을 미치는 모든 것)은 devicetree maintainer 를 검토하는 것이 필요합니다.

  3) For a series going though multiple trees, the binding patch should be
     kept with the driver using the binding.
  3) 여러 트리를 통과하는 시리즈인 경우 바인딩 패치는 바인딩을 사용하여 드라이버와 함께 유지해야합니다.

III. Notes
III. 노트

  0) Please see ...bindings/ABI.txt for details regarding devicetree ABI.
   0) devicetree ABI에 대한 자세한 내용은 bindings / ABI.txt를 참조하십시오.

  1) This document is intended as a general familiarization with the process as
     decided at the 2013 Kernel Summit.  When in doubt, the current word of the
     devicetree maintainers overrules this document.  In that situation, a patch
     updating this document would be appreciated.
      1)이 문서는 2013 년 커널 서밋에서 결정된 프로세스에 대한 일반적인 이해를위한 것입니다. 의심스러운 경우, devicetree 관리자의 현재 단어가 이 문서를 무효화합니다. 이 상황에서,이 문서를 업데이트하는 패치가 인정 될 것입니다.
```

## Doc/DeviceDriver/devicetree/bindings/unittest.txt
```
1) OF unittest platform device

** unittest

Required properties:
- compatible: must be "unittest"

All other properties are optional.

Example:
	unittest {
		compatible = "unittest";
		status = "okay";
	};

2) OF unittest i2c adapter platform device

** platform device unittest adapter

Required properties:
- compatible: must be unittest-i2c-bus

Children nodes contain unittest i2c devices.

Example:
	unittest-i2c-bus {
		compatible = "unittest-i2c-bus";
		status = "okay";
	};

3) OF unittest i2c device

** I2C unittest device

Required properties:
- compatible: must be unittest-i2c-dev

All other properties are optional

Example:
	unittest-i2c-dev {
		compatible = "unittest-i2c-dev";
		status = "okay";
	};

4) OF unittest i2c mux device
4) OF unittest i2c 멀티플렉서 장치
** I2C unittest mux

Required properties:
- compatible: must be unittest-i2c-mux
- compatible : unittest-i2c-mux 여야합니다.

Children nodes contain unittest i2c bus nodes per channel.
자식 노드는 채널 당 unittest i2c 버스 노드를 포함합니다.

Example:
	unittest-i2c-mux {
		compatible = "unittest-i2c-mux";
		status = "okay";
		#address-cells = <1>;
		#size-cells = <0>;
		channel-0 {
			reg = <0>;
			#address-cells = <1>;
			#size-cells = <0>;
			i2c-dev {
				reg = <8>;
				compatible = "unittest-i2c-dev";
				status = "okay";
			};
		};
	};
```

## Doc/DeviceDriver/devicetree/bindings/usb/allwinner,sun4i-a10-musb.txt
```
Allwinner sun4i A10 musb DRC/OTG controller
-------------------------------------------

Required properties:
 - compatible      : "allwinner,sun4i-a10-musb", "allwinner,sun6i-a31-musb"
                     or "allwinner,sun8i-a33-musb"
 - reg             : mmio address range of the musb controller
 - clocks          : clock specifier for the musb controller ahb gate clock
 - reset           : reset specifier for the ahb reset (A31 and newer only)
 - interrupts      : interrupt to which the musb controller is connected
 - interrupt-names : must be "mc"
 - phys            : phy specifier for the otg phy
 - phy-names       : must be "usb"
 - dr_mode         : Dual-Role mode must be "host" or "otg"
 - extcon          : extcon specifier for the otg phy

필수 속성 :
  - 호환 : "allwinner, sun4i-a10-musb", "allwinner, sun6i-a31-musb"또는 "allwinner, sun8i-a33-musb"
  - musc 컨트롤러의 reg : mmio 주소 범위
  - clocks : musb 컨트롤러의 clock specifier ahb gate clock
  - reset  : ahb 재설정 reset specifier (A31 이상 만)
  - interrupts : musb 컨트롤러가 연결된 인터럽트
  - interrupt-names : "mc"여야합니다.
  - phys : oyg phy에 대한 phy 지정자
  - phy-names : "usb"여야합니다.
  - dr_mode : 이중 역할 모드는 "호스트"또는 "otg"이어야합니다.
  - extcon : otg phy에 대한 extcon 지정자

Example:

	usb_otg: usb@01c13000 {
		compatible = "allwinner,sun4i-a10-musb";
		reg = <0x01c13000 0x0400>;
		clocks = <&ahb_gates 0>;
		interrupts = <38>;
		interrupt-names = "mc";
		phys = <&usbphy 0>;
		phy-names = "usb";
		extcon = <&usbphy 0>;
		status = "disabled";
	};
```
