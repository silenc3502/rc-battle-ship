## Doc/DeviceDriver/devicetree/bindings/remoteproc/wkup_m3_rproc.txt
```
TI Wakeup M3 Remoteproc Driver
==============================

The TI AM33xx and AM43xx family of devices use a small Cortex M3 co-processor
(commonly referred to as Wakeup M3 or CM3) to help with various low power tasks
that cannot be controlled from the MPU. This CM3 processor requires a firmware
binary to accomplish this. The wkup_m3 remoteproc driver handles the loading of
the firmware and booting of the CM3.
TI AM33xx 및 AM43xx 제품군은 소형 Cortex M3 co-processor (일반적으로 Wakeup M3 또는 CM3이라고 함)를 사용하여 MPU에서 제어 할 수없는 다양한 저전력 작업을 지원합니다. 이 CM3 processor는 이를 수행하기 위해 펌웨어 바이너리가 필요합니다. wkup_m3 remoteproc 드라이버는 펌웨어로드 및 CM3 부팅을 처리합니다.

Wkup M3 Device Node:
====================
A wkup_m3 device node is used to represent the Wakeup M3 processor instance
within the SoC. It is added as a child node of the parent interconnect bus
(l4_wkup) through which it is accessible to the MPU.
wkup_m3 장치 노드는 SoC 내의 Wakeup M3 프로세서 인스턴스를 나타내는 데 사용됩니다. 
MPU에서 액세스 할 수있는 상위 상호 연결 버스 (l4_wkup)의 하위 노드로 추가됩니다.

Required properties:
--------------------
- compatible:		Should be one of,
					그 중 하나 여야합니다.

				"ti,am3352-wkup-m3" for AM33xx SoCs
				"ti,am4372-wkup-m3" for AM43xx SoCs
- reg:			Should contain the address ranges for the two internal
			memory regions, UMEM and DMEM. The parent node should
			provide an appropriate ranges property for properly
			translating these into bus addresses.
			두 개의 내부 메모리 영역 인 UMEM 및 DMEM의 주소 범위를 포함해야합니다. 
			부모 노드는 이들을 버스 주소로 적절하게 변환하기 위해 적절한 ranges 속성을 제공해야합니다.

- reg-names:		Contains the corresponding names for the two memory
			regions. These should be named "umem" & "dmem".
- reg-names : 두 메모리 영역에 해당하는 names을 포함합니다. 이러한 names은 "umem"& "dmem"이어야합니다.

- ti,hwmods:		Name of the hwmod associated with the wkupm3 device.
					wkupm3 디바이스와 연관된 hwmod의 Name.
- ti,pm-firmware:	Name of firmware file to be used for loading and
			booting the wkup_m3 remote processor.
 					wkup_m3 원격 프로세서로드 및 부팅에 사용할 펌웨어 파일 Name입니다.
Example:
--------
/* AM33xx */
ocp {
	 l4_wkup: l4_wkup@44c00000 {
		compatible = "am335-l4-wkup", "simple-bus";
		ranges = <0 0x44c00000 0x400000>;
		#address-cells = <1>;
		#size-cells = <1>;

		wkup_m3: wkup_m3@100000 {
			compatible = "ti,am3352-wkup-m3";
			reg = <0x100000 0x4000>,
			      <0x180000 0x2000>;
			reg-names = "umem", "dmem";
			ti,hwmods = "wkup_m3";
			ti,pm-firmware = "am335x-pm-firmware.elf";
		};
	};

	...
};
```

## Doc/DeviceDriver/devicetree/bindings/reset/allwinner,sunxi-clock-reset.txt
```
Allwinner sunxi Peripheral Reset Controller
===========================================

Please also refer to reset.txt in this directory for common reset
controller binding usage.

Required properties:
- compatible: Should be one of the following:
  "allwinner,sun6i-a31-ahb1-reset"
  "allwinner,sun6i-a31-clock-reset"
- reg: should be register base and length as documented in the
  datasheet
- #reset-cells: 1, see below

Allwinner sunxi 주변 장치 리셋 컨트롤러
===============================

common reset controller binding 사용에 대해서는이 디렉토리의 reset.txt를 참조하십시오.

필수 속성 :
- compatible : 다음 중 하나 여야합니다.
   "allwinner, sun6i-a31-ahb1-reset"
   "allwinner, sun6i-a31-clock-reset"
- reg : 데이터 시트에 문서화 된대로 레지스터 기본 및 길이 여야합니다.
- # reset-cells : 1, 아래 참조


example:

ahb1_rst: reset@01c202c0 {
	#reset-cells = <1>;
	compatible = "allwinner,sun6i-a31-ahb1-reset";
	reg = <0x01c202c0 0xc>;
};
```

## Doc/DeviceDriver/devicetree/bindings/reset/ath79-reset.txt
```
Binding for Qualcomm Atheros AR7xxx/AR9XXX reset controller

Please also refer to reset.txt in this directory for common reset
controller binding usage.

Required Properties:
- compatible: has to be "qca,<soctype>-reset", "qca,ar7100-reset"
              as fallback
- reg: Base address and size of the controllers memory area
- #reset-cells : Specifies the number of cells needed to encode reset
                 line, should be 1

Qualcomm Atheros AR7xxx / AR9XXX 재설정 컨트롤러에 대한 바인딩

공통 재설정 제어기 바인딩 사용에 대해서는이 디렉토리의 reset.txt를 참조하십시오.

필수 등록 정보 :
- 호환 : 대체로 "qca, <soctype> -reset", "qca, ar7100-reset"이되어야합니다.
- reg : 컨트롤러 메모리 영역의 기본 주소와 크기
- # reset-cells : 리셋 라인을 인코딩하는 데 필요한 셀의 수를 지정합니다. 1이어야합니다.


Example:

	reset-controller@1806001c {
		compatible = "qca,ar9132-reset", "qca,ar7100-reset";
		reg = <0x1806001c 0x4>;

		#reset-cells = <1>;
	};
```

## Doc/DeviceDriver/devicetree/bindings/reset/berlin,reset.txt
```
Marvell Berlin reset controller
===============================

Please also refer to reset.txt in this directory for common reset
controller binding usage.

The reset controller node must be a sub-node of the chip controller
node on Berlin SoCs.

Required properties:
- compatible: should be "marvell,berlin2-reset"
- #reset-cells: must be set to 2

마벨 베를린 리셋 컨트롤러
=================

common reset controller binding 사용에 대해서는이 디렉토리의 reset.txt를 참조하십시오.

reset controller node 는 베를린 SoC의 칩 컨트롤러 노드의 하위 노드 여야합니다.

필수 속성 :
- 호환 가능 : "marvell, berlin2-reset"이어야합니다.
- # reset-cells : 2로 설정해야합니다.


Example:

chip_rst: reset {
	compatible = "marvell,berlin2-reset";
	#reset-cells = <2>;
};

&usb_phy0 {
	resets = <&chip_rst 0x104 12>;
};
```

## Doc/DeviceDriver/devicetree/bindings/reset/brcm,bcm21664-resetmgr.txt
```
Broadcom Kona Family Reset Manager
----------------------------------

The reset manager is used on the Broadcom BCM21664 SoC.

Required properties:
  - compatible: brcm,bcm21664-resetmgr
  - reg: memory address & range

Broadcom Kona 패밀리 리셋 관리자
----------------------------------

리셋 관리자는 Broadcom BCM21664 SoC에서 사용됩니다.

필수 속성 :
   - 호환 : brcm, bcm21664-resetmgr
   - reg : 메모리 주소 & 범위


Example:
	brcm,resetmgr@35001f00 {
		compatible = "brcm,bcm21664-resetmgr";
		reg = <0x35001f00 0x24>;
	};
```

## Doc/DeviceDriver/devicetree/bindings/reset/brcm,bcm63138-pmb.txt
```
Broadcom BCM63138 Processor Monitor Bus binding
===============================================

Please also refer to reset.txt in this directory for common reset
controller binding usage.

Require properties:

- compatible: must be "brcm,bcm63138-pmb"
- reg: base register address and size for this bus controller
- #reset-cells: must be 2 first cell is the address within the bus instance designated
  by the phandle, and the second is the number of zones for this peripheral

Broadcom BCM63138 프로세서 모니터 버스 바인딩
===================================================================

공통 재설정 제어기 바인딩 사용에 대해서는이 디렉토리의 reset.txt를 참조하십시오.

속성 필요 :

- 호환 가능 : "brcm, bcm63138-pmb"여야합니다.
- reg :이 버스 컨트롤러의 기본 레지스터 주소 및 크기
- # reset-cells : 2이어야 함 첫 번째 셀은 phandle에 의해 지정된 버스 인스턴스 내의 주소이고 두 번째 셀은이 주변 장치의 영역 수입니다.




Example:
	pmb0: reset-controller@4800c0 {
		compatible = "brcm,bcm63138-pmb";
		reg = <0x4800c0 0x10>;
		#reset-cells = <2>;
	};
```

## Doc/DeviceDriver/devicetree/bindings/reset/fsl,imx-src.txt
```
Freescale i.MX System Reset Controller
======================================

Please also refer to reset.txt in this directory for common reset
controller binding usage.

Required properties:
- compatible: Should be "fsl,<chip>-src"
- reg: should be register base and length as documented in the
  datasheet
- interrupts: Should contain SRC interrupt and CPU WDOG interrupt,
  in this order.
- #reset-cells: 1, see below

프리 스케일 i.MX 시스템 리셋 컨트롤러
========================

공통 재설정 제어기 바인딩 사용에 대해서는이 디렉토리의 reset.txt를 참조하십시오.

필수 속성 :
- 호환 가능 : "fsl, <chip> -src"여야합니다.
- reg : 데이터 시트에 문서화 된대로 레지스터 기본 및 길이 여야합니다.
- 인터럽트 : SRC 인터럽트 및 CPU WDOG 인터럽트를이 순서로 포함해야합니다.
- # reset-cells : 1, 아래 참조


example:

src: src@020d8000 {
        compatible = "fsl,imx6q-src";
        reg = <0x020d8000 0x4000>;
        interrupts = <0 91 0x04 0 96 0x04>;
        #reset-cells = <1>;
};

Specifying reset lines connected to IP modules
==============================================

The system reset controller can be used to reset the GPU, VPU,
IPU, and OpenVG IP modules on i.MX5 and i.MX6 ICs. Those device
nodes should specify the reset line on the SRC in their resets
property, containing a phandle to the SRC device node and a
RESET_INDEX specifying which module to reset, as described in
reset.txt

IP 모듈에 연결된 리셋 라인 지정하기
==================================

시스템 재설정 컨트롤러는 i.MX5 및 i.MX6 IC의 GPU, VPU, IPU 및 OpenVG IP 모듈을 재설정하는 데 사용할 수 있습니다. 이러한 장치 노드는 reset.txt에 설명 된대로 SRC 장치 노드에 대한 phandle과 재설정 할 모듈을 지정하는 RESET_INDEX를 포함하는 resets 속성의 SRC에 재설정 줄을 지정해야합니다

example:

        ipu1: ipu@02400000 {
                resets = <&src 2>;
        };
        ipu2: ipu@02800000 {
                resets = <&src 4>;
        };

The following RESET_INDEX values are valid for i.MX5:
GPU_RESET     0
VPU_RESET     1
IPU1_RESET    2
OPEN_VG_RESET 3
The following additional RESET_INDEX value is valid for i.MX6:
IPU2_RESET    4

다음 RESET_INDEX 값은 i.MX5에 유효합니다.
GPU_RESET 0
VPU_RESET 1
IPU1_RESET 2
OPEN_VG_RESET 3
다음의 추가 RESET_INDEX 값은 i.MX6에 유효합니다.
IPU2_RESET 4
```

## Doc/DeviceDriver/devicetree/bindings/reset/nxp,lpc1850-rgu.txt
```
NXP LPC1850  Reset Generation Unit (RGU)
========================================

Please also refer to reset.txt in this directory for common reset
controller binding usage.

Required properties:
- compatible: Should be "nxp,lpc1850-rgu"
- reg: register base and length
- clocks: phandle and clock specifier to RGU clocks
- clock-names: should contain "delay" and "reg"
- #reset-cells: should be 1

See table below for valid peripheral reset numbers. Numbers not
in the table below are either reserved or not applicable for
normal operation.

common reset controller binding 사용에 대해서는이 디렉토리의 reset.txt를 참조하십시오.

필수 속성 :
- 호환 가능 : "nxp, lpc1850-rgu"여야합니다.
- 등록 : 기본 및 길이 등록
- clocks : RGU 클럭에 대한 phandle 및 clock 지정자
- clock-names : "지연"과 "reg"를 포함해야합니다.
- # reset-cells : 1이어야합니다.

유효한 주변 장치 재설정 번호는 아래 표를 참조하십시오. 아래 표에없는 번호는 예약되었거나 정상 작동에 적용되지 않습니다.

Reset	Peripheral
  9	System control unit (SCU)
 12	ARM Cortex-M0 subsystem core (LPC43xx only)
 13	CPU core
 16	LCD controller
 17	USB0
 18	USB1
 19	DMA
 20	SDIO
 21	External memory controller (EMC)
 22	Ethernet
 25	Flash bank A
 27	EEPROM
 28	GPIO
 29	Flash bank B
 32	Timer0
 33	Timer1
 34	Timer2
 35	Timer3
 36	Repetitive Interrupt timer (RIT)
 37	State Configurable Timer (SCT)
 38	Motor control PWM (MCPWM)
 39	QEI
 40	ADC0
 41	ADC1
 42	DAC
 44	USART0
 45	UART1
 46	USART2
 47	USART3
 48	I2C0
 49	I2C1
 50	SSP0
 51	SSP1
 52	I2S0 and I2S1
 53	Serial Flash Interface (SPIFI)
 54	C_CAN1
 55	C_CAN0
 56	ARM Cortex-M0 application core (LPC4370 only)
 57	SGPIO (LPC43xx only)
 58	SPI (LPC43xx only)
 60	ADCHS (12-bit ADC) (LPC4370 only)

Refer to NXP LPC18xx or LPC43xx user manual for more details about
the reset signals and the connected block/peripheral.
리셋 신호 및 연결된 블록 / 주변 장치에 대한 자세한 내용은 NXP LPC18xx 또는 LPC43xx 사용자 매뉴얼을 참조하십시오.

Reset provider example:
rgu: reset-controller@40053000 {
	compatible = "nxp,lpc1850-rgu";
	reg = <0x40053000 0x1000>;
	clocks = <&cgu BASE_SAFE_CLK>, <&ccu1 CLK_CPU_BUS>;
	clock-names = "delay", "reg";
	#reset-cells = <1>;
};

Reset consumer example:
mac: ethernet@40010000 {
	compatible = "nxp,lpc1850-dwmac", "snps,dwmac-3.611", "snps,dwmac";
	reg = <0x40010000 0x2000>;
	interrupts = <5>;
	interrupt-names = "macirq";
	clocks = <&ccu1 CLK_CPU_ETHERNET>;
	clock-names = "stmmaceth";
	resets = <&rgu 22>;
	reset-names = "stmmaceth";
	status = "disabled";
};
```

## Doc/DeviceDriver/devicetree/bindings/reset/reset.txt
```
= Reset Signal Device Tree Bindings =

This binding is intended to represent the hardware reset signals present
internally in most IC (SoC, FPGA, ...) designs. Reset signals for whole
standalone chips are most likely better represented as GPIOs, although there
are likely to be exceptions to this rule.

Hardware blocks typically receive a reset signal. This signal is generated by
a reset provider (e.g. power management or clock module) and received by a
reset consumer (the module being reset, or a module managing when a sub-
ordinate module is reset). This binding exists to represent the provider and
consumer, and provide a way to couple the two together.

A reset signal is represented by the phandle of the provider, plus a reset
specifier - a list of DT cells that represents the reset signal within the
provider. The length (number of cells) and semantics of the reset specifier
are dictated by the binding of the reset provider, although common schemes
are described below.

A word on where to place reset signal consumers in device tree: It is possible
in hardware for a reset signal to affect multiple logically separate HW blocks
at once. In this case, it would be unwise to represent this reset signal in
the DT node of each affected HW block, since if activated, an unrelated block
may be reset. Instead, reset signals should be represented in the DT node
where it makes most sense to control it; this may be a bus node if all
children of the bus are affected by the reset signal, or an individual HW
block node for dedicated reset signals. The intent of this binding is to give
appropriate software access to the reset signals in order to manage the HW,
rather than to slavishly enumerate the reset signal that affects each HW
block.

= Reset Signal Device Tree Bindings =

이 바인딩은 대부분의 IC (SoC, FPGA, ...) 설계에 내부적으로 존재하는 하드웨어 리셋 신호를 나타 내기위한 것이다. whole standalone chips에 대한 리셋 신호는이 규칙에 대한 예외가있을지라도 GPIO로 표시 될 가능성이 높습니다.

하드웨어 블록은 일반적으로 리셋 신호를 수신합니다. 이 신호는 리셋 공급자 (예 : e.g 전원 관리 또는 클럭 모듈)에 의해 생성되고 리셋 소비자 (리셋되는 모듈 또는 하위 모듈이 리셋 될 때 관리되는 모듈)에 의해 수신됩니다. 이 바인딩은 공급자와 소비자를 나타내며 둘을 결합하는 방법을 제공합니다.

리셋 신호는 공급자의 phandle 과 리셋 지정자- 공급자 내의 리셋 신호를 나타내는 DT 셀 목록 로 표현됩니다. 리셋 지정자의 길이 (셀의 수)와 의미는 리셋 공급자의 바인딩에 의해 결정되지만 일반적인 schemes는 아래에 설명되어 있습니다

장치 트리에서 리셋 신호 소비자를 배치 할 위치에 대한 단어 : 하드웨어에서 리셋 신호가 multiple logically 로 분리 된 HW 블록에 동시에 적용될 수 있습니다. 이 경우 영향받은 각 HW 블록의 DT 노드에서 재설정 신호를 나타내는 것이 현명하지 않을 것입니다. 그이유는 활성화 된 경우 무관 한 블록이 재설정 될 수 있기 때문입니다. 대신 리셋 신호는 제어하기에 가장 적합한 DT 노드에 표시되어야합니다. 이것은 버스의 모든 children이 리셋 신호에 의해 영향을받는다면 버스 노드 일 수도 있고, 전용 리셋 신호들을위한 개별 HW 블록 노드 일 수도있다. 이 바인딩의 목적은 각 HW 블록에 영향을 미치는 리셋 신호를 slavishly 으로 열거하기보다는 HW를 관리하기 위해 리셋 신호에 적절한 소프트웨어 액세스를 제공하는 것입니다.


= Reset providers =

Required properties:
#reset-cells:	Number of cells in a reset specifier; Typically 0 for nodes
		with a single reset output and 1 for nodes with multiple
		reset outputs.

= 공급자 재설정 =

필수 속성 :
# reset-cells : 재설정 지정자의 셀 수. 단일 리셋 출력이있는 노드의 경우 일반적으로 0이고 여러 리셋 출력이있는 노드의 경우 1입니다.



For example:

	rst: reset-controller {
		#reset-cells = <1>;
	};

= Reset consumers =

Required properties:
resets:		List of phandle and reset specifier pairs, one pair
		for each reset signal that affects the device, or that the
		device manages. Note: if the reset provider specifies '0' for
		#reset-cells, then only the phandle portion of the pair will
		appear.

Optional properties:
reset-names:	List of reset signal name strings sorted in the same order as
		the resets property. Consumers drivers will use reset-names to
		match reset signal names with reset specifiers.

필수 속성 :
리셋 : List of phandle 및 리셋 지정자 쌍 , 장치에 영향을주는 각 리셋 신호에 대한 한 쌍 또는 장치가 관리하는 쌍. 
참고 : 재설정 공급자가 # reset-cells에 '0'을 지정하면 쌍의 phandle 부분 만 나타납니다.

선택적 속성 :
reset-names : List of reset signal name strings 은 reset 속성과 같은 순서로 정렬됩니다. 
소비자 드라이버는 reset-names을 사용하여 재설정 신호 이름을 재설정 지정자와 비교합니다.





For example:

	device {
		resets = <&rst 20>;
		reset-names = "reset";
	};

This represents a device with a single reset signal named "reset".

	bus {
		resets = <&rst 10> <&rst 11> <&rst 12> <&rst 11>;
		reset-names = "i2s1", "i2s2", "dma", "mixer";
	};

This represents a bus that controls the reset signal of each of four sub-
ordinate devices. Consider for example a bus that fails to operate unless no
child device has reset asserted.
이것은 4 개의 각 수직 소자의 리셋 신호를 제어하는 버스를 나타냅니다. 예를 들어 자식 장치가 리셋되었다고 선언하지 않으면 작동하지 않는 버스를 고려하십시오.
```
