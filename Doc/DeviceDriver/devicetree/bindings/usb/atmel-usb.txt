## Doc/DeviceDriver/devicetree/bindings/usb/exynos-usb.txt
```
Samsung Exynos SoC USB controller

The USB devices interface with USB controllers on Exynos SOCs.
The device node has following properties.
USB 장치는 Exynos SOC의 USB 컨트롤러와 인터페이스합니다.
장치 노드에는 다음과 같은 속성이 있습니다.

EHCI
Required properties:
 - compatible: should be "samsung,exynos4210-ehci" for USB 2.0
   EHCI controller in host mode.
 - reg: physical base address of the controller and length of memory mapped
   region.
 - interrupts: interrupt number to the cpu.
 - clocks: from common clock binding: handle to usb clock.
 - clock-names: from common clock binding: Shall be "usbhost".
 - port: if in the SoC there are EHCI phys, they should be listed here.
   One phy per port. Each port should have following entries:
	- reg: port number on EHCI controller, e.g
	       On Exynos5250, port 0 is USB2.0 otg phy
			      port 1 is HSIC phy0
			      port 2 is HSIC phy1
	- phys: from the *Generic PHY* bindings; specifying phy used by port.

필수 속성 :
  - 호환 : 호스트 모드에서 USB 2.0 EHCI 컨트롤러의 경우 "synex, exynos4210-ehci"여야합니다.
  - reg : 컨트롤러의 물리적 인 기본 주소와 메모리 매핑 된 영역의 길이.
  - interrupts : CPU에 대한 인터럽트 번호.
  - clocks : 일반적인 clocks 바인딩 : usb clocks 처리.
  - clock-names : common clock 바인딩에서 : "usbhost"가되어야합니다.
  - 포트 : SoC에 EHCI phys가있는 경우 여기에 나열되어야합니다.
    포트 당 하나의 phy. 각 포트에는 다음 항목이 있어야합니다.
- reg : EHCI 컨트롤러의 포트 번호, e.g가  Exynos5250에서 포트 0은 USB2.0 포트입니다.
포트 1은 HSIC phy0입니다.
포트 2는 HSIC phy1입니다.
- phys : * 일반 PHY * 바인딩에서. 포트가 사용하는 phy를 지정합니다.



Optional properties:
 - samsung,vbus-gpio:  if present, specifies the GPIO that
   needs to be pulled up for the bus to be powered.
선택적 속성 :
  - samsung, vbus-gpio :있는 경우 버스 전원 공급을 위해 끌어 올릴 필요가있는 GPIO를 지정합니다.

Example:

	usb@12110000 {
		compatible = "samsung,exynos4210-ehci";
		reg = <0x12110000 0x100>;
		interrupts = <0 71 0>;
		samsung,vbus-gpio = <&gpx2 6 1 3 3>;

		clocks = <&clock 285>;
		clock-names = "usbhost";

		#address-cells = <1>;
		#size-cells = <0>;
		port@0 {
		    reg = <0>;
		    phys = <&usb2phy 1>;
		    status = "disabled";
		};
	};

OHCI
Required properties:
 - compatible: should be "samsung,exynos4210-ohci" for USB 2.0
   OHCI companion controller in host mode.
 - reg: physical base address of the controller and length of memory mapped
   region.
 - interrupts: interrupt number to the cpu.
 - clocks: from common clock binding: handle to usb clock.
 - clock-names: from common clock binding: Shall be "usbhost".
 - port: if in the SoC there are OHCI phys, they should be listed here.
   One phy per port. Each port should have following entries:
	- reg: port number on OHCI controller, e.g
	       On Exynos5250, port 0 is USB2.0 otg phy
			      port 1 is HSIC phy0
			      port 2 is HSIC phy1
	- phys: from the *Generic PHY* bindings, specifying phy used by port.

OHCI
필수 속성 :
  - 호환 : 호스트 모드에서 USB 2.0 OHCI 도우미 컨트롤러의 경우 "samsung, exynos4210-ohci"여야합니다.
  - reg : 컨트롤러의 물리적 인 기본 주소와 메모리 매핑 된 영역의 길이.
  - interrupts : CPU에 대한 인터럽트 번호.
  - clocks : 일반적인 clocks 바인딩 : usb clocks 처리.
  - clock-names :common clock 바인딩에서 : "usbhost"가되어야합니다.
  - 포트 : SoC에 OHCI가 있으면 여기에 나열되어야합니다.
포트 당 하나의 phy. 각 포트에는 다음 항목이 있어야합니다.
- reg : OHCI 컨트롤러의 포트 번호, e.g 가 Exynos5250, 포트 0이 USB2.0 포트입니다.
포트 1은 HSIC phy0입니다.
포트 2는 HSIC phy1입니다.
- phys : * 일반 PHY * 바인딩에서 포트가 사용하는 phy를 지정합니다.


Example:
	usb@12120000 {
		compatible = "samsung,exynos4210-ohci";
		reg = <0x12120000 0x100>;
		interrupts = <0 71 0>;

		clocks = <&clock 285>;
		clock-names = "usbhost";

		#address-cells = <1>;
		#size-cells = <0>;
		port@0 {
		    reg = <0>;
		    phys = <&usb2phy 1>;
		    status = "disabled";
		};

	};

DWC3
Required properties:
 - compatible: should be one of the following -
	       "samsung,exynos5250-dwusb3": for USB 3.0 DWC3 controller on
					    Exynos5250/5420.
	       "samsung,exynos7-dwusb3": for USB 3.0 DWC3 controller on Exynos7.
 - #address-cells, #size-cells : should be '1' if the device has sub-nodes
				 with 'reg' property.
 - ranges: allows valid 1:1 translation between child's address space and
	   parent's address space
 - clocks: Clock IDs array as required by the controller.
 - clock-names: names of clocks correseponding to IDs in the clock property

Sub-nodes:
The dwc3 core should be added as subnode to Exynos dwc3 glue.
- dwc3 :
   The binding details of dwc3 can be found in:
   Documentation/devicetree/bindin필수 속성 :
  

- compatible : 다음 중 하나 여야합니다 -
"samsung, exynos5250-dwusb3": Exynos5250 / 5420의 USB 3.0 DWC3 컨트롤러 용.
"samsung, exynos7-dwusb3": Exynos7의 USB 3.0 DWC3 컨트롤러 용.
  - # address-cells, # size-cells : 장치에 'reg'속성이있는 하위 노드가있는 경우 '1'이어야합니다.
  - 범위 : 하위 주소 공간과 상위 주소 공간 간의 유효한 1 : 1 변환을 허용합니다.
  - clocks : 컨트롤러에서 요구하는대로 clocks ID 배열.
  - clock-names : clock 속성의 ID와 일치하는 시계의 이름

하위 노드 :
dwc3 코어는 Exynos dwc3 glue의 서브 노드로 추가되어야합니다.
- dwc3 :
    dwc3의 바인딩 세부 사항은 다음에서 찾을 수 있습니다.
    문서 / devicetree / bindings / usb / dwc3.txtgs/usb/dwc3.txt

Example:
	usb@12000000 {
		compatible = "samsung,exynos5250-dwusb3";
		clocks = <&clock 286>;
		clock-names = "usbdrd30";
		#address-cells = <1>;
		#size-cells = <1>;
		ranges;

		dwc3 {
			compatible = "synopsys,dwc3";
			reg = <0x12000000 0x10000>;
			interrupts = <0 72 0>;
			usb-phy = <&usb2_phy &usb3_phy>;
		};
	};
```

## Doc/DeviceDriver/devicetree/bindings/usb/fsl-usb.txt
```
Freescale SOC USB controllers

The device node for a USB controller that is part of a Freescale
SOC is as described in the document "Open Firmware Recommended
Practice : Universal Serial Bus" with the following modifications
and additions :

Freescale SOC의 일부인 USB 컨트롤러의 장치 노드는 "Open Firmware Recommended Practice : Universal Serial Bus"문서에 설명 된대로 다음과 같이 수정 및 추가됩니다.

Required properties :
 - compatible : Should be "fsl-usb2-mph" for multi port host USB
   controllers, or "fsl-usb2-dr" for dual role USB controllers
   or "fsl,mpc5121-usb2-dr" for dual role USB controllers of MPC5121.
   Wherever applicable, the IP version of the USB controller should
   also be mentioned (for eg. fsl-usb2-dr-v2.2 for bsc9132).
 - phy_type : For multi port host USB controllers, should be one of
   "ulpi", or "serial". For dual role USB controllers, should be
   one of "ulpi", "utmi", "utmi_wide", or "serial".
 - reg : Offset and length of the register set for the device
 - port0 : boolean; if defined, indicates port0 is connected for
   fsl-usb2-mph compatible controllers.  Either this property or
   "port1" (or both) must be defined for "fsl-usb2-mph" compatible
   controllers.
 - port1 : boolean; if defined, indicates port1 is connected for
   fsl-usb2-mph compatible controllers.  Either this property or
   "port0" (or both) must be defined for "fsl-usb2-mph" compatible
   controllers.
 - dr_mode : indicates the working mode for "fsl-usb2-dr" compatible
   controllers.  Can be "host", "peripheral", or "otg".  Default to
   "host" if not defined for backward compatibility.

필수 속성 :
  - 호환 : 다중 포트 호스트 USB 컨트롤러의 경우 "fsl-usb2-mph", 이중 역할 USB 컨트롤러의 경우 "fsl-usb2-dr"또는 MPC5121의 이중 역할 USB 컨트롤러의 경우 "fsl, mpc5121-usb2-dr"이어야합니다.
    해당되는 경우 USB 컨트롤러의 IP 버전도 언급해야합니다 (예 : bsc9132의 경우 fsl-usb2-dr-v2.2).
  - phy_type : 멀티 포트 호스트 USB 컨트롤러의 경우 "ulpi"또는 "serial"중 하나 여야합니다. 이중 역할 USB 컨트롤러의 경우 "ulpi", "utmi", "utmi_wide"또는 "serial"중 하나 여야합니다.
  - reg : 장치에 설정된 레지스터 오프셋 및 길이
  - port0 :  boolean; 정의 된 경우 port0이 fsl-usb2-mph 호환 제어기에 연결되었음을 나타냅니다. "fsl-usb2-mph"호환 제어기에 대해이 등록 정보 또는 "port1"(또는 둘다)을 정의해야합니다.
  - port1 : boolean; 정의 된 경우 port1이 fsl-usb2-mph 호환 제어기에 연결되었음을 나타냅니다. "fsl-usb2-mph"호환 제어기에 대해이 등록 정보 또는 "port0"(또는 둘 다)을 정의해야합니다.
  - dr_mode : "fsl-usb2-dr"호환 컨트롤러의 작동 모드를 나타냅니다. "호스트", "주변 장치"또는 "otg"일 수 있습니다. 이전 버전과의 호환성을 위해 정의되지 않은 경우 기본값은 "host"입니다.

Recommended properties :
 - interrupts : <a b> where a is the interrupt number and b is a
   field that represents an encoding of the sense and level
   information for the interrupt.  This should be encoded based on
   the information in section 2) depending on the type of interrupt
   controller you have.
 - interrupt-parent : the phandle for the interrupt controller that
   services interrupts for this device.

Optional properties :
 - fsl,invert-drvvbus : boolean; for MPC5121 USB0 only. Indicates the
   port power polarity of internal PHY signal DRVVBUS is inverted.
 - fsl,invert-pwr-fault : boolean; for MPC5121 USB0 only. Indicates
   the PWR_FAULT signal polarity is inverted.

권장 속성 :
  - 인터럽트 : a는 인터럽트 번호이고 b는 인터럽트에 대한 감지 및 레벨 정보의 인코딩을 나타내는 필드입니다. 이것은 인터럽트 컨트롤러의 유형에 따라 섹션 2)의 정보를 기반으로 인코딩해야합니다.
  - interrupt-parent :이 장치에 대한 인터럽트를 서비스하는 인터럽트 컨트롤러의 파들입니다.

선택적 속성 :
  - fsl, invert-drvvbus : boolean; MPC5121 USB0 전용. 내부 PHY 신호 DRVVBUS의 포트 전원 극성이 반전되었음을 나타냅니다.
  - fsl, invert-pwr-fault : boolean; MPC5121 USB0 전용. PWR_FAULT 신호의 극성이 바뀌 었음을 나타냅니다.




Example multi port host USB controller device node :
멀티 포트 호스트 USB 컨트롤러 장치 노드의 예 :

	usb@22000 {
		compatible = "fsl-usb2-mph";
		reg = <22000 1000>;
		#address-cells = <1>;
		#size-cells = <0>;
		interrupt-parent = <700>;
		interrupts = <27 1>;
		phy_type = "ulpi";
		port0;
		port1;
	};

Example dual role USB controller device node :
 이중 역할 USB 컨트롤러 장치 노드 예 :

	usb@23000 {
		compatible = "fsl-usb2-dr";
		reg = <23000 1000>;
		#address-cells = <1>;
		#size-cells = <0>;
		interrupt-parent = <700>;
		interrupts = <26 1>;
		dr_mode = "otg";
		phy = "ulpi";
	};

Example dual role USB controller device node for MPC5121ADS:
듀얼 롤 MPC5121ADS 용 USB 컨트롤러 장치 노드  예 :
	usb@4000 {
		compatible = "fsl,mpc5121-usb2-dr";
		reg = <0x4000 0x1000>;
		#address-cells = <1>;
		#size-cells = <0>;
		interrupt-parent = < &ipic >;
		interrupts = <44 0x8>;
		dr_mode = "otg";
		phy_type = "utmi_wide";
		fsl,invert-drvvbus;
		fsl,invert-pwr-fault;
	};
```

## Doc/DeviceDriver/devicetree/bindings/usb/generic.txt
```
Generic USB Properties

Optional properties:
 - maximum-speed: tells USB controllers we want to work up to a certain
			speed. Valid arguments are "super-speed", "high-speed",
			"full-speed" and "low-speed". In case this isn't passed
			via DT, USB controllers should default to their maximum
			HW capability.
 - dr_mode: tells Dual-Role USB controllers that we want to work on a
			particular mode. Valid arguments are "host",
			"peripheral" and "otg". In case this attribute isn't
			passed via DT, USB DRD controllers should default to
			OTG.
 - otg-rev: tells usb driver the release number of the OTG and EH supplement
			with which the device and its descriptors are compliant,
			in binary-coded decimal (i.e. 2.0 is 0200H). This
			property is used if any real OTG features(HNP/SRP/ADP)
			is enabled, if ADP is required, otg-rev should be
			0x0200 or above.
 - hnp-disable: tells OTG controllers we want to disable OTG HNP, normally HNP
			is the basic function of real OTG except you want it
			to be a srp-capable only B device.
 - srp-disable: tells OTG controllers we want to disable OTG SRP, SRP is
			optional for OTG device.
 - adp-disable: tells OTG controllers we want to disable OTG ADP, ADP is
			optional for OTG device.
 - otg-controller: phandle to otg controller. Host or gadget controllers can
			contain this property to link it to a particular otg
			controller. If this property is not present then otg
			core assumes that host and gadget controllers are
			children of the otg controller.


선택적 속성 :
  -  maximum-speed : 특정 속도까지 작동하려는 USB 컨트롤러를 알려줍니다. 유효한 인수는 "super-speed", "high-speed", "full-speed"및 "low-speed"입니다. 이것이 DT를 통해 전달되지 않는 경우 USB 컨트롤러는 최대 HW 기능을 기본값으로 설정해야합니다.
  - dr_mode : 이중 모드 USB 컨트롤러에 특정 모드로 작업 할 것을 지시합니다. 유효한 인수는 "host", "peripheral"및 "otg"입니다. 이 속성이 DT를 통해 전달되지 않는 경우 USB DRD 제어기는 OTG로 기본 설정되어야합니다.
  - otg-rev : 장치 및 해당 설명자가 준수하는 OTG 및 EH 보완의 릴리스 번호를 usb 드라이버에 2 진 코드 10 진수 (예 : 2.0은 0200H)로 알려줍니다. 이 속성은 실제 OTG 기능 (HNP / SRP / ADP)이 		활성화 된 경우에 사용되며 ADP가 필요하면 otg-rev는 0x0200 이상이어야합니다.
  - hnp-disable : OTG HNP를 비활성화하려는 OTG 컨트롤러에 알려줍니다. 일반적으로 HNP는 실제 OTG의 기본 기능이며, srp 가능 B 장치가되기를 원합니다.
  - srp-disable : OTG SRP를 비활성화하려는 OTG 컨트롤러에 알려주고, SRP는 OTG 장치의 경우 선택 사항입니다.
  - adp-disable : OTG ADP를 비활성화하려는 OTG 컨트롤러에 알려주고, ADP는 OTG 장치의 경우 선택 사항입니다.
  - otg-controller : 컨트롤러에 연결합니다. 호스트 또는 가젯 컨트롤러는 특정 OTG 컨트롤러에 링크하기 위해이 속성을 포함 할 수 있습니다. 이 속성이 없으면 otg 코어는 호스트 및 가젯 컨트롤러가 otg 컨트롤러의 자식이라고 가정합니다.


This is an attribute to a USB controller such as:
다음 은  USB 컨트롤러의 특성입니다.

dwc3@4a030000 {
	compatible = "synopsys,dwc3";
	reg = <0x4a030000 0xcfff>;
	interrupts = <0 92 4>
	usb-phy = <&usb2_phy>, <&usb3,phy>;
	maximum-speed = "super-speed";
	dr_mode = "otg";
	otg-rev = <0x0200>;
	adp-disable;
};
```

## Doc/DeviceDriver/devicetree/bindings/usb/gr-udc.txt
```
USB Peripheral Controller driver for Aeroflex Gaisler GRUSBDC.

The GRUSBDC USB Device Controller core is available in the GRLIB VHDL
IP core library.

Note: In the ordinary environment for the core, a Leon SPARC system,
these properties are built from information in the AMBA plug&play.

Required properties:

- name : Should be "GAISLER_USBDC" or "01_021"

- reg : Address and length of the register set for the device

- interrupts : Interrupt numbers for this device. Either one interrupt number
	for all interrupts, or one for status related interrupts, one for IN
	endpoint related interrupts and one for OUT endpoint related interrupts.

Optional properties:

- epobufsizes : Array of buffer sizes for OUT endpoints when they differ
	from the default size of 1024. The array is indexed by the OUT endpoint
	number. If the property is present it typically contains one entry for
	each OUT endpoint of the core. Fewer entries overrides the default sizes
	only for as many endpoints as the array contains.

- epibufsizes : Array of buffer sizes for IN endpoints when they differ
	from the default size of 1024. The array is indexed by the IN endpoint
	number. If the property is present it typically contains one entry for
	each IN endpoint of the core. Fewer entries overrides the default sizes
	only for as many endpoints as the array contains.

For further information look in the documentation for the GLIB IP core library:
http://www.gaisler.com/products/grlib/grip.pdf


GRUSBDC USB 장치 컨트롤러 코어는 GRLIB VHDL IP 코어 라이브러리에서 사용할 수 있습니다.

참고 : 일반적인 환경 인 Leon SPARC 시스템의 경우 이러한 속성은 AMBA 플러그 앤 플레이의 정보로 작성됩니다.

필수 속성 :

- name : 'GAISLER_USBDC'또는 '01_021 '이어야합니다.

- reg : 장치에 설정된 레지스터의 주소와 길이

- interrupts :이 장치의 번호를 인터럽트합니다. 모든 인터럽트에 대한 하나의 인터럽트 번호 또는 상태 관련 인터럽트에 대한 인터럽트 번호, IN endpoint 관련 인터럽트 및 OUT endpoint 관련 인터럽트 중 하나.

선택적 속성 :

- epobufsizes : OUT 엔드 포인트가 기본 크기 인 1024와 다를 때의 버퍼 크기 배열. 배열은 OUT 엔드 포인트 번호에 의해 색인됩니다. 속성이있는 경우 일반적으로 코어의 각 OUT 끝점에 대해 하나의 항목이 포함됩니다. 적은 수의 항목 만이 배열에 포함 된 끝점의 기본 크기보다 우선합니다.

- epibufsizes : 기본 엔드 포인트 크기가 1024 인 IN 엔드 포인트의 버퍼 크기 배열. IN 엔드 포인트 번호로 인덱스가 인덱싱됩니다. 속성이있는 경우 일반적으로 코어의 각 IN 끝점에 대해 하나의 항목이 포함됩니다. 적은 수의 항목 만이 배열에 포함 된 끝점의 기본 크기보다 우선합니다.

For further information look in the documentation for the GLIB IP core library:
자세한 내용은 GLIB IP 코어 라이브러리 설명서를 참조하십시오.
http://www.gaisler.com/products/grlib/grip.pdf
```

## Doc/DeviceDriver/devicetree/bindings/usb/isp1301.txt
```
* NXP ISP1301 USB transceiver

Required properties:
- compatible: must be "nxp,isp1301"
- reg: I2C address of the ISP1301 device

Optional properties of devices using ISP1301:
- transceiver: phandle of isp1301 - this helps the ISP1301 driver to find the
               ISP1301 instance associated with the respective USB driver

* NXP ISP1301 USB 트랜시버

필수 속성 :
- 호환 가능 : "nxp, isp1301"이어야합니다.
- reg : ISP1301 장치의 I2C 주소

ISP1301을 사용하는 장치의 선택적 속성 :
- transceiver : isp1301의 phandle - 이것은 ISP1301 드라이버가 각각의 USB 드라이버와 연관된 ISP1301 인스턴스를 찾도록 도와줍니다.



Example:

	isp1301: usb-transceiver@2c {
		compatible = "nxp,isp1301";
		reg = <0x2c>;
	};

	usbd@31020000 {
		compatible = "nxp,lpc3220-udc";
		reg = <0x31020000 0x300>;
		interrupt-parent = <&mic>;
		interrupts = <0x3d 0>, <0x3e 0>, <0x3c 0>, <0x3a 0>;
		transceiver = <&isp1301>;
		status = "okay";
	};
```
