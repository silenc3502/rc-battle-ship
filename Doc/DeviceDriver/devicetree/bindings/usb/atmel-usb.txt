## Doc/DeviceDriver/devicetree/bindings/usb/keystone-usb.txt
```
TI Keystone Soc USB Controller

DWC3 GLUE

Required properties:
 - compatible: should be "ti,keystone-dwc3".
 - #address-cells, #size-cells : should be '1' if the device has sub-nodes
   with 'reg' property.
 - reg : Address and length of the register set for the USB subsystem on
   the SOC.
 - interrupts : The irq number of this device that is used to interrupt the
   MPU.
 - ranges: allows valid 1:1 translation between child's address space and
   parent's address space.
 - clocks: Clock IDs array as required by the controller.
 - clock-names: names of clocks correseponding to IDs in the clock property.

Sub-nodes:
The dwc3 core should be added as subnode to Keystone DWC3 glue.
- dwc3 :
   The binding details of dwc3 can be found in:
   Documentation/devicetree/bindings/usb/dwc3.txt


필수 속성 :
  - compatible : "ti, keystone-dwc3"이어야합니다.
  - # address-cells, # size-cells : 장치에 'reg'속성이있는 하위 노드가있는 경우 '1'이어야합니다.
  - reg : SOC에있는 USB 서브 시스템 용 레지스터 세트의 주소와 길이.
  - interrupts : MPU를 인터럽트하는 데 사용되는 irq 번호입니다.
  - 범위 : 하위 주소 공간과 상위 주소 공간 간의 유효한 1 : 1 변환을 허용합니다.
  - clocks : 컨트롤러에서 요구하는대로 clocks ID 배열.
  - clock-names : clock 속성의 ID와 일치하는 clocks의 이름입니다.

하위 노드 :
dwc3 코어는 Keystone DWC3 아교에 하위 노드로 추가해야합니다.
- dwc3 :
    dwc3의 바인딩 세부 사항은 다음에서 찾을 수 있습니다.
    Documentation / devicetree / bindings / usb / dwc3.txt







Example:
	usb: usb@2680000 {
		compatible = "ti,keystone-dwc3";
		#address-cells = <1>;
		#size-cells = <1>;
		reg = <0x2680000 0x10000>;
		clocks = <&clkusb>;
		clock-names = "usb";
		interrupts = <GIC_SPI 393 IRQ_TYPE_EDGE_RISING>;
		ranges;
		status = "disabled";

		dwc3@2690000 {
			compatible = "synopsys,dwc3";
			reg = <0x2690000 0x70000>;
			interrupts = <GIC_SPI 393 IRQ_TYPE_EDGE_RISING>;
			usb-phy = <&usb_phy>, <&usb_phy>;
		};
	};
```

## Doc/DeviceDriver/devicetree/bindings/usb/lpc32xx-udc.txt
```
* NXP LPC32xx SoC USB Device Controller (UDC)

Required properties:
- compatible: Must be "nxp,lpc3220-udc"
- reg: Physical base address of the controller and length of memory mapped
  region.
- interrupts: The USB interrupts:
              * USB Device Low Priority Interrupt
              * USB Device High Priority Interrupt
              * USB Device DMA Interrupt
              * External USB Transceiver Interrupt (OTG ATX)
- transceiver: phandle of the associated ISP1301 device - this is necessary for
               the UDC controller for connecting to the USB physical layer


필수 속성 :
- compatible : "nxp, lpc3220-udc"여야합니다.
- reg : 컨트롤러의 물리적 기본 주소와 메모리 매핑 된 영역의 길이.
- 인터럽트 : USB 인터럽트 :
               * USB 장치 낮은 우선 순위 인터럽트
               * USB 장치 높은 우선 순위 인터럽트
               * USB 장치 DMA 인터럽트
               * 외부 USB 트랜시버 인터럽트 (OTG ATX)
- transceiver : 관련 ISP1301 장치의 phandle - UDC 컨트롤러가 USB 물리 계층에 연결하기 위해 필요합니다.



Example:

	isp1301: usb-transceiver@2c {
		compatible = "nxp,isp1301";
		reg = <0x2c>;
	};

	usbd@31020000 {
		compatible = "nxp,lpc3220-udc";
		reg = <0x31020000 0x300>;
		interrupt-parent = <&mic>;
		interrupts = <0x3d 0>, <0x3e 0>, <0x3c 0>, <0x3a 0>;
		transceiver = <&isp1301>;
	};
```

## Doc/DeviceDriver/devicetree/bindings/usb/msm-hsusb.txt
```
MSM SoC HSUSB controllers

EHCI

Required properties:
- compatible:	Should contain "qcom,ehci-host"
- regs:			offset and length of the register set in the memory map
- usb-phy:		phandle for the PHY device

필수 속성 :
- compatible : "qcom, ehci-host"
- regs : 메모리 맵에서 레지스터 세트의 오프셋과 길이
- usb-phy : PHY 장치의 phandle


Example EHCI controller device node:

	ehci: ehci@f9a55000 {
		compatible = "qcom,ehci-host";
		reg = <0xf9a55000 0x400>;
		usb-phy = <&usb_otg>;
	};

USB PHY with optional OTG:

Required properties:
- compatible:   Should contain:
  "qcom,usb-otg-ci" for chipsets with ChipIdea 45nm PHY
  "qcom,usb-otg-snps" for chipsets with Synopsys 28nm PHY

- regs:         Offset and length of the register set in the memory map
- interrupts:   interrupt-specifier for the OTG interrupt.

- clocks:       A list of phandle + clock-specifier pairs for the
                clocks listed in clock-names
- clock-names:  Should contain the following:
  "phy"         USB PHY reference clock
  "core"        Protocol engine clock
  "iface"       Interface bus clock
  "alt_core"    Protocol engine clock for targets with asynchronous
                reset methodology. (optional)

- vdccx-supply: phandle to the regulator for the vdd supply for
                digital circuit operation.
- v1p8-supply:  phandle to the regulator for the 1.8V supply
- v3p3-supply:  phandle to the regulator for the 3.3V supply

- resets:       A list of phandle + reset-specifier pairs for the
                resets listed in reset-names
- reset-names:  Should contain the following:
  "phy"         USB PHY controller reset
  "link"        USB LINK controller reset

- qcom,otg-control: OTG control (VBUS and ID notifications) can be one of
                1 - PHY control
                2 - PMIC control

필수 속성 :
- 호환 가능 : 다음을 포함해야합니다 :
   ChipIdea 45nm PHY 칩셋 용 "qcom, usb-otg-ci"
   Synopsys 28nm PHY 칩셋을위한 "qcom, usb-otg-snps"

- regs : 메모리 맵에서 레지스터 세트의 오프셋과 길이
- interrupts : OTG 인터럽트에 대한 인터럽트 지정자.

- clocks : clocks 이름에 나열된 clocks에 대한 phandle + clock-specifier 쌍 목록
- clock-names : 다음을 포함해야합니다 :
   "phy"USB PHY 기준 클럭
   "코어"프로토콜 엔진 clock
   "iface"인터페이스 버스 클럭
   "alt_core"비동기 재설정 방법론이있는 대상에 대한 프로토콜 엔진 클럭 (선택 사항)
- vdccx-supply : 디지털 회로 동작을위한 vdd 전원을위한 레귤레이터 에 phandle
- v1p8-supply : 1.8V 전원 레귤레이터에 phandle
 - v3p3-supply : 3.3V 전원 레귤레이터에 phandle
- reset : reset-names에 나열된 재설정에 대한 phandle + reset-specifier 쌍 목록
- reset-names : 다음을 포함해야합니다 :
   "phy"USB PHY 컨트롤러 재설정
   "링크"USB LINK 컨트롤러 재설정

- qcom, otg-control : OTG 제어 (VBUS 및 ID 알림)는 다음 중 하나 일 수 있습니다.
                 1 - PHY 제어
                 2 - PMIC 제어



Optional properties:
- dr_mode:      One of "host", "peripheral" or "otg". Defaults to "otg"

- switch-gpio:  A phandle + gpio-specifier pair. Some boards are using Dual
                SPDT USB Switch, witch is cotrolled by GPIO to de/multiplex
                D+/D- USB lines between connectors.

- qcom,phy-init-sequence: PHY configuration sequence values. This is related to Device
                Mode Eye Diagram test. Start address at which these values will be
                written is ULPI_EXT_VENDOR_SPECIFIC. Value of -1 is reserved as
                "do not overwrite default value at this address".
                For example: qcom,phy-init-sequence = < -1 0x63 >;
                Will update only value at address ULPI_EXT_VENDOR_SPECIFIC + 1.

- qcom,phy-num: Select number of pyco-phy to use, can be one of
                0 - PHY one, default
                1 - Second PHY
                Some platforms may have configuration to allow USB
                controller work with any of the two HSPHYs present.

- qcom,vdd-levels: This property must be a list of three integer values
                (no, min, max) where each value represents either a voltage
                in microvolts or a value corresponding to voltage corner.

- qcom,manual-pullup: If present, vbus is not routed to USB controller/phy
                and controller driver therefore enables pull-up explicitly
                before starting controller using usbcmd run/stop bit.

- extcon:       phandles to external connector devices. First phandle
                should point to external connector, which provide "USB"
                cable events, the second should point to external connector
                device, which provide "USB-HOST" cable events. If one of
                the external connector devices is not required empty <0>
                phandle should be specified.


선택적 속성 :
- dr_mode : "host", "peripheral"또는 "otg"중 하나입니다. 기본값은 "otg"입니다.

- switch-gpio : phandle + gpio-specifier 쌍. 일부 보드는 듀얼 SPDT USB 스위치를 사용하고 있으며 GPIO는 커넥터 간 D + / D-USB 라인을 분리 / 멀티플렉싱합니다.

- qcom, phy-init-sequence : PHY 구성 순서 값. 이것은 Device Mode Eye Diagram test 와 관련이 있습니다. 이 값들이 쓰여지는 시작 주소는 ULPI_EXT_VENDOR_SPECIFIC입니다. 값 -1은 "이 주소의 기본값을 덮어 쓰지 않습니다"로 예약됩니다.
                 예 : qcom, phy-init-sequence = <-1 0x63>;
                 주소 ULPI_EXT_VENDOR_SPECIFIC + 1의 값만 업데이트합니다.

Example HSUSB OTG controller device node:
HSUSB OTG 컨트롤러 장치 노드의 예 :

    usb@f9a55000 {
        compatible = "qcom,usb-otg-snps";
        reg = <0xf9a55000 0x400>;
        interrupts = <0 134 0>;
        dr_mode = "peripheral";

        clocks = <&gcc GCC_XO_CLK>, <&gcc GCC_USB_HS_SYSTEM_CLK>,
                <&gcc GCC_USB_HS_AHB_CLK>;

        clock-names = "phy", "core", "iface";

        vddcx-supply = <&pm8841_s2_corner>;
        v1p8-supply = <&pm8941_l6>;
        v3p3-supply = <&pm8941_l24>;

        resets = <&gcc GCC_USB2A_PHY_BCR>, <&gcc GCC_USB_HS_BCR>;
        reset-names = "phy", "link";

        qcom,otg-control = <1>;
        qcom,phy-init-sequence = < -1 0x63 >;
        qcom,vdd-levels = <1 5 7>;
	};
```

## Doc/DeviceDriver/devicetree/bindings/usb/nvidia,tegra20-ehci.txt
```
Tegra SOC USB controllers

The device node for a USB controller that is part of a Tegra
SOC is as described in the document "Open Firmware Recommended
Practice : Universal Serial Bus" with the following modifications
and additions :

Required properties :
 - compatible : For Tegra20, must contain "nvidia,tegra20-ehci".
   For Tegra30, must contain "nvidia,tegra30-ehci".  Otherwise, must contain
   "nvidia,<chip>-ehci" plus at least one of the above, where <chip> is
   tegra114, tegra124, tegra132, or tegra210.
 - nvidia,phy : phandle of the PHY that the controller is connected to.
 - clocks : Must contain one entry, for the module clock.
   See ../clocks/clock-bindings.txt for details.
 - resets : Must contain an entry for each entry in reset-names.
   See ../reset/reset.txt for details.
 - reset-names : Must include the following entries:
   - usb

Optional properties:
 - nvidia,needs-double-reset : boolean is to be set for some of the Tegra20
   USB ports, which need reset twice due to hardware issues.


   Tegra SOC USB 컨트롤러

Tegra SOC의 일부인 USB 컨트롤러의 장치 노드는 "Open Firmware Recommended Practice : Universal Serial Bus"문서에 설명 된대로 다음과 같이 수정 및 추가됩니다.

필수 속성 :
  - compatible : Tegra20의 경우 "nvidia, tegra20-ehci"를 포함해야합니다. Tegra30의 경우 "nvidia, tegra30-ehci"를 포함해야합니다. 그렇지 않으면 "nvidia, <chip> -ehci"와 적어도 하나 이상을 포함해야합니다. 여기서 <chip>은 tegra114, tegra124, tegra132 또는 tegra210입니다.
  - nvidia, phy : 컨트롤러가 연결된 PHY의 phandle.
  - clocks : 모듈 클럭에 대해 하나의 항목을 포함해야합니다.
    자세한 내용은 ../clocks/clock-bindings.txt를 참조하십시오.
  - reset : reset-names의 각 항목에 대한 항목을 포함해야합니다. 자세한 내용은 ../reset/reset.txt를 참조하십시오.
  - reset-names : 다음 항목을 포함해야합니다.
    - USB

선택적 속성 :
  - nvidia, needs-double-reset : 하드웨어 문제로 인해 두 번 재설정해야하는 Tegra20 USB 포트 중 일부에 부울을 설정해야합니다.
```

## Doc/DeviceDriver/devicetree/bindings/usb/ohci-nxp.txt
```
* OHCI controller, NXP ohci-nxp variant

Required properties:
- compatible: must be "nxp,ohci-nxp"
- reg: physical base address of the controller and length of memory mapped
  region.
- interrupts: The OHCI interrupt
- transceiver: phandle of the associated ISP1301 device - this is necessary for
               the UDC controller for connecting to the USB physical layer


* OHCI 컨트롤러, NXP ohci-nxp 변형

필수 속성 :
- compatible : "nxp, ohci-nxp"여야합니다.
- reg : 컨트롤러의 물리적 인 기본 주소와 메모리 매핑 된 영역의 길이.
- 인터럽트 : OHCI 인터럽트
- transceiver : 관련 ISP1301 장치의 phandle - USB 물리적 레이어에 연결하기 위해 UDC 컨트롤러에 필요합니다.

Example (LPC32xx):

	isp1301: usb-transceiver@2c {
		compatible = "nxp,isp1301";
		reg = <0x2c>;
	};

	ohci@31020000 {
		compatible = "nxp,ohci-nxp";
		reg = <0x31020000 0x300>;
		interrupt-parent = <&mic>;
		interrupts = <0x3b 0>;
		transceiver = <&isp1301>;
	};
```

## Doc/DeviceDriver/devicetree/bindings/usb/ohci-omap3.txt
```
OMAP HS USB OHCI controller (OMAP3 and later)

Required properties:

- compatible: should be "ti,ohci-omap3"
- reg: should contain one register range i.e. start and length
- interrupts: description of the interrupt line

OMAP HS USB OHCI 컨트롤러 (OMAP3 이상)

필수 속성 :

- compatible : "ti, ohci-omap3"이어야합니다.
- reg : 시작과 길이라는 하나의 레지스터 범위를 포함해야합니다.
- interrupts : 인터럽트 라인에 대한 설명


Example for OMAP4:

usbhsohci: ohci@4a064800 {
	compatible = "ti,ohci-omap3";
	reg = <0x4a064800 0x400>;
	interrupts = <0 76 0x4>;
};
```

## Doc/DeviceDriver/devicetree/bindings/usb/ohci-st.txt
```
ST USB OHCI controller

Required properties:

 - compatible		: must be "st,st-ohci-300x"
 - reg			: physical base addresses of the controller and length of memory mapped
			  region
 - interrupts		: one OHCI controller interrupt should be described here
 - clocks		: phandle list of usb clocks
 - clock-names		: should be "ic" for interconnect clock and "clk48"
See: Documentation/devicetree/bindings/clock/clock-bindings.txt

 - phys			: phandle for the PHY device
 - phy-names		: should be "usb"

 - resets		: phandle to the powerdown and reset controller for the USB IP
 - reset-names		: should be "power" and "softreset".
See: Documentation/devicetree/bindings/reset/st,sti-powerdown.txt
See: Documentation/devicetree/bindings/reset/reset.txt

필수 속성 :

  - compatible : "st, oh-ohci-300x"이어야합니다.
  - reg : 컨트롤러의 물리적 기본 주소 및 메모리 매핑 된 영역의 길이
  - 인터럽트 : 여기에 OHCI 컨트롤러 인터럽트 하나를 설명해야합니다.
  - clocks : usb clocks의 phandle 목록
  - clock-names :  상호 연결 클럭 및 "clk48"에 대해 "ic"이어야합니다. 
	Documentation / devicetree / bindings / clock / clock-bindings.txt를 참조하십시오.

  - phys : PHY 장치의 phandle
  - phy-names : "usb"여야합니다.

  - resets : 파워 다운으로 향하고 USB IP 용 컨트롤러 리셋 에 phandle
  - reset-names : "power"및 "softreset"이어야합니다.
참조 : Documentation / devicetree / bindings / reset / st, sti-powerdown.txt
참조 : Documentation / devicetree / bindings / reset / reset.txt


Example:

	ohci0: usb@0xfe1ffc00 {
		compatible = "st,st-ohci-300x";
		reg = <0xfe1ffc00 0x100>;
		interrupts = <GIC_SPI 149 IRQ_TYPE_NONE>;
		clocks = <&clk_s_a1_ls 0>,
			 <&clockgen_b0 0>;
		clock-names = "ic", "clk48";
		phys = <&usb2_phy>;
		phy-names = "usb";
		status = "okay";

		resets = <&powerdown STIH416_USB0_POWERDOWN>,
			 <&softreset STIH416_USB0_SOFTRESET>;
		reset-names = "power", "softreset";
	};
```
