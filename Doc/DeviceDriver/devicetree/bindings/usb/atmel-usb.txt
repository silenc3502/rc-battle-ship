## Doc/DeviceDriver/devicetree/bindings/usb/atmel-usb.txt
```
Atmel SOC USB controllers

OHCI

Required properties:
 - compatible: Should be "atmel,at91rm9200-ohci" for USB controllers
   used in host mode.
 - reg: Address and length of the register set for the device
 - interrupts: Should contain ehci interrupt
 - clocks: Should reference the peripheral, host and system clocks
 - clock-names: Should contains two strings
		"ohci_clk" for the peripheral clock
		"hclk" for the host clock
		"uhpck" for the system clock
 - num-ports: Number of ports.
 - atmel,vbus-gpio: If present, specifies a gpio that needs to be
   activated for the bus to be powered.
 - atmel,oc-gpio: If present, specifies a gpio that needs to be
   activated for the overcurrent detection.

  - compatible : 호스트 모드에서 사용되는 USB 컨트롤러의 경우 "atmel, at91rm9200-ohci"여야합니다.
  - reg : 장치에 설정된 레지스터의 주소와 길이
  - interrupts : ehci 인터럽트를 포함해야합니다.
  - 클럭 : 주변 장치, 호스트 및 시스템 클럭을 참조해야합니다.
  - clock-names : 두 개의 문자열을 포함해야합니다.
주변 장치 클럭 "ohci_clk"
호스트 클럭의 "hclk"
시스템 클럭의 "uhpck"
  - num-ports : 포트 수.
  - atmel, vbus-gpio : 있으면 버스에 전원을 공급하기 위해 활성화해야 할 gpio를 지정합니다.
  - atmel, oc-gpio :있는 경우, 과전류 감지를 위해 활성화해야하는 gpio를 지정합니다.

usb0: ohci@00500000 {
	compatible = "atmel,at91rm9200-ohci", "usb-ohci";
	reg = <0x00500000 0x100000>;
	clocks = <&uhphs_clk>, <&uhphs_clk>, <&uhpck>;
	clock-names = "ohci_clk", "hclk", "uhpck";
	interrupts = <20 4>;
	num-ports = <2>;
};






EHCI

Required properties:
 - compatible: Should be "atmel,at91sam9g45-ehci" for USB controllers
   used in host mode.
 - reg: Address and length of the register set for the device
 - interrupts: Should contain ehci interrupt
 - clocks: Should reference the peripheral and the UTMI clocks
 - clock-names: Should contains two strings
		"ehci_clk" for the peripheral clock
		"usb_clk" for the UTMI clock

  - compatible : 호스트 모드에서 사용되는 USB 컨트롤러의 경우 "atmel, at91sam9g45-ehci"여야합니다.
  - reg : 장치에 설정된 레지스터의 주소와 길이
  - interrupts : ehci 인터럽트를 포함해야합니다.
  - clocks : 주변 장치 및 UTMI 클럭을 참조해야합니다.
  - clock-names : 두 개의 문자열을 포함해야합니다.
	주변 장치 클럭 "ehci_clk"
	UTMI 시계의 경우 "usb_clk"


usb1: ehci@00800000 {
	compatible = "atmel,at91sam9g45-ehci", "usb-ehci";
	reg = <0x00800000 0x100000>;
	interrupts = <22 4>;
	clocks = <&utmi>, <&uhphs_clk>;
	clock-names = "usb_clk", "ehci_clk";
};

AT91 USB device controller

Required properties:
 - compatible: Should be one of the following
	       "atmel,at91rm9200-udc"
	       "atmel,at91sam9260-udc"
	       "atmel,at91sam9261-udc"
	       "atmel,at91sam9263-udc"
 - reg: Address and length of the register set for the device
 - interrupts: Should contain macb interrupt
 - clocks: Should reference the peripheral and the AHB clocks
 - clock-names: Should contains two strings
		"pclk" for the peripheral clock
		"hclk" for the AHB clock

Optional properties:
 - atmel,vbus-gpio: If present, specifies a gpio that needs to be
   activated for the bus to be powered.

필수 속성 :
  - compatible : 다음 중 하나 여야합니다.
		"atmel,at91rm9200-udc"
	       "atmel,at91sam9260-udc"
	       "atmel,at91sam9261-udc"
	       "atmel,at91sam9263-udc"
- reg : 장치에 설정된 레지스터의 주소와 길이
  - interrupts : macb 인터럽트를 포함해야합니다.
  - 클럭 : 주변 장치 및 AHB 클럭을 참조해야합니다.
  - clock-names : 두 개의 문자열을 포함해야합니다.
	주변 장치 클럭 "pclk"
	AHB 시계 용 "hclk"


선택적 속성 :
  - atmel, vbus-gpio : 있으면 버스에 전원을 공급하기 위해 활성화해야 할 gpio를 지정합니다.


usb1: gadget@fffa4000 {
	compatible = "atmel,at91rm9200-udc";
	reg = <0xfffa4000 0x4000>;
	interrupts = <10 4>;
	clocks = <&udc_clk>, <&udpck>;
	clock-names = "pclk", "hclk";
	atmel,vbus-gpio = <&pioC 5 0>;
};

Atmel High-Speed USB device controller

Required properties:
 - compatible: Should be one of the following
	       "atmel,at91sam9rl-udc"
	       "atmel,at91sam9g45-udc"
	       "atmel,sama5d3-udc"
 - reg: Address and length of the register set for the device
 - interrupts: Should contain usba interrupt
 - clocks: Should reference the peripheral and host clocks
 - clock-names: Should contains two strings
		"pclk" for the peripheral clock
		"hclk" for the host clock
 - ep childnode: To specify the number of endpoints and their properties.

필수 속성 :
  - compatible : 다음 중 하나 여야합니다.
		"atmel,at91sam9rl-udc"
	    "atmel,at91sam9g45-udc"
	    "atmel,sama5d3-udc"
  - reg : 장치에 설정된 레지스터의 주소와 길이
  - 인터럽트 : usba 인터럽트를 포함해야합니다.
  - 클럭 : 주변 장치 및 호스트 클럭을 참조해야합니다.
  - clock-names : 두 개의 문자열을 포함해야합니다.
주변 장치 클럭 "pclk"
호스트 클럭의 "hclk"
  - ep childnode : 엔드 포인트의 수와 특성을 지정합니다.


Optional properties:
 - atmel,vbus-gpio: If present, specifies a gpio that allows to detect whether
   vbus is present (USB is connected).

Required child node properties:
 - name: Name of the endpoint.
 - reg: Num of the endpoint.
 - atmel,fifo-size: Size of the fifo.
 - atmel,nb-banks: Number of banks.
 - atmel,can-dma: Boolean to specify if the endpoint support DMA.
 - atmel,can-isoc: Boolean to specify if the endpoint support ISOC.

선택적 속성 :
  - atmel, vbus-gpio : vbus가 있는지 여부를 감지 할 수있는 gpio를 지정합니다 (USB가 연결됨).

필수 자식 노드 등록 정보 :
  - name : 엔드 포인트의 이름.
  - reg : 끝점 번호.
  - atmel, fifo-size : fifo 크기입니다.
  - atmel, nb-banks : banks의 수.
  - atmel, can-dma : 끝점에서 DMA를 지원하는지 여부를 지정하는  boolean입니다.
  - atmel, can-isoc : 끝점에서 ISOC를 지원하는지 여부를 지정하는  boolean입니다.





usb2: gadget@fff78000 {
	#address-cells = <1>;
	#size-cells = <0>;
	compatible = "atmel,at91sam9rl-udc";
	reg = <0x00600000 0x80000
	       0xfff78000 0x400>;
	interrupts = <27 4 0>;
	clocks = <&utmi>, <&udphs_clk>;
	clock-names = "hclk", "pclk";
	atmel,vbus-gpio = <&pioB 19 0>;

	ep0 {
		reg = <0>;
		atmel,fifo-size = <64>;
		atmel,nb-banks = <1>;
	};

	ep1 {
		reg = <1>;
		atmel,fifo-size = <1024>;
		atmel,nb-banks = <2>;
		atmel,can-dma;
		atmel,can-isoc;
	};

	ep2 {
		reg = <2>;
		atmel,fifo-size = <1024>;
		atmel,nb-banks = <2>;
		atmel,can-dma;
		atmel,can-isoc;
	};

	ep3 {
		reg = <3>;
		atmel,fifo-size = <1024>;
		atmel,nb-banks = <3>;
		atmel,can-dma;
	};

	ep4 {
		reg = <4>;
		atmel,fifo-size = <1024>;
		atmel,nb-banks = <3>;
		atmel,can-dma;
	};

	ep5 {
		reg = <5>;
		atmel,fifo-size = <1024>;
		atmel,nb-banks = <3>;
		atmel,can-dma;
		atmel,can-isoc;
	};

	ep6 {
		reg = <6>;
		atmel,fifo-size = <1024>;
		atmel,nb-banks = <3>;
		atmel,can-dma;
		atmel,can-isoc;
	};
};
```

## Doc/DeviceDriver/devicetree/bindings/usb/brcm,bcm3384-usb.txt
```
* Broadcom USB controllers

Required properties:
- compatible: "brcm,bcm3384-ohci", "brcm,bcm3384-ehci"

  These currently use the generic-ohci and generic-ehci drivers.  On some
  systems, special handling may be needed in the following cases:

  - Restoring state after systemwide power save modes
  - Sharing PHYs with the USBD (UDC) hardware
  - Figuring out which controllers are disabled on ASIC bondout variants


* Broadcom USB 컨트롤러

필수 속성 :
- 호환 : "brcm, bcm3384-ohci", "brcm, bcm3384-ehci"

   현재는 generic-ohci 및 generic-ehci 드라이버를 사용합니다. 일부 시스템에서는 다음과 같은 경우에 특수 처리가 필요할 수 있습니다.

   - 시스템 전체 절전 모드 이후의 상태 복원
   - USBD (UDC) 하드웨어로 PHY 공유
   - ASIC 본드 아웃 변형에서 사용할 수없는 컨트롤러 파악
```

## Doc/DeviceDriver/devicetree/bindings/usb/ci-hdrc-usb2.txt
```
* USB2 ChipIdea USB controller for ci13xxx

Required properties:
- compatible: should be one of:
	"fsl,imx27-usb"
	"lsi,zevio-usb"
	"qcom,ci-hdrc"
	"chipidea,usb2"
	"xlnx,zynq-usb-2.20a"
- reg: base address and length of the registers
- interrupts: interrupt for the USB controller

필수 속성 :
- compatible : 다음 중 하나 여야합니다.
"fsl, imx27-usb"
"lsi, zevio-usb"
"qcom, ci-hdrc"
"chipidea, usb2"
"xlnx, zynq-usb-2.20a"
- reg : 레지스터의 기본 주소와 길이
- interrupts : USB 컨트롤러의 인터럽트


Recommended properies:
- phy_type: the type of the phy connected to the core. Should be one
  of "utmi", "utmi_wide", "ulpi", "serial" or "hsic". Without this
  property the PORTSC register won't be touched.
- dr_mode: One of "host", "peripheral" or "otg". Defaults to "otg"
권장 사항 :
- phy_type : 코어에 연결된 phy 유형입니다. "utmi", "utmi_wide", "ulpi", "serial"또는 "hsic"중 하나 여야합니다. 이 속성이 없으면 PORTSC 레지스터는 건드리지 않습니다.
- dr_mode : "host", "peripheral"또는 "otg"중 하나입니다. 기본값은 "otg"입니다.

Deprecated properties:
- usb-phy:      phandle for the PHY device. Use "phys" instead.
- fsl,usbphy: phandle of usb phy that connects to the port. Use "phys" instead.
사용되지 않는 속성 :
- usb-phy : phy 장치에 대한 phandle. 대신 "phys"를 사용하십시오.
- fsl, usbphy : 포트에 연결하는 usb phy의 phandle. 대신 "phys"를 사용하십시오.


Optional properties:
- clocks: reference to the USB clock
- phys: reference to the USB PHY
- phy-names: should be "usb-phy"
- vbus-supply: reference to the VBUS regulator
- maximum-speed: limit the maximum connection speed to "full-speed".
- tpl-support: TPL (Targeted Peripheral List) feature for targeted hosts
- itc-setting: interrupt threshold control register control, the setting
  should be aligned with ITC bits at register USBCMD.
- ahb-burst-config: it is vendor dependent, the required value should be
  aligned with AHBBRST at SBUSCFG, the range is from 0x0 to 0x7. This
  property is used to change AHB burst configuration, check the chipidea
  spec for meaning of each value. If this property is not existed, it
  will use the reset value.
- tx-burst-size-dword: it is vendor dependent, the tx burst size in dword
  (4 bytes), This register represents the maximum length of a the burst
  in 32-bit words while moving data from system memory to the USB
  bus, the value of this property will only take effect if property
  "ahb-burst-config" is set to 0, if this property is missing the reset
  default of the hardware implementation will be used.
- rx-burst-size-dword: it is vendor dependent, the rx burst size in dword
  (4 bytes), This register represents the maximum length of a the burst
  in 32-bit words while moving data from the USB bus to system memory,
  the value of this property will only take effect if property
  "ahb-burst-config" is set to 0, if this property is missing the reset
  default of the hardware implementation will be used.
- extcon: phandles to external connector devices. First phandle should point to
  external connector, which provide "USB" cable events, the second should point
  to external connector device, which provide "USB-HOST" cable events. If one
  of the external connector devices is not required, empty <0> phandle should
  be specified.
- phy-clkgate-delay-us: the delay time (us) between putting the PHY into
  low power mode and gating the PHY clock.

선택적 속성 :
- clocks : USB 클럭에 대한 참조
- phys : USB PHY에 대한 참조
- phy-names : "usb-phy"여야합니다.
- vbus-supply : VBUS 레귤레이터에 대한 참조
- 최대 속도 : 최대 연결 속도를 "full-speed"로 제한하십시오.
- tpl-support : 대상 호스트의 TPL (Targeted Peripheral List) 기능
- itc 설정 : 인터럽트 임계 값 제어 레지스터 제어, 설정은 레지스터 USBCMD의 ITC 비트와 정렬되어야합니다.
- ahb-burst-config : 공급 업체에 따라 다르며 SBUSCFG에서 필수 값이 AHBBRST와 정렬되어야하며 범위는 0x0에서 0x7까지입니다. 이 속성은 AHB 버스트 구성을 변경하는 데 사용되며 각 값의 의미에 대해 chipidea 사양을 확인하십시오. 이 특성이 존재하지 않으면 재설정 값을 사용합니다.
- tx-burst-size-dword : 공급 업체에 따라 다르며 dx (4 바이트)의 tx 버스트 크기입니다.이 레지스터는 시스템 메모리에서 USB 버스로 데이터를 이동하는 동안 32 비트 단어로 된 버스트의 최대 길이를 나타냅니다 이 property의 값은 property "ahb-burst-config"가 0으로 설정된 경우에만 유효합니다.이 property가 없으면 하드웨어 구현의 리셋 기본값이 사용됩니다.
- rx-burst-size-dword : 공급 업체에 따라 다르며 rx 버스트 크기는 dword (4 바이트)로,이 레지스터는 USB 버스에서 시스템 메모리로 데이터를 이동하는 동안 32 비트 단어로 버스트의 최대 길이를 나타냅니다 이 property의 값은 property "ahb-burst-config"가 0으로 설정된 경우에만 유효합니다.이 property가 없으면 하드웨어 구현의 리셋 기본값이 사용됩니다.
- extcon : 외부 커넥터 장치에 연결합니다. 첫 번째 phandle은 "USB"케이블 이벤트를 제공하는 외부 커넥터를 가리켜 야하고 두 번째는 "USB-HOST"케이블 이벤트를 제공하는 외부 커넥터 장치를 가리켜 야합니다. 외부 커넥터 장치 중 하나가 필요하지 않은 경우 빈 <0> phandle을 지정해야합니다.
- phy-clkgate-delay-us : PHY를 저전력 모드로 설정하고 PHY 클럭을 게이팅하는 것 사이의 지연 시간 (us).


i.mx specific properties
- fsl,usbmisc: phandler of non-core register device, with one
  argument that indicate usb controller index
- disable-over-current: disable over current detect
- external-vbus-divider: enables off-chip resistor divider for Vbus

i.mx 특정 속성
- fsl, usbmisc : 비 핵심 레지스터 장치의 phandler이며, 하나의 인수는 usb 컨트롤러 인덱스를 나타냅니다.
- disable-over-current : 과전류 감지 비활성화
- external-vbus-divider : Vbus를위한 오프 칩 저항 분배기를 가능하게한다.

Example:

	usb@f7ed0000 {
		compatible = "chipidea,usb2";
		reg = <0xf7ed0000 0x10000>;
		interrupts = <GIC_SPI 11 IRQ_TYPE_LEVEL_HIGH>;
		clocks = <&chip CLKID_USB0>;
		phys = <&usb_phy0>;
		phy-names = "usb-phy";
		vbus-supply = <&reg_usb0_vbus>;
		gadget-itc-setting = <0x4>; /* 4 micro-frames */
		 /* Incremental burst of unspecified length */
     / * 지정되지 않은 길이의 증분 버스트 * /
		ahb-burst-config = <0x0>;
		tx-burst-size-dword = <0x10>; /* 64 bytes */
		rx-burst-size-dword = <0x10>;
		extcon = <0>, <&usb_id>;
		phy-clkgate-delay-us = <400>;
	};
```

## Doc/DeviceDriver/devicetree/bindings/usb/dwc2.txt
```
Platform DesignWare HS OTG USB 2.0 controller
-----------------------------------------------------

Required properties:
- compatible : One of:
  - brcm,bcm2835-usb: The DWC2 USB controller instance in the BCM2835 SoC.
  - rockchip,rk3066-usb: The DWC2 USB controller instance in the rk3066 Soc;
  - "rockchip,rk3188-usb", "rockchip,rk3066-usb", "snps,dwc2": for rk3188 Soc;
  - "rockchip,rk3288-usb", "rockchip,rk3066-usb", "snps,dwc2": for rk3288 Soc;
  - snps,dwc2: A generic DWC2 USB controller with default parameters.
- reg : Should contain 1 register range (address and length)
- interrupts : Should contain 1 interrupt
- clocks: clock provider specifier
- clock-names: shall be "otg"
Refer to clk/clock-bindings.txt for generic clock consumer properties

Optional properties:
- phys: phy provider specifier
- phy-names: shall be "usb2-phy"
Refer to phy/phy-bindings.txt for generic phy consumer properties
- dr_mode: shall be one of "host", "peripheral" and "otg"
  Refer to usb/generic.txt
- g-use-dma: enable dma usage in gadget driver.
- g-rx-fifo-size: size of rx fifo size in gadget mode.
- g-np-tx-fifo-size: size of non-periodic tx fifo size in gadget mode.
- g-tx-fifo-size: size of periodic tx fifo per endpoint (except ep0) in gadget mode.


필수 속성 :
- 호환 가능 : 다음 중 하나 :
   - brcm, bcm2835-usb : BCM2835 SoC의 DWC2 USB 컨트롤러 인스턴스.
   - rockchip, rk3066-usb : rk3066 Soc의 DWC2 USB 컨트롤러 인스턴스입니다.
   - "rockchip, rk3188-usb", "rockchip, rk3066-usb", "snps, dwc2": rk3188 Soc 용;
   - "rockchip, rk3288-usb", "rockchip, rk3066-usb", "snps, dwc2": rk3288 Soc 용;
   - snps, dwc2 : 기본 매개 변수가있는 일반 DWC2 USB 컨트롤러입니다.
- reg : 1 개의 레지스터 범위 (주소와 길이)를 포함해야 함.
- 인터럽트 : 1 개의 인터럽트를 포함해야합니다.
- clocks : clock provider specifier
- clock-names : "otg"가되어야한다.
 generic clock consumer 특성은 clk / clock-bindings.txt를 참조하십시오.


선택적 속성 :
- phys : phy 공급자 지정자
- phy-names : "usb2-phy"이어야합니다. 일반 phy 소비자 속성은 phy / phy-bindings.txt를 참조하십시오
- dr_mode : "host", "peripheral"및 "otg"중 하나이어야합니다. usb / generic.txt를 참조하십시오.
- g-use-dma : 가젯 드라이버에서 dma 사용을 활성화합니다.
- g-rx-fifo-size : 가제트 모드에서 rx fifo 크기의 크기.
- g-np-tx-fifo-size : 가제트 모드에서 비 주기적 tx fifo 크기의 크기.
- g-tx-fifo-size : 가제트 모드의 엔드 포인트 당 주기적 tx fifo의 크기 (ep0 제외).


Example:

        usb@101c0000 {
                compatible = "ralink,rt3050-usb, snps,dwc2";
                reg = <0x101c0000 40000>;
                interrupts = <18>;
		clocks = <&usb_otg_ahb_clk>;
		clock-names = "otg";
		phys = <&usbphy>;
		phy-names = "usb2-phy";
        };
```
