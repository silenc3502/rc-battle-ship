## Doc/DeviceDriver/devicetree/bindings/usb/dwc3-st.txt
```
ST DWC3 glue logic

This file documents the parameters for the dwc3-st driver.
This driver controls the glue logic used to configure the dwc3 core on
STiH407 based platforms.

Required properties:
 - compatible	: must be "st,stih407-dwc3"
 - reg		: glue logic base address and USB syscfg ctrl register offset
 - reg-names	: should be "reg-glue" and "syscfg-reg"
 - st,syscon	: should be phandle to system configuration node which
		  encompasses the glue registers
 - resets	: list of phandle and reset specifier pairs. There should be two entries, one
		  for the powerdown and softreset lines of the usb3 IP
 - reset-names	: list of reset signal names. Names should be "powerdown" and "softreset"
See: Documentation/devicetree/bindings/reset/st,sti-powerdown.txt
See: Documentation/devicetree/bindings/reset/reset.txt

 - #address-cells, #size-cells : should be '1' if the device has sub-nodes
   with 'reg' property

 - pinctl-names	: A pinctrl state named "default" must be defined
See: Documentation/devicetree/bindings/pinctrl/pinctrl-binding.txt

 - pinctrl-0	: Pin control group
See: Documentation/devicetree/bindings/pinctrl/pinctrl-binding.txt

 - ranges	: allows valid 1:1 translation between child's address space and
		  parent's address space


이 파일은 dwc3-st 드라이버의 매개 변수를 설명합니다.
이 드라이버는 dwc3 코어를 켜기 위해 사용되는 글루 로직을 제어합니다.
STiH407 기반 플랫폼.

필수 속성 :
  - compatible : "st, stih407-dwc3"이어야합니다.
  - reg : 논리 기본 주소 및 USB syscfg ctrl 레지스터 오프셋 붙이기
  - reg-names : "reg-glue"및 "syscfg-reg"여야합니다.
  - st, syscon : 글루 레지스터를 포함하는 시스템 설정 노드에 있어야한다.
  - resets : phandle 및 재설정 지정자 쌍의 목록입니다. 두 항목이 있어야합니다. 하나는 usb3 IP의 powerdown 및 softreset 행입니다.
  - reset-names : 재설정 된 신호 이름 목록. 이름은 "powerdown"및 "softreset"이어야합니다.
참조 : Documentation / devicetree / bindings / reset / st, sti-powerdown.txt
참조 : Documentation / devicetree / bindings / reset / reset.txt

- # address-cells, # size-cells : 장치에 'reg'속성이있는 하위 노드가있는 경우 '1'이어야합니다.

  - pinctl-names : "default"라는 pinctrl 상태를 정의해야합니다.
참조 : Documentation / devicetree / bindings / pinctrl / pinctrl-binding.txt

  - pinctrl-0 : 핀 제어 그룹
참조 : Documentation / devicetree / bindings / pinctrl / pinctrl-binding.txt

  - 범위 : 하위 주소 공간과 상위 주소 공간 간의 유효한 1 : 1 변환을 허용합니다.


Sub-nodes:
The dwc3 core should be added as subnode to ST DWC3 glue as shown in the
example below. The DT binding details of dwc3 can be found in:
Documentation/devicetree/bindings/usb/dwc3.txt

NB: The dr_mode property described in [1] is NOT optional for this driver, as the default value
is "otg", which isn't supported by this SoC. Valid dr_mode values for dwc3-st are either "host"
or "device".

[1] Documentation/devicetree/bindings/usb/generic.txt

하위 노드 :
dwc3 코어는 아래 예제와 같이 ST DWC3 글루에 서브 노드로 추가되어야합니다. dwc3의 DT 바인딩 세부 사항은 Documentation / devicetree / bindings / usb / dwc3.txt에서 찾을 수 있습니다.

주의 :이 드라이버에서는 [1]에서 설명한 dr_mode 속성이 선택 사항이 아니며 기본값은 "otg"입니다.이 값은이 SoC에서 지원되지 않습니다. dwc3-st의 유효한 dr_mode 값은 "host"또는 "device"입니다.

[1] Documentation/devicetree/bindings/usb/generic.txt

Example:

st_dwc3: dwc3@8f94000 {
	status		= "disabled";
	compatible	= "st,stih407-dwc3";
	reg		= <0x08f94000 0x1000>, <0x110 0x4>;
	reg-names	= "reg-glue", "syscfg-reg";
	st,syscfg	= <&syscfg_core>;
	resets		= <&powerdown STIH407_USB3_POWERDOWN>,
			  <&softreset STIH407_MIPHY2_SOFTRESET>;
	reset-names	= "powerdown", "softreset";
	#address-cells	= <1>;
	#size-cells	= <1>;
	pinctrl-names	= "default";
	pinctrl-0	= <&pinctrl_usb3>;
	ranges;

	dwc3: dwc3@9900000 {
		compatible	= "snps,dwc3";
		reg		= <0x09900000 0x100000>;
		interrupts	= <GIC_SPI 155 IRQ_TYPE_NONE>;
		dr_mode		= "host";
		phy-names	= "usb2-phy", "usb3-phy";
		phys		= <&usb2_picophy2>, <&phy_port2 PHY_TYPE_USB3>;
	};
};
```

## Doc/DeviceDriver/devicetree/bindings/usb/dwc3.txt
```
synopsys DWC3 CORE

DWC3- USB3 CONTROLLER. Complies to the generic USB binding properties
      as described in 'usb/generic.txt'

Required properties:
 - compatible: must be "snps,dwc3"
 - reg : Address and length of the register set for the device
 - interrupts: Interrupts used by the dwc3 controller.

DWC3- USB3 컨트롤러. 'usb / generic.txt'에 설명 된대로 일반 USB 바인딩 속성을 준수합니다.

필수 속성 :
  - compatible : "snps, dwc3"이어야합니다.
  - reg : 장치에 설정된 레지스터의 주소와 길이
  - interrupts : dwc3 컨트롤러가 사용하는 인터럽트입니다.

Optional properties:
 - usb-phy : array of phandle for the PHY device.  The first element
   in the array is expected to be a handle to the USB2/HS PHY and
   the second element is expected to be a handle to the USB3/SS PHY
 - phys: from the *Generic PHY* bindings
 - phy-names: from the *Generic PHY* bindings
 - tx-fifo-resize: determines if the FIFO *has* to be reallocated.
 - snps,usb3_lpm_capable: determines if platform is USB3 LPM capable
 - snps,disable_scramble_quirk: true when SW should disable data scrambling.
	Only really useful for FPGA builds.
 - snps,has-lpm-erratum: true when DWC3 was configured with LPM Erratum enabled
 - snps,lpm-nyet-threshold: LPM NYET threshold
 - snps,u2exit_lfps_quirk: set if we want to enable u2exit lfps quirk
 - snps,u2ss_inp3_quirk: set if we enable P3 OK for U2/SS Inactive quirk
 - snps,req_p1p2p3_quirk: when set, the core will always request for
			P1/P2/P3 transition sequence.
 - snps,del_p1p2p3_quirk: when set core will delay P1/P2/P3 until a certain
			amount of 8B10B errors occur.
 - snps,del_phy_power_chg_quirk: when set core will delay PHY power change
			from P0 to P1/P2/P3.
 - snps,lfps_filter_quirk: when set core will filter LFPS reception.
 - snps,rx_detect_poll_quirk: when set core will disable a 400us delay to start
			Polling LFPS after RX.Detect.
 - snps,tx_de_emphasis_quirk: when set core will set Tx de-emphasis value.
 - snps,tx_de_emphasis: the value driven to the PHY is controlled by the
			LTSSM during USB3 Compliance mode.
 - snps,dis_u3_susphy_quirk: when set core will disable USB3 suspend phy.
 - snps,dis_u2_susphy_quirk: when set core will disable USB2 suspend phy.
 - snps,dis_enblslpm_quirk: when set clears the enblslpm in GUSB2PHYCFG,
			disabling the suspend signal to the PHY.
 - snps,is-utmi-l1-suspend: true when DWC3 asserts output signal
			utmi_l1_suspend_n, false when asserts utmi_sleep_n
 - snps,hird-threshold: HIRD threshold
 - snps,hsphy_interface: High-Speed PHY interface selection between "utmi" for
   UTMI+ and "ulpi" for ULPI when the DWC_USB3_HSPHY_INTERFACE has value 3.
 - snps,quirk-frame-length-adjustment: Value for GFLADJ_30MHZ field of GFLADJ
	register for post-silicon frame length adjustment when the
	fladj_30mhz_sdbnd signal is invalid or incorrect.

선택적 속성 :
  - usb-phy : PHY 장치에 대한 phandle 배열입니다. array 의 첫 번째 요소는 USB2 / HS PHY의 핸들이 될 것으로 예상되며 두 번째 요소는 USB3 / SS PHY의 핸들이 될 것으로 예상됩니다
  - phys : * 일반 PHY * 바인딩
  - phy-names : * 일반 PHY * 바인딩
  - tx-fifo-resize : FIFO *가 재 할당되어야 하는지를 결정합니다.
  - snps, usb3_lpm_capable : 플랫폼이 USB3 LPM 가능 여부를 결정합니다.
  - snps, disable_scramble_quirk : SW가 데이터 스크램블을 비활성화해야하는 경우 true입니다. FPGA 빌드에 정말 유용합니다.
  - snps, has-lpm-erratum : LPM 에라타를 사용하도록 DWC3을 구성한 경우 true
  - snps, lpm-nyet-threshold : LPM NYET 임계 값
  - snps, u2exit_lfps_quirk : u2exit lfps quirk를 활성화하려면 설정하십시오.
  - snps, u2ss_inp3_quirk : P3을 U2 / SS 용으로 설정하면 설정 됨 비활성 쿼크
  - snps, req_p1p2p3_quirk : 코어가 설정되면 항상 P1 / P2 / P3 전환 시퀀스를 요청합니다.
  - snps, del_p1p2p3_quirk : 코어가 설정되면 일정량의 8B10B 오류가 발생할 때까지 P1 / P2 / P3을 지연시킵니다.
  - snps, del_phy_power_chg_quirk : 코어를 설정하면 PHY 전원이 P0에서 P1 / P2 / P3으로 변경됩니다.
  - snps, lfps_filter_quirk : 코어가 설정되면 LFPS 수신을 필터링합니다.
  - snps, rx_detect_poll_quirk : 코어가 설정된 경우 RX.Detect 후 폴링 LFPS를 시작하기 위해 400us 지연을 비활성화합니다.
  - snps, tx_de_emphasis_quirk : 코어가 설정되면 Tx 디앰 퍼시스 값이 설정됩니다.
  - snps, tx_de_emphasis : PHY로 구동되는 값은 USB3 준수 모드에서 LTSSM에 의해 제어됩니다.
  - snps, dis_u3_susphy_quirk : 코어가 설정되면 USB3 suspend phy가 비활성화됩니다.
  - snps, dis_u2_susphy_quirk : 코어가 설정되면 USB2 suspend phy가 비활성화됩니다.
  - snps, dis_enblslpm_quirk : GUSB2PHYCFG의 enblslpm을 지우고 PHY에 대한 일시 중지 신호를 비활성화합니다.
- snps, is-utmi-l1-suspend : DWC3이 출력 신호 utmi_l1_suspend_n을 지정할 때 true, utmi_sleep_n을 지정할 때 false
  - snps, hird-threshold : HIRD threshold
  - snps, hsphy_interface : "utmi"사이의 고속 PHY 인터페이스 선택
    DWC_USB3_HSPHY_INTERFACE 값이 3 일 때 ULPI에 대해 UTMI + 및 "ulpi".
  - snps, quirk-frame-length-adjustment : fladj_30mhz_sdbnd 신호가 유효하지 않거나 올바르지 않은 경우 실리콘 후 프레임 길이 조정을위한 GFLADJ 레지스터의 GFLADJ_30MHZ 필드 값입니다.

This is usually a subnode to DWC3 glue to which it is connected.
이것은 일반적으로 연결되어있는 DWC3  glue 의 하위 노드입니다.

dwc3@4a030000 {
	compatible = "snps,dwc3";
	reg = <0x4a030000 0xcfff>;
	interrupts = <0 92 4>
	usb-phy = <&usb2_phy>, <&usb3,phy>;
	tx-fifo-resize;
};
```

## Doc/DeviceDriver/devicetree/bindings/usb/ehci-omap.txt
```
OMAP HS USB EHCI controller

This device is usually the child of the omap-usb-host
Documentation/devicetree/bindings/mfd/omap-usb-host.txt

Required properties:

- compatible: should be "ti,ehci-omap"
- reg: should contain one register range i.e. start and length
- interrupts: description of the interrupt line

Optional properties:

- phys: list of phandles to PHY nodes.
  This property is required if at least one of the ports are in
  PHY mode i.e. OMAP_EHCI_PORT_MODE_PHY

To specify the port mode, see
Documentation/devicetree/bindings/mfd/omap-usb-host.txt


이 장치는 대개 omap-usb-host의 하위 파일입니다. Documentation / devicetree / bindings / mfd / omap-usb-host.txt

필수 속성 :

- compatible  : "ti, ehci-omap"이어야합니다.
- reg : 시작과 길이라는 하나의 레지스터 범위를 포함해야합니다.
- interrupts : 인터럽트 라인에 대한 설명

선택적 속성 :

- phys : PHY 노드에 대한 phandles 목록입니다.
   포트 중 하나 이상이 PHY 모드 인 경우이 속성이 필요합니다 (OMAP_EHCI_PORT_MODE_PHY).

포트 모드를 지정하려면 다음을 참조하십시오.
Documentation / devicetree / bindings / mfd / omap-usb-host.txt

Example for OMAP4:

usbhsehci: ehci@4a064c00 {
	compatible = "ti,ehci-omap";
	reg = <0x4a064c00 0x400>;
	interrupts = <0 77 0x4>;
};

&usbhsehci {
	phys = <&hsusb1_phy 0 &hsusb3_phy>;
};
```

## Doc/DeviceDriver/devicetree/bindings/usb/ehci-orion.txt
```
* EHCI controller, Orion Marvell variants

Required properties:
- compatible: must be "marvell,orion-ehci"
- reg: physical base address of the controller and length of memory mapped
  region.
- interrupts: The EHCI interrupt

Optional properties:
- clocks: reference to the clock
- phys: reference to the USB PHY
- phy-names: name of the USB PHY, should be "usb"


* EHCI 컨트롤러, Orion Marvell 변형

필수 속성 :
- 호환 가능 : "marvell, orion-ehci"여야합니다.
- reg : 컨트롤러의 물리적 인 기본 주소와 메모리 매핑 된 영역의 길이.
- 인터럽트 : EHCI 인터럽트

선택적 속성 :
- clocks : clocks 에 대한 참조
- phys : USB PHY에 대한 참조
- phy-names : USB PHY의 이름이며, "usb"여야합니다.



Example:

	ehci@50000 {
		compatible = "marvell,orion-ehci";
		reg = <0x50000 0x1000>;
		interrupts = <19>;
	};
```

## Doc/DeviceDriver/devicetree/bindings/usb/ehci-st.txt
```
ST USB EHCI controller

Required properties:
 - compatible		: must be "st,st-ehci-300x"
 - reg			: physical base addresses of the controller and length of memory mapped
			  region
 - interrupts		: one EHCI interrupt should be described here
 - pinctrl-names	: a pinctrl state named "default" must be defined
 - pinctrl-0		: phandle referencing pin configuration of the USB controller
See: Documentation/devicetree/bindings/pinctrl/pinctrl-binding.txt
 - clocks		: phandle list of usb clocks
 - clock-names		: should be "ic" for interconnect clock and "clk48"
See: Documentation/devicetree/bindings/clock/clock-bindings.txt

 - phys			: phandle for the PHY device
 - phy-names		: should be "usb"
 - resets		: phandle + reset specifier pairs to the powerdown and softreset lines
			  of the USB IP
 - reset-names		: should be "power" and "softreset"
See: Documentation/devicetree/bindings/reset/st,sti-powerdown.txt
See: Documentation/devicetree/bindings/reset/reset.txt

필수 속성 :
  - 호환 가능 : "st, st-ehci-300x"이어야합니다.
  - reg : 컨트롤러의 물리적 기본 주소 및 메모리 매핑 된 영역의 길이
  - 인터럽트 : 여기에 하나의 EHCI 인터럽트를 설명해야합니다.
  - pinctrl-names : "default"라는 pinctrl 상태를 정의해야합니다.
  - pinctrl-0 : USB 컨트롤러의 phandle 참조 핀 구성
참조 : Documentation / devicetree / bindings / pinctrl / pinctrl-binding.txt
  - clocks : usb clocks의 phandle 목록
  - clock-names : 상호 연결 클럭에 대해 "ic"이어야하고 "clk48"
참조 : Documentation / devicetree / bindings / clock / clock-bindings.txt

  - phys : PHY 장치의 phandle
  - phy-names : "usb"여야합니다.
  - 재설정 : phandle + 재설정 지정자 쌍을 USB IP의 powerdown 및 softreset 행에 연결합니다.
  - reset-names : "power"및 "softreset"이어야합니다.
참조 : Documentation / devicetree / bindings / reset / st, sti-powerdown.txt
참조 : Documentation / devicetree / bindings / reset / reset.txt


Example:

	ehci1: usb@0xfe203e00 {
		compatible = "st,st-ehci-300x";
		reg = <0xfe203e00 0x100>;
		interrupts = <GIC_SPI 148 IRQ_TYPE_NONE>;
		pinctrl-names = "default";
		pinctrl-0 = <&pinctrl_usb1>;
		clocks = <&clk_s_a1_ls 0>;
		phys = <&usb2_phy>;
		phy-names = "usb";
		status = "okay";

		resets = <&powerdown STIH416_USB1_POWERDOWN>,
			 <&softreset STIH416_USB1_SOFTRESET>;
		reset-names = "power", "softreset";
	};
```
