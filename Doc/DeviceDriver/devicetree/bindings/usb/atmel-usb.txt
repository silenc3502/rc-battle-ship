## Doc/DeviceDriver/devicetree/bindings/usb/omap-usb.txt
```
OMAP GLUE AND OTHER OMAP SPECIFIC COMPONENTS

OMAP MUSB GLUE
 - compatible : Should be "ti,omap4-musb" or "ti,omap3-musb"
 - ti,hwmods : must be "usb_otg_hs"
 - multipoint : Should be "1" indicating the musb controller supports
   multipoint. This is a MUSB configuration-specific setting.
 - num-eps : Specifies the number of endpoints. This is also a
   MUSB configuration-specific setting. Should be set to "16"
 - ram-bits : Specifies the ram address size. Should be set to "12"
 - interface-type : This is a board specific setting to describe the type of
   interface between the controller and the phy. It should be "0" or "1"
   specifying ULPI and UTMI respectively.
 - mode : Should be "3" to represent OTG. "1" signifies HOST and "2"
   represents PERIPHERAL.
 - power : Should be "50". This signifies the controller can supply up to
   100mA when operating in host mode.
 - usb-phy : the phandle for the PHY device
 - phys : the phandle for the PHY device (used by generic PHY framework)
 - phy-names : the names of the PHY corresponding to the PHYs present in the
   *phy* phandle.

OMAP MUSB GLUE
  - compatible : "ti, omap4-musb"또는 "ti, omap3-musb"이어야합니다.
  -  ti,hwmods : "usb_otg_hs"여야합니다.
   - multipoint : musb 컨트롤러가 multipoint를 지원함을 나타내는 "1"이어야합니다. 이는 MUSB 구성 별 설정입니다.
  - num-eps : 끝점의 수를 지정합니다. 이는 MUSB 구성 별 설정이기도합니다. "16"으로 설정해야합니다.
  - ram-bits : 램 주소 크기를 지정합니다. "12"로 설정해야합니다.
  - interface-type : 컨트롤러와 phy 사이의 인터페이스 유형을 설명하는 보드 별 설정입니다. ULPI 및 UTMI를 각각 지정하는 "0"또는 "1"이어야합니다.
  - mode : OTG를 나타 내기 위해 "3"이어야합니다. "1"은 호스트를 나타내며 "2"는 주변을 나타냅니다.
  - power : "50"이어야합니다. 이는 호스트 모드에서 작동 할 때 컨트롤러가 최대 100mA를 공급할 수 있음을 의미합니다.
  - usb-phy : PHY 장치의 phandle
  - phys : PHY 장치의 phandle (일반 PHY 프레임 워크에서 사용)
  - phy-names : * phy * phandle에있는 PHY에 해당하는 PHY의 이름.


Optional properties:
 - ctrl-module : phandle of the control module this glue uses to write to mailbox

선택적 속성 :
  - ctrl-module : glue가 mailbox에 기입하는데 사용하는 제어 모듈 phandle

SOC specific device node entry
SOC 특정 장치 노드 항목
usb_otg_hs: usb_otg_hs@4a0ab000 {
	compatible = "ti,omap4-musb";
	ti,hwmods = "usb_otg_hs";
	multipoint = <1>;
	num-eps = <16>;
	ram-bits = <12>;
	ctrl-module = <&omap_control_usb>;
	phys = <&usb2_phy>;
	phy-names = "usb2-phy";
};

Board specific device node entry
보드 특정 장치 노드 항목
&usb_otg_hs {
	interface-type = <1>;
	mode = <3>;
	power = <50>;
};

OMAP DWC3 GLUE
 - compatible : Should be
	* "ti,dwc3" for OMAP5 and DRA7
	* "ti,am437x-dwc3" for AM437x
 - ti,hwmods : Should be "usb_otg_ss"
 - reg : Address and length of the register set for the device.
 - interrupts : The irq number of this device that is used to interrupt the
   MPU
 - #address-cells, #size-cells : Must be present if the device has sub-nodes
 - utmi-mode : controls the source of UTMI/PIPE status for VBUS and OTG ID.
   It should be set to "1" for HW mode and "2" for SW mode.
 - ranges: the child address space are mapped 1:1 onto the parent address space

  - compatible : OMAP5 및 DRA7의 경우 "ti, dwc3"* AM437x의 경우 "ti, am437x-dwc3"이어야 함
  - ti, hwmods : "usb_otg_ss"여야합니다.
  - reg : 장치에 설정된 레지스터의 주소와 길이.
  - 인터럽트 : MPU를 인터럽트하는 데 사용되는이 장치의 irq 번호
  - # address-cells, # size-cells : 장치에 하위 노드가있는 경우에 있어야합니다.
  - utmi-mode : VBUS 및 OTG ID에 대한 UTMI / PIPE 상태 소스를 제어합니다.
    HW 모드에서는 "1"로, SW 모드에서는 "2"로 설정해야합니다.
  - 범위 : 하위 주소 공간이 상위 주소 공간에 1 : 1로 매핑됩니다.

Optional Properties:
 - extcon : phandle for the extcon device omap dwc3 uses to detect
   connect/disconnect events.
 - vbus-supply : phandle to the regulator device tree node if needed.
선택적 속성 :
  - extcon : extcon 장치 용 phandle omap dwc3은 연결 / 연결 끊김 이벤트를 감지하는 데 사용됩니다.
  - vbus-supply : 필요한 경우 조절기 장치 트리 노드에 연결합니다.

Sub-nodes:
The dwc3 core should be added as subnode to omap dwc3 glue.
- dwc3 :
   The binding details of dwc3 can be found in:
   Documentation/devicetree/bindings/usb/dwc3.txt

Sub-nodes:
dwc3 코어는 dwc3 glue 을 omap하기위한 서브 노드로 추가되어야합니다.
- dwc3 :
    dwc3의 바인딩 세부 사항은 다음에서 찾을 수 있습니다.
     Documentation / devicetree / bindings / usb / dwc3.txt


omap_dwc3 {
	compatible = "ti,dwc3";
	ti,hwmods = "usb_otg_ss";
	reg = <0x4a020000 0x1ff>;
	interrupts = <0 93 4>;
	#address-cells = <1>;
	#size-cells = <1>;
	utmi-mode = <2>;
	ranges;
};
```

## Doc/DeviceDriver/devicetree/bindings/usb/pxa-usb.txt
```
PXA USB controllers

OHCI

Required properties:
 - compatible: Should be "marvell,pxa-ohci" for USB controllers
   used in host mode.

Optional properties:
 - "marvell,enable-port1", "marvell,enable-port2", "marvell,enable-port3"
   If present, enables the appropriate USB port of the controller.
 - "marvell,port-mode" selects the mode of the ports:
	1 = PMM_NPS_MODE
	2 = PMM_GLOBAL_MODE
	3 = PMM_PERPORT_MODE
 - "marvell,power-sense-low" - power sense pin is low-active.
 - "marvell,power-control-low" - power control pin is low-active.
 - "marvell,no-oc-protection" - disable over-current protection.
 - "marvell,oc-mode-perport" - enable per-port over-current protection.
 - "marvell,power_on_delay" Power On to Power Good time - in ms.


필수 속성 :
  - 호환 : 호스트 모드에서 사용되는 USB 컨트롤러의 경우 "marvell, pxa-ohci"여야합니다.

선택적 속성 :
  - "marvell, enable-port1", "marvell, enable-port2", "marvell, enable-port3"컨트롤러의 해당 USB 포트를 활성화합니다.
  - "marvell, port-mode"는 포트의 모드를 선택합니다.
1 = PMM_NPS_MODE
2 = PMM_GLOBAL_MODE
3 = PMM_PERPORT_MODE
  - "marvell, power-sense-low"- 전력 감지 핀이 로우 액티브.
  - "marvell, power-control-low"- 전원 제어 핀이 로우 액티브입니다.
  - "Marvell, no-oc-protection"- 과전류 보호를 비활성화하십시오.
  - "marvell, oc-mode-perport"- 포트 별 과전류 보호를 가능하게합니다.
  - "marvell, power_on_delay"전원이 켜지면 좋은 시간 - ms입니다


Example:

	usb0: ohci@4c000000 {
		compatible = "marvell,pxa-ohci", "usb-ohci";
		reg = <0x4c000000 0x100000>;
		interrupts = <18>;
		marvell,enable-port1;
		marvell,port-mode = <2>; /* PMM_GLOBAL_MODE */
	};

UDC

Required properties:
 - compatible: Should be "marvell,pxa270-udc" for USB controllers
   used in device mode.
 - reg: usb device MMIO address space
 - interrupts: single interrupt generated by the UDC IP
 - clocks: input clock of the UDC IP (see clock-bindings.txt)

Optional properties:
 - gpios:
   - gpio activated to control the USB D+ pullup (see gpio.txt)

필수 속성 :
  - 호환 : 장치 모드에서 사용되는 USB 컨트롤러의 경우 "marvell, pxa270-udc"이어야합니다.
  - reg : usb 장치 MMIO 주소 공간
  - 인터럽트 : UDC IP에 의해 생성 된 단일 인터럽트
  - clocks : UDC IP의 입력 클럭 (clock-bindings.txt 참조)

선택적 속성 :
  - gpios :
    - gpio가 USB D + 풀업을 제어하도록 활성화되었습니다 (gpio.txt 참조).


Example:

		pxa27x_udc: udc@40600000 {
			compatible = "marvell,pxa270-udc";
			reg = <0x40600000 0x10000>;
			interrupts = <11>;
			clocks = <&pxa2xx_clks 11>;
			gpios = <&gpio 22 GPIO_ACTIVE_LOW>;
		};
```

## Doc/DeviceDriver/devicetree/bindings/usb/qcom,dwc3.txt
```
Qualcomm SuperSpeed DWC3 USB SoC controller

Required properties:
- compatible:	should contain "qcom,dwc3"
- clocks:		A list of phandle + clock-specifier pairs for the
				clocks listed in clock-names
- clock-names:	Should contain the following:
  "core"		Master/Core clock, have to be >= 125 MHz for SS
				operation and >= 60MHz for HS operation

Optional clocks:
  "iface"		System bus AXI clock.  Not present on all platforms
  "sleep"		Sleep clock, used when USB3 core goes into low
				power mode (U3).

필수 속성 :
- compatible : "qcom, dwc3"을 포함해야합니다.
- clocks : clock-names에 나열된 clocks에 대한 phandle + clock-specifier 쌍 목록
- clock-names : 다음을 포함해야합니다 :
      "코어"    마스터 / 코어 클록은 SS 동작을 위해서는 125MHz 이상이어야하고 HS 동작을 위해서는 60MHz 이상이어야한다.

선택 사양 클럭 :
   "iface"시스템 버스 AXI 클록. 모든 플랫폼에 존재하지 않음
   "sleep"Sleep clock, USB3 코어가 저전력 모드 (U3)로 전환 될 때 사용됩니다.

Required child node:
A child node must exist to represent the core DWC3 IP block. The name of
the node is not important. The content of the node is defined in dwc3.txt.
필수 자식 노드 :
핵심 DWC3 IP 블록을 나타내는 하위 노드가 있어야합니다. 노드의 이름은 중요하지 않습니다. 노드의 내용은 dwc3.txt에 정의됩니다.

Phy documentation is provided in the following places:
Phy 문서는 다음 장소에서 제공됩니다.
Documentation/devicetree/bindings/phy/qcom,dwc3-usb-phy.txt

Example device nodes:

		hs_phy: phy@100f8800 {
			compatible = "qcom,dwc3-hs-usb-phy";
			reg = <0x100f8800 0x30>;
			clocks = <&gcc USB30_0_UTMI_CLK>;
			clock-names = "ref";
			#phy-cells = <0>;

			status = "ok";
		};

		ss_phy: phy@100f8830 {
			compatible = "qcom,dwc3-ss-usb-phy";
			reg = <0x100f8830 0x30>;
			clocks = <&gcc USB30_0_MASTER_CLK>;
			clock-names = "ref";
			#phy-cells = <0>;

			status = "ok";
		};

		usb3_0: usb30@0 {
			compatible = "qcom,dwc3";
			#address-cells = <1>;
			#size-cells = <1>;
			clocks = <&gcc USB30_0_MASTER_CLK>;
			clock-names = "core";

			ranges;

			status = "ok";

			dwc3@10000000 {
				compatible = "snps,dwc3";
				reg = <0x10000000 0xcd00>;
				interrupts = <0 205 0x4>;
				phys = <&hs_phy>, <&ss_phy>;
				phy-names = "usb2-phy", "usb3-phy";
				tx-fifo-resize;
				dr_mode = "host";
			};
		};
```

## Doc/DeviceDriver/devicetree/bindings/usb/renesas_usbhs.txt
```
Renesas Electronics USBHS driver

Required properties:
  - compatible: Must contain one of the following:
	- "renesas,usbhs-r8a7790"
	- "renesas,usbhs-r8a7791"
	- "renesas,usbhs-r8a7794"
	- "renesas,usbhs-r8a7795"
  - reg: Base address and length of the register for the USBHS
  - interrupts: Interrupt specifier for the USBHS
  - clocks: A list of phandle + clock specifier pairs

필수 속성 :
   - 호환 : 다음 중 하나를 포함해야합니다.
- "renesas, usbhs-r8a7790"
- "renesas, usbhs-r8a7791"
- "renesas, usbhs-r8a7794"
- "renesas, usbhs-r8a7795"
   - reg : USBHS 용 레지스터의 기본 주소 및 길이
   - 인터럽트 : USBHS의 인터럽트 지정자
   - clocks : phandle + clock 지정자 쌍 목록


Optional properties:
  - renesas,buswait: Integer to use BUSWAIT register
  - renesas,enable-gpio: A gpio specifier to check GPIO determining if USB
			 function should be enabled
  - phys: phandle + phy specifier pair
  - phy-names: must be "usb"
  - dmas: Must contain a list of references to DMA specifiers.
  - dma-names : named "ch%d", where %d is the channel number ranging from zero
                to the number of channels (DnFIFOs) minus one.
선택적 속성 :
   - renesas, buswait : BUSWAIT 레지스터를 사용하는 정수
   - renesas, enable-gpio : GPIO가 USB 기능을 활성화해야하는지 확인하는 gpio 지정자
   - phys : phandle + phy 지정자 쌍
   - phy-names : "usb"여야합니다.
   - dmas : DMA 지정자에 대한 참조 목록을 포함해야합니다.
   - dma-names : "ch % d"로 명명되며, 여기서 % d는 0에서 채널 수 (DnFIFOs) - 1까지의 채널 번호입니다.

Example:
	usbhs: usb@e6590000 {
		compatible = "renesas,usbhs-r8a7790";
		reg = <0 0xe6590000 0 0x100>;
		interrupts = <0 107 IRQ_TYPE_LEVEL_HIGH>;
		clocks = <&mstp7_clks R8A7790_CLK_HSUSB>;
	};
```
