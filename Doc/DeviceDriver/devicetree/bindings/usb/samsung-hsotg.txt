## Doc/DeviceDriver/devicetree/bindings/usb/usbmisc-imx.txt
```
* Freescale i.MX non-core registers

Required properties:
- #index-cells: Cells used to descibe usb controller index. Should be <1>
- compatible: Should be one of below:
	"fsl,imx6q-usbmisc" for imx6q
	"fsl,vf610-usbmisc" for Vybrid vf610
	"fsl,imx6sx-usbmisc" for imx6sx
- reg: Should contain registers location and length

필수 속성 :
- # index-cells : usb 컨트롤러 색인을 descibe하는 데 사용되는 셀입니다. <1>이어야합니다.
- compatible : 다음 중 하나 여야합니다.
imx6q에 대한 "fsl, imx6q-usbmisc"
Vybrid vf610 용 "fsl, vf610-usbmisc"
"fsl, imx6sx-usbmisc"for imx6sx
- reg : 레지스터 위치와 길이를 포함해야합니다.


Examples:
usbmisc@02184800 {
	#index-cells = <1>;
	compatible = "fsl,imx6q-usbmisc";
	reg = <0x02184800 0x200>;
};
```

## Doc/DeviceDriver/devicetree/bindings/usb/ux500-usb.txt
```
Ux500 MUSB

Required properties:
 - compatible : Should be "stericsson,db8500-musb"
 - reg        : Offset and length of registers
 - interrupts : Interrupt; mode, number and trigger
 - dr_mode    : Dual-role; either host mode "host", peripheral mode "peripheral"
                or both "otg"

Optional properties:
 - dmas       : A list of dma channels;
                dma-controller, event-line, fixed-channel, flags
 - dma-names  : An ordered list of channel names affiliated to the above


필수 속성 :
  - compatible : "stericsson, db8500-musb"이어야합니다.
  - reg : 레지스터의 오프셋 및 길이
  - 인터럽트 : 인터럽트; 모드, 번호 및 트리거
  - dr_mode : 이중 역할; 호스트 모드 "호스트", 주변 장치 모드 "주변 장치"또는 둘 다 "otg"


선택적 속성 :
  - dmas : dma 채널 목록입니다. dma-controller, 이벤트 라인, 고정 채널, 플래그
  - dma-names : 위에 나열된 채널 이름의 정렬 된 목록


Example:

usb_per5@a03e0000 {
	compatible = "stericsson,db8500-musb";
	reg = <0xa03e0000 0x10000>;
	interrupts = <0 23 0x4>;
	interrupt-names = "mc";

	dr_mode = "otg";

	dmas = <&dma 38 0 0x2>, /* Logical - DevToMem */
	       <&dma 38 0 0x0>, /* Logical - MemToDev */
	       <&dma 37 0 0x2>, /* Logical - DevToMem */
	       <&dma 37 0 0x0>, /* Logical - MemToDev */
	       <&dma 36 0 0x2>, /* Logical - DevToMem */
	       <&dma 36 0 0x0>, /* Logical - MemToDev */
	       <&dma 19 0 0x2>, /* Logical - DevToMem */
	       <&dma 19 0 0x0>, /* Logical - MemToDev */
	       <&dma 18 0 0x2>, /* Logical - DevToMem */
	       <&dma 18 0 0x0>, /* Logical - MemToDev */
	       <&dma 17 0 0x2>, /* Logical - DevToMem */
	       <&dma 17 0 0x0>, /* Logical - MemToDev */
	       <&dma 16 0 0x2>, /* Logical - DevToMem */
	       <&dma 16 0 0x0>, /* Logical - MemToDev */
	       <&dma 39 0 0x2>, /* Logical - DevToMem */
	       <&dma 39 0 0x0>; /* Logical - MemToDev */

	dma-names = "iep_1_9",  "oep_1_9",
		    "iep_2_10", "oep_2_10",
		    "iep_3_11", "oep_3_11",
		    "iep_4_12", "oep_4_12",
		    "iep_5_13", "oep_5_13",
		    "iep_6_14", "oep_6_14",
		    "iep_7_15", "oep_7_15",
		    "iep_8",    "oep_8";
};
```
