## Doc/DeviceDriver/devicetree/bindings/usb/samsung-hsotg.txt
```
Samsung High Speed USB OTG controller
-----------------------------

The Samsung HSOTG IP can be found on Samsung SoCs, from S3C6400 onwards.
It gives functionality of OTG-compliant USB 2.0 host and device with
support for USB 2.0 high-speed (480Mbps) and full-speed (12 Mbps)
operation.

Samsung HSOTG IP는 삼성 SoC에서 S3C6400부터 찾을 수 있습니다.
USB 2.0 고속 (480Mbps) 및 전속 (12Mbps) 작동을 지원하는 OTG 호환 USB 2.0 호스트 및 장치의 기능을 제공합니다.

Currently only device mode is supported.
현재는 장치 모드 만 지원됩니다.

Binding details
-----

Required properties:
- compatible: "samsung,s3c6400-hsotg" should be used for all currently
    supported SoC,
- interrupt-parent: phandle for the interrupt controller to which the
    interrupt signal of the HSOTG block is routed,
- interrupts: specifier of interrupt signal of interrupt controller,
    according to bindings of interrupt controller,
- clocks: contains an array of clock specifiers:
    - first entry: OTG clock
- clock-names: contains array of clock names:
    - first entry: must be "otg"
- vusb_d-supply: phandle to voltage regulator of digital section,
- vusb_a-supply: phandle to voltage regulator of analog section.

필수 속성 :
- compatible : 현재 지원되는 모든 SoC에 "samsung, s3c6400-hsotg"를 사용해야합니다.
- interrupt-parent : HSOTG 블록의 인터럽트 신호가 라우팅되는 인터럽트 컨트롤러에 대한 phandle,
- 인터럽트 : 인터럽트 컨트롤러의 바인딩에 따라 인터럽트 컨트롤러의 인터럽트 신호 지정자,
- clocks : 클럭 지정자의 배열을 포함합니다.
     - 첫 번째 항목 : OTG clocks
- clock-names : clocks 이름의 배열을 포함합니다 :
     - 첫 번째 항목 : "otg"여야합니다.
- vusb_d 공급 : 디지털 섹션의 전압 조절기에 대한 phandle,
- vusb_a-supply : 아날로그 섹션 의 전압 조절기에 대한 phandle,



Example
-----

	hsotg@12480000 {
		compatible = "samsung,s3c6400-hsotg";
		reg = <0x12480000 0x20000>;
		interrupts = <0 71 0>;
		clocks = <&clock 305>;
		clock-names = "otg";
		vusb_d-supply = <&vusb_reg>;
		vusb_a-supply = <&vusbdac_reg>;
	};
```

## Doc/DeviceDriver/devicetree/bindings/usb/spear-usb.txt
```
ST SPEAr SoC USB controllers:
-----------------------------

EHCI:
-----

Required properties:
- compatible: "st,spear600-ehci"
- interrupt-parent: Should be the phandle for the interrupt controller
  that services interrupts for this device
- interrupts: Should contain the EHCI interrupt

EHCI :
-----

필수 속성 :
- compatible : "st, spear600-ehci"
- interrupt-parent :이 장치에 대한 인터럽트를 서비스하는 인터럽트 컨트롤러의 phandle이어야합니다.
- 인터럽트 : EHCI 인터럽트를 포함해야합니다.



Example:

	ehci@e1800000 {
		compatible = "st,spear600-ehci", "usb-ehci";
		reg = <0xe1800000 0x1000>;
		interrupt-parent = <&vic1>;
		interrupts = <27>;
	};


OHCI:
-----

Required properties:
- compatible: "st,spear600-ohci"
- interrupt-parent: Should be the phandle for the interrupt controller
  that services interrupts for this device
- interrupts: Should contain the OHCI interrupt

OHCI :
-----

필수 속성 :
- compatible : "st, spear600-ohci"
- interrupt-parent :이 장치에 대한 인터럽트를 서비스하는 인터럽트 컨트롤러의 phandle이어야합니다.
- 인터럽트 : OHCI 인터럽트가 있어야합니다.


Example:

	ohci@e1900000 {
		compatible = "st,spear600-ohci", "usb-ohci";
		reg = <0xe1800000 0x1000>;
		interrupt-parent = <&vic1>;
		interrupts = <26>;
	};
```

## Doc/DeviceDriver/devicetree/bindings/usb/twlxxxx-usb.txt
```
USB COMPARATOR OF TWL CHIPS

TWL6030 USB COMPARATOR
 - compatible : Should be "ti,twl6030-usb"
 - interrupts : Two interrupt numbers to the cpu should be specified. First
   interrupt number is the otg interrupt number that raises ID interrupts when
   the controller has to act as host and the second interrupt number is the
   usb interrupt number that raises VBUS interrupts when the controller has to
   act as device
 - usb-supply : phandle to the regulator device tree node. It should be vusb
   if it is twl6030 or ldousb if it is twl6032 subclass.


TWL6030 USB COMPARATOR
  - compatible : "ti, twl6030-usb"여야합니다.
  - interrupts : CPU에 대한 두 개의 인터럽트 번호를 지정해야합니다. 첫 번째 인터럽트 번호는 컨트롤러가 호스트로 작동해야하는 경우 ID 인터럽트를 발생시키는 두 번째 인터럽트 번호이며 두 번째 인터럽트 번호는 컨트롤러가 장치로 작동해야하는 경우 VBUS 인터럽트를 발생시키는 USB 인터럽트 번호입니다

  - usb-supply : 조절기 장치 트리 노드에 연결합니다. twl6030이면 vusb이거나 twl6032 서브 클래스이면 ldousb 여야합니다.

twl6030-usb {
	compatible = "ti,twl6030-usb";
	interrupts = < 4 10 >;
};

Board specific device node entry
&twl6030-usb {
	usb-supply = <&vusb>;
};

TWL4030 USB PHY AND COMPARATOR
 - compatible : Should be "ti,twl4030-usb"
 - interrupts : The interrupt numbers to the cpu should be specified. First
   interrupt number is the otg interrupt number that raises ID interrupts
   and VBUS interrupts. The second interrupt number is optional.
 - <supply-name>-supply : phandle to the regulator device tree node.
   <supply-name> should be vusb1v5, vusb1v8 and vusb3v1
 - usb_mode : The mode used by the phy to connect to the controller. "1"
   specifies "ULPI" mode and "2" specifies "CEA2011_3PIN" mode.

If a sibling node is compatible "ti,twl4030-bci", then it will find
this device and query it for USB power status.

 - compatible : "ti, twl4030-usb"이어야합니다.
  - interrupts : CPU에 대한 인터럽트 번호를 지정해야합니다. 첫 번째 인터럽트 번호는 ID 인터럽트 및 VBUS 인터럽트를 발생시키는 OTG 인터럽트 번호입니다. 두 번째 인터럽트 번호는 선택 사항입니다.
  - <supply-name> -supply : 조절 장치 트리 노드에 대한 지시.
    <공급 이름>은 vusb1v5, vusb1v8 및 vusb3v1이어야합니다.
  - usb_mode : phy가 컨트롤러에 연결하는 데 사용하는 모드. "1"은 "ULPI"모드를 지정하고 "2"는 "CEA2011_3PIN"모드를 지정합니다.

형제 노드가 "ti, twl4030-bci"와 호환되면이 장치를 찾아서 USB 전원 상태를 쿼리합니다.


twl4030-usb {
	compatible = "ti,twl4030-usb";
	interrupts = < 10 4 >;
	usb1v5-supply = <&vusb1v5>;
	usb1v8-supply = <&vusb1v8>;
	usb3v1-supply = <&vusb3v1>;
	usb_mode = <1>;
};
```

## Doc/DeviceDriver/devicetree/bindings/usb/udc-xilinx.txt
```
Xilinx USB2 device controller

Required properties:
- compatible		: Should be "xlnx,usb2-device-4.00.a"
- reg			: Physical base address and size of the USB2
			  device registers map.
- interrupts		: Should contain single irq line of USB2 device
			  controller
- xlnx,has-builtin-dma	: if DMA is included

필수 속성 :
- compatible : "xlnx, usb2-device-4.00.a"여야합니다.
- reg : 물리적 인 기본 주소와 USB2 장치 레지스터 맵의 크기.
- 인터럽트 : USB2 장치 컨트롤러의 단일 irq 라인을 포함해야합니다.
- xlnx, has-builtin-dma : DMA가 포함 된 경우


Example:
 		axi-usb2-device@42e00000 {
                        compatible = "xlnx,usb2-device-4.00.a";
                        interrupts = <0x0 0x39 0x1>;
                        reg = <0x42e00000 0x10000>;
                        xlnx,has-builtin-dma;
                };
```

## Doc/DeviceDriver/devicetree/bindings/usb/usb-ehci.txt
```
USB EHCI controllers

Required properties:
  - compatible : should be "generic-ehci".
  - reg : should contain at least address and length of the standard EHCI
    register set for the device. Optional platform-dependent registers
    (debug-port or other) can be also specified here, but only after
    definition of standard EHCI registers.
  - interrupts : one EHCI interrupt should be described here.

필수 속성 :
   - compatible : "generic-ehci"여야합니다.
   - reg : 적어도 장치의 표준 EHCI 레지스터 세트의 주소와 길이를 포함해야합니다. 선택적인 플랫폼 종속 
	레지스터 (디버그 포트 또는 기타)도 여기에 지정할 수 있지만 표준 EHCI 레지스터 정의 	후	에 만 지정할 수 있습니다.

   - interrupts : 여기서 하나의 EHCI 인터럽트를 설명해야합니다.



Optional properties:
 - big-endian-regs : boolean, set this for hcds with big-endian registers
 - big-endian-desc : boolean, set this for hcds with big-endian descriptors
 - big-endian : boolean, for hcds with big-endian-regs + big-endian-desc
 - needs-reset-on-resume : boolean, set this to force EHCI reset after resume
 - has-transaction-translator : boolean, set this if EHCI have a Transaction
				Translator built into the root hub.
 - clocks : a list of phandle + clock specifier pairs
 - phys : phandle + phy specifier pair
 - phy-names : "usb"
 - resets : phandle + reset specifier pair

선택적 속성 :
  - big-endian-regs : 부울 값, 빅 엔디안 레지스터가있는 hcds로 설정합니다.
  - big-endian-desc : 부울 값, big-endian 설명자가있는 hcds로 설정합니다.
  - big-endian : big-endian-regs + big-endian-desc가있는 hcds의 경우 boolean입니다.
  - needs-reset-on-resume : 부울 값,이 값을 설정하면 다시 시작한 후 EHCI가 재설정됩니다.
  - has-transaction-translator : boolean, EHCI가 루트 허브에 트랜잭션 트랜 슬레이터를 내장하고 있다면 이것을 설정하십시오.
  - clocks : phandle + clock specifier pairs
  - phys : phandle + phy specifier pair
  - phy-names : "usb"
  - resets  : phandle + reset specifier pair


Example (Sequoia 440EPx):
    ehci@e0000300 {
	   compatible = "ibm,usb-ehci-440epx", "usb-ehci";
	   interrupt-parent = <&UIC0>;
	   interrupts = <1a 4>;
	   reg = <0 e0000300 90 0 e0000390 70>;
	   big-endian;
   };

Example (Allwinner sun4i A10 SoC):
   ehci0: usb@01c14000 {
	   compatible = "allwinner,sun4i-a10-ehci", "generic-ehci";
	   reg = <0x01c14000 0x100>;
	   interrupts = <39>;
	   clocks = <&ahb_gates 1>;
	   phys = <&usbphy 1>;
	   phy-names = "usb";
   };
```

## Doc/DeviceDriver/devicetree/bindings/usb/usb-nop-xceiv.txt
```
USB NOP PHY

Required properties:
- compatible: should be usb-nop-xceiv

Optional properties:
- clocks: phandle to the PHY clock. Use as per Documentation/devicetree
  /bindings/clock/clock-bindings.txt
  This property is required if clock-frequency is specified.

- clock-names: Should be "main_clk"

- clock-frequency: the clock frequency (in Hz) that the PHY clock must
  be configured to.

- vcc-supply: phandle to the regulator that provides power to the PHY.

- reset-gpios: Should specify the GPIO for reset.

- vbus-detect-gpio: should specify the GPIO detecting a VBus insertion
                    (see Documentation/devicetree/bindings/gpio/gpio.txt)
- vbus-regulator : should specifiy the regulator supplying current drawn from
  the VBus line (see Documentation/devicetree/bindings/regulator/regulator.txt).


필수 속성 :
- 호환 가능 : usb-nop-xceiv 여야합니다.

선택적 속성 :
- 클럭 : PHY 클럭에 연결합니다. Documentation / devicetree /bindings/clock/clock-bindings.txt에 따라 사용하십시오.
   이 속성은 clock-frequency가 지정된 경우 필요합니다.

- clock-names : "main_clk"이어야합니다.

- 클럭 주파수 : PHY 클럭을 구성해야하는 클럭 주파수 (Hz)입니다.

- vcc-supply : PHY에 전력을 공급하는 regulator에 위약하십시오.

- reset-gpios : 재설정을 위해 GPIO를 지정해야합니다.

- vbus-detect-gpio : VBus 삽입을 감지하는 GPIO를 지정해야합니다.
                     (Documentation / devicetree / bindings / gpio / gpio.txt 참조)
- vbus-regulator : VBus 라인에서 끌어온 전류를 공급하는 regulator를 지정해야합니다 (Documentation / devicetree / bindings / regulator / regulator.txt 참조).



Example:

	hsusb1_phy {
		compatible = "usb-nop-xceiv";
		clock-frequency = <19200000>;
		clocks = <&osc 0>;
		clock-names = "main_clk";
		vcc-supply = <&hsusb1_vcc_regulator>;
		reset-gpios = <&gpio1 7 GPIO_ACTIVE_LOW>;
		vbus-detect-gpio = <&gpio2 13 GPIO_ACTIVE_HIGH>;
		vbus-regulator = <&vbus_regulator>;
	};

hsusb1_phy is a NOP USB PHY device that gets its clock from an oscillator
and expects that clock to be configured to 19.2MHz by the NOP PHY driver.
hsusb1_vcc_regulator provides power to the PHY and GPIO 7 controls RESET.
GPIO 13 detects VBus insertion, and accordingly notifies the vbus-regulator.

hsusb1_phy는 NOP USB PHY 디바이스로, 발진기에서 클록을 가져오고 NOP PHY 드라이버가 클럭을 19.2MHz로 구성 할 것을 기대합니다.
hsusb1_vcc_regulator는 PHY에 전력을 공급하고 GPIO 7은 RESET을 제어합니다.
GPIO (13)는 VBus 삽입을 검출하고, 그에 따라 vbus- regulator에 통지한다.
```

## Doc/DeviceDriver/devicetree/bindings/usb/usb-ohci.txt
```
USB OHCI controllers

Required properties:
- compatible : "generic-ohci"
- reg : ohci controller register range (address and length)
- interrupts : ohci controller interrupt

Optional properties:
- big-endian-regs : boolean, set this for hcds with big-endian registers
- big-endian-desc : boolean, set this for hcds with big-endian descriptors
- big-endian : boolean, for hcds with big-endian-regs + big-endian-desc
- no-big-frame-no : boolean, set if frame_no lives in bits [15:0] of HCCA
- num-ports : u32, to override the detected port count
- clocks : a list of phandle + clock specifier pairs
- phys : phandle + phy specifier pair
- phy-names : "usb"
- resets : phandle + reset specifier pair

필수 속성 :
-  compatible : "generic-ohci"
- reg : ohci 컨트롤러 레지스터 범위 (주소 및 길이)
- 인터럽트 : ohci 컨트롤러 인터럽트

선택적 속성 :
- big-endian-regs : 부울 값, 빅 엔디안 레지스터가있는 hcds로 설정합니다.
- big-endian-desc : 부울 값, big-endian 설명자가있는 hcds로 설정합니다.
- big-endian : big-endian-regs + big-endian-desc가있는 hcds의 경우 boolean입니다.
- no-big-frame-no : 부울 값, frame_no가 HCCA의 비트 [15 : 0]에있는 경우 설정합니다.
- num-ports : u32 - 감지 된 포트 수를 무시합니다.
- clocks : phandle + clock specifier 쌍 목록
- phys : phandle + phy specifier 쌍
- phy-names : "usb"
- 재설정 : phandle + 재설정 specifier 쌍


Example:

	ohci0: usb@01c14400 {
		compatible = "allwinner,sun4i-a10-ohci", "generic-ohci";
		reg = <0x01c14400 0x100>;
		interrupts = <64>;
		clocks = <&usb_clk 6>, <&ahb_gates 2>;
		phys = <&usbphy 1>;
		phy-names = "usb";
	};
```

## Doc/DeviceDriver/devicetree/bindings/usb/usb-xhci.txt
```
USB xHCI controllers

Required properties:
  - compatible: should be one of "generic-xhci",
    "marvell,armada-375-xhci", "marvell,armada-380-xhci",
    "renesas,xhci-r8a7790", "renesas,xhci-r8a7791" (deprecated:
    "xhci-platform").
  - reg: should contain address and length of the standard XHCI
    register set for the device.
  - interrupts: one XHCI interrupt should be described here.

Optional properties:
  - clocks: reference to a clock
  - usb3-lpm-capable: determines if platform is USB3 LPM capable

필수 속성 :
   - compatible : "generic-xhci"중 하나 여야합니다.
     "marvell, armada-375-xhci", "marvell, armada-380-xhci",
     "renesas, xhci-r8a7790", "renesas, xhci-r8a7791"(더 이상 사용되지 않는 "xhci-platform").
   - reg : 장치에 설정된 표준 XHCI 레지스터의 주소와 길이를 포함해야합니다.
   - 인터럽트 : 하나의 XHCI 인터럽트를 여기서 설명해야합니다.

선택적 속성 :
   - 클럭 : 클럭에 대한 참조
   - usb3-lpm-capable : 플랫폼이 USB3 LPM 가능 여부를 결정합니다.

Example:
	usb@f0931000 {
		compatible = "generic-xhci";
		reg = <0xf0931000 0x8c8>;
		interrupts = <0x0 0x4e 0x0>;
	};
```

## Doc/DeviceDriver/devicetree/bindings/usb/usb3503.txt
```
SMSC USB3503 High-Speed Hub Controller

Required properties:
- compatible: Should be "smsc,usb3503" or "smsc,usb3503a".

Optional properties:
- reg: Specifies the i2c slave address, it is required and should be 0x08
       if I2C is used.
- connect-gpios: Should specify GPIO for connect.
- disabled-ports: Should specify the ports unused.
	'1' or '2' or '3' are available for this property to describe the port
	number. 1~3 property values are possible to be described.
	Do not describe this property if all ports have to be enabled.
- intn-gpios: Should specify GPIO for interrupt.
- reset-gpios: Should specify GPIO for reset.
- initial-mode: Should specify initial mode.
                (1 for HUB mode, 2 for STANDBY mode)
- refclk: Clock used for driving REFCLK signal (optional, if not provided
	the driver assumes that clock signal is always available, its
	rate is specified by REF_SEL pins and a value from the primary
	reference clock frequencies table is used)
- refclk-frequency: Frequency of the REFCLK signal as defined by REF_SEL
	pins (optional, if not provided, driver will not set rate of the
	REFCLK signal and assume that a value from the primary reference
	clock frequencies table is used)

필수 속성 :
- compatible : "smsc, usb3503"또는 "smsc, usb3503a"여야합니다.

선택적 속성 :
- reg : I2C 슬레이브 주소를 지정합니다. I2C가 사용되는 경우 필요하며 0x08이어야합니다.
- connect-gpios : 연결할 GPIO를 지정해야합니다.
- disabled-ports : 사용되지 않는 포트를 지정해야합니다.
이 등록 정보에서 포트 번호를 설명하는 데 '1'또는 '2'또는 '3'을 사용할 수 있습니다. 1 ~ 3 개의 속성 값을 기술 할 수 있습니다.
모든 포트를 활성화해야하는 경우이 속성을 사용하지 마십시오.
- intn-gpios : 인터럽트에 대해 GPIO를 지정해야합니다.
- reset-gpios : 재설정을 위해 GPIO를 지정해야합니다.
- 초기 모드 : 초기 모드를 지정해야합니다.
                 (HUB 모드의 경우 1, STANDBY 모드의 경우 2)
- refclk : REFCLK 신호를 구동하는 데 사용되는 클록 (옵션, 클럭 신호가 항상 사용 가능하고 해당 속도가 REF_SEL 핀에 의해 지정되고 기본 참조 클럭 주파수 표의 값이 사용되는 경우 드라이버가 제공되지 않는 경우 선택적)

- refclk-frequency : REF_SEL 핀으로 정의 된 REFCLK 신호의 주파수 (옵션으로 제공되지 않는 경우 드라이버는 REFCLK 신호의 속도를 설정하지 않고 기본 참조 클럭 주파수 표의 값이 사용된다고 가정 함)


Examples:
	usb3503@08 {
		compatible = "smsc,usb3503";
		reg = <0x08>;
		connect-gpios = <&gpx3 0 1>;
		disabled-ports = <2 3>;
		intn-gpios = <&gpx3 4 1>;
		reset-gpios = <&gpx3 5 1>;
		initial-mode = <1>;
	};
```
