## Doc/DeviceDriver/devicetree/bindings/misc/ifm-csi.txt
```
IFM camera sensor interface on mpc5200 LocalPlus bus

Required properties:
- compatible: "ifm,o2d-csi"
- reg: specifies sensor chip select number and associated address range
- interrupts: external interrupt line number and interrupt sense mode
  of the interrupt line signaling frame valid events
- gpios: three gpio-specifiers for "capture", "reset" and "master enable"
  GPIOs (strictly in this order).
- ifm,csi-clk-handle: the phandle to a node in the DT describing the sensor
  clock generator. This node is usually a general purpose timer controller.
- ifm,csi-addr-bus-width: address bus width (valid values are 16, 24, 25)
- ifm,csi-data-bus-width: data bus width (valid values are 8 and 16)
- ifm,csi-wait-cycles: sensor bus wait cycles

Optional properties:
- ifm,csi-byte-swap: if this property is present, the byte swapping on
  the bus will be enabled.

mpc5200 LocalPlus 버스의 IFM 카메라 센서 인터페이스

필수 속성 :
- 호환 : "ifm, o2d-csi"
- reg : 센서 칩 선택 번호와 관련 주소 범위 지정 - 인터럽트 : 인터럽트 라인의 인터럽트 감지 번호 및 인터럽트 라인의 인터럽트 감지 모드 유효 신호 - gpios : "capture", "reset"및 "master enable"에 대한 3 개의 gpio 지정자(엄격하게이 순서대로).
- ifm, csi-clk-handle : 센서 클럭 생성기를 설명하는 DT의 노드에 대한 phandle입니다. 이 노드는 일반적으로 범용 타이머 컨트롤러입니다.
- ifm, csi-addr-bus-width : 주소 버스 폭 (유효한 값은 16, 24, 25 임)
- ifm, csi-data-bus-width : 데이터 버스 폭 (유효한 값은 8 및 16 임)
- ifm, csi-wait-cycles : 센서 버스 대기 사이클

선택적 속성 :
- ifm, csi-byte-swap :이 속성이 있으면 버스에서 바이트 스와핑이 활성화됩니다.


Example:

	csi@3,0 {
		compatible = "ifm,o2d-csi";
		reg = <3 0 0x00100000>;		/* CS 3, 1 MiB range */
									/ * CS 3, 1 MiB 범위 * /

		interrupts = <1 1 2>;		/* IRQ1, edge falling */

		ifm,csi-clk-handle = <&timer7>;
		gpios = <&gpio_simple 23 0	/* image_capture */
			 &gpio_simple 26 0	/* image_reset */
			 &gpio_simple 29 0>;	/* image_master_en */

		ifm,csi-addr-bus-width = <24>;
		ifm,csi-data-bus-width = <8>;
		ifm,csi-wait-cycles = <0>;
	};

The base address of the used chip select is specified in the
ranges property of the parent localbus node, for example:

	ranges = <0 0 0xff000000 0x01000000
		  3 0 0xe3000000 0x00100000>;

사용 된 칩 선택의 기본 주소는 상위 로컬 버스 노드의 ranges 속성에 지정됩니다 (예 :

범위 = <0 0 0xff000000 0x01000000
3 0 0xe3000000 0x00100000>;
```

## Doc/DeviceDriver/devicetree/bindings/misc/keystone-debugss.txt
```
Texas Instruments Debug Sub-System (DebugSS) module for Keystone devices

Required properties:
- compatible : Should be "ti,keystone-debugss"

Optional properties:
- clocks : the clocks feeding the Debug sub-system.
	   As an exception, the mainpllclk and
	   armpllclk are not directly feeding
	   the debugss, instead they are used
	   by the debugss module to expose the
	   mainpll and armpll clock rates as
	   sysfs entries readable from userspace
	   applications.
	   Needed if platform uses clocks.
	   See clock-bindings.txt
- clocks-names : clock name strings correspond to the clocks
		 defined above. These strings are used inside
		 module source code to identify the respective clocks

키스톤 장치 용 Texas Instruments 디버그 서브 시스템 (DebugSS) 모듈

필수 속성 :
- compatible : "ti, keystone-debugss"여야합니다.

선택적 속성 :
- clocks : Debug 서브 시스템에 공급되는 clocks.
예외적으로 mainpllclk와 armpllclk는 debugss를 직접 공급하지 않고 대신 debugss 모듈에서 mainpll 및 armpll 클럭 속도를 userspace 응용 프로그램에서 읽을 수있는 sysfs 항목으로 사용합니다.

플랫폼에서 clocks를 사용하는 경우 필요합니다.

clock-bindings.txt를 참조하십시오.

- clocks-names : clocks-names 문자열은 위에 정의 된 clocks에 해당합니다. 이 문자열은 모듈 소스 코드 내에서 각각의 clocks을 식별하는 데 사용됩니다



Documentation:
http://www.ti.com/lit/ug/spruhm4/spruhm4.pdf
http://www.ti.com/lit/ds/symlink/tci6636k2h.pdf

Examples:

debugss: debugss {
        compatible = "ti,keystone-debugss";
        clocks = <&mainpllclk>, <&armpllclk>, <&clkdebugsstrc>, <&gemtraceclk>, <&clktetbtrc>;
        clock-names = "mainpllclock", "armpllclock", "debugssclock", "gemtraceclock", "tetbclock";
};
```

## Doc/DeviceDriver/devicetree/bindings/misc/nvidia,tegra20-apbmisc.txt
```
NVIDIA Tegra20/Tegra30/Tegr114/Tegra124 apbmisc block

Required properties:
- compatible : For Tegra20, must be "nvidia,tegra20-apbmisc".  For Tegra30,
  must be "nvidia,tegra30-apbmisc".  Otherwise, must contain
  "nvidia,<chip>-apbmisc", plus one of the above, where <chip> is tegra114,
  tegra124, tegra132.
- reg: Should contain 2 entries: the first entry gives the physical address
       and length of the registers which contain revision and debug features.
       The second entry gives the physical address and length of the
       registers indicating the strapping options.

Optional properties:
- nvidia,long-ram-code: If present, the RAM code is long (4 bit). If not, short (2 bit).



NVIDIA Tegra20 / Tegra30 / Tegr114 / Tegra124 apbmisc 블록

필수 속성 :
- compatible : Tegra20의 경우 "nvidia, tegra20-apbmisc"여야합니다. Tegra30의 경우 "nvidia, tegra30-apbmisc"여야합니다. 그렇지 않으면 "nvidia, <chip> -apbmisc"와 위의 하나를 포함해야합니다. 여기서 <chip>은 tegra114, tegra124, tegra132입니다.

- reg : 2 개의 엔트리를 포함해야한다 : 첫번째 엔트리는 revision과 ebug 기능을 포함하는 레지스터의 물리적 주소와 길이를 제공한다.
        두 번째 항목은 스트링 옵션을 나타내는 레지스터의 실제 주소와 길이를 제공합니다.

선택적 속성 :
- nvidia, long-ram-code :있는 경우 RAM 코드가 길어집니다 (4 비트). 그렇지 않은 경우, short (2 비트).
```

## Doc/DeviceDriver/devicetree/bindings/misc/sram.txt
```
Generic on-chip SRAM

Simple IO memory regions to be managed by the genalloc API.

Required properties:

- compatible : mmio-sram

- reg : SRAM iomem address range


범용 온칩 SRAM

genalloc API가 관리 할 단순 IO 메모리 영역.

필수 속성 :

- 호환 : mmio-sram

- reg : SRAM 주소 범위



Reserving sram areas:
sram 영역 예약 :
---------------------

Each child of the sram node specifies a region of reserved memory. Each
child node should use a 'reg' property to specify a specific range of
reserved memory.
sram 노드의 각 자식은 예약 된 메모리 영역을 지정합니다. 각 자식 노드는 'reg'속성을 사용하여 예약 된 메모리의 특정 범위를 지정해야합니다.

Following the generic-names recommended practice, node names should
reflect the purpose of the node. Unit address (@<address>) should be
appended to the name.
generic-names 관행에 따라 노드 name은 노드의 목적을 반영해야합니다. 단위 주소 (@ <address>)는 name에 추가해야합니다.


Required properties in the sram node:

- #address-cells, #size-cells : should use the same values as the root node
- ranges : standard definition, should translate from local addresses
           within the sram to bus addresses

Required properties in the area nodes:

- reg : iomem address range, relative to the SRAM range

Optional properties in the area nodes:

- compatible : standard definition, should contain a vendor specific string
               in the form <vendor>,[<device>-]<usage>
- pool : indicates that the particular reserved SRAM area is addressable
         and in use by another device or devices
- export : indicates that the reserved SRAM area may be accessed outside
           of the kernel, e.g. by bootloader or userspace
- label : the name for the reserved partition, if omitted, the label
          is taken from the node name excluding the unit address.
- map-exec : map range to allow code execution
- map-exec-nocache : map range to allow code execution and also non-cached

sram 노드의 필수 등록 정보 :

- # address-cells, # size-cells : 루트 노드와 동일한 값을 사용해야합니다.

- 범위 : 표준 정의, sram 내의 로컬 주소를 버스 주소로 변환해야합니다.

영역 노드의 필수 속성 :

- reg : iomem 주소 범위 (SRAM 범위 기준)

영역 노드의 선택적 속성 :

- compatible : 표준 정의, 공급 업체 특정 문자열을 <vendor>, [<device> -] <usage>

- 풀 (pool) : 특정 예약 된 SRAM 영역이 어드레싱 가능하고 다른 장치 또는 장치들에 의해 사용 중임을 지시 함.

- export : 예약 된 SRAM 영역이 커널 외부에서 액세스 될 수 있음을 나타냅니다. 부트 로더 또는 사용자 공간 별

- label : 예약 된 파티션의 이름. 생략하면 레이블은 장치 주소를 제외한 노드 이름에서 가져옵니다.

- map-exec : 코드 실행을 허용하는 범위 매핑

- map-exec-nocache : 코드 실행 및 캐시되지 않는 범위 매핑





Example:

sram: sram@5c000000 {
	compatible = "mmio-sram";
	reg = <0x5c000000 0x40000>; /* 256 KiB SRAM at address 0x5c000000 */
								/ * 주소 0x5c000000의 256 KiB SRAM * /
								
	#adress-cells = <1>;
	#size-cells = <1>;
	ranges = <0 0x5c000000 0x40000>;

	smp-sram@100 {
		compatible = "socvendor,smp-sram";
		reg = <0x100 0x50>;
	};

	device-sram@1000 {
		reg = <0x1000 0x1000>;
		pool;
	};

	exported@20000 {
		reg = <0x20000 0x20000>;
		export;
	};
};
```

## Doc/DeviceDriver/devicetree/bindings/nvmen/allwinner,sunxi-sid.txt
```
Allwinner sunxi-sid

Required properties:
- compatible: "allwinner,sun4i-a10-sid" or "allwinner,sun7i-a20-sid"
- reg: Should contain registers location and length

= Data cells =
Are child nodes of qfprom, bindings of which as described in
bindings/nvmem/nvmem.txt

필수 속성 :
- 호환 : "allwinner, sun4i-a10-sid"또는 "allwinner, sun7i-a20-sid"
- reg : 레지스터 위치와 길이를 포함해야합니다.

= 데이터 셀 =
qfprom의 자식 노드는 다음과 같이 바인딩됩니다.
bindings / nvmem / nvmem.txt


Example for sun4i:
	sid@01c23800 {
		compatible = "allwinner,sun4i-a10-sid";
		reg = <0x01c23800 0x10>
	};

Example for sun7i:
	sid@01c23800 {
		compatible = "allwinner,sun7i-a20-sid";
		reg = <0x01c23800 0x200>
	};
```

## Doc/DeviceDriver/devicetree/bindings/nvmen/imx-ocotp.txt
```
Freescale i.MX6 On-Chip OTP Controller (OCOTP) device tree bindings

This binding represents the on-chip eFuse OTP controller found on
i.MX6Q/D, i.MX6DL/S, i.MX6SL, and i.MX6SX SoCs.

Required properties:
- compatible: should be one of
	"fsl,imx6q-ocotp" (i.MX6Q/D/DL/S),
	"fsl,imx6sl-ocotp" (i.MX6SL), or
	"fsl,imx6sx-ocotp" (i.MX6SX), followed by "syscon".
- reg: Should contain the register base and length.
- clocks: Should contain a phandle pointing to the gated peripheral clock.


이 바인딩은 i.MX6Q / D, i.MX6DL / S, i.MX6SL 및 i.MX6SX SoC에있는 온칩 eFuse OTP 컨트롤러를 나타냅니다.

필수 속성 :
- 호환 가능 : 다음 중 하나 여야합니다.
"fsl, imx6q-ocotp"(i.MX6Q / D / DL / S)
"fsl, imx6sl-ocotp"(i.MX6SL) 또는
"fsl, imx6sx-ocotp"(i.MX6SX) 다음에 "syscon"이옵니다.
- reg : 레지스터 기본과 길이를 포함해야합니다.
- clocks : 게이트 된 주변 장치 클럭을 가리키는 phandle을 포함해야합니다.

Example:

	ocotp: ocotp@021bc000 {
		compatible = "fsl,imx6q-ocotp", "syscon";
		reg = <0x021bc000 0x4000>;
		clocks = <&clks IMX6QDL_CLK_IIM>;
	};
```

## Doc/DeviceDriver/devicetree/bindings/nvmen/mxs-ocotp.txt
```
On-Chip OTP Memory for Freescale i.MX23/i.MX28

Required properties :
- compatible :
  - "fsl,imx23-ocotp" for i.MX23
  - "fsl,imx28-ocotp" for i.MX28
- #address-cells : Should be 1
- #size-cells : Should be 1
- reg : Address and length of OTP controller registers
- clocks : Should contain a reference to the hbus clock

= Data cells =
Are child nodes of mxs-ocotp, bindings of which as described in
bindings/nvmem/nvmem.txt

필수 속성 :
- 호환 가능 :
   - i.MX23의 경우 "fsl, imx23-ocotp"
   - i.MX28의 경우 "fsl, imx28-ocotp"
- # 주소 - 셀 : 1이어야합니다.
- # 크기 - 셀 : 1이어야합니다.
- reg : OTP 제어기 레지스터의 주소와 길이
- clocks : hbus clocks에 대한 참조를 포함해야합니다.

= 데이터 셀 =
bindings / nvmem / nvmem.txt에 설명 된 것과 같은 바인딩 인 mxs-ocotp의 자식 노드이다.



Example for i.MX28:

	ocotp: ocotp@8002c000 {
		compatible = "fsl,imx28-ocotp", "fsl,ocotp";
		#address-cells = <1>;
		#size-cells = <1>;
		reg = <0x8002c000 0x2000>;
		clocks = <&clks 25>;
		status = "okay";
	};
```

## Doc/DeviceDriver/devicetree/bindings/nvmen/nvmem.txt
```
= NVMEM(Non Volatile Memory) Data Device Tree Bindings =

This binding is intended to represent the location of hardware
configuration data stored in NVMEMs like eeprom, efuses and so on.

On a significant proportion of boards, the manufacturer has stored
some data on NVMEM, for the OS to be able to retrieve these information
and act upon it. Obviously, the OS has to know about where to retrieve
these data from, and where they are stored on the storage device.

This document is here to document this.

= NVMEM (비 휘발성 메모리) 데이터 장치 트리 바인딩 =

이 바인딩은 eeprom, efuse 등과 같은 NVMEM에 저장된 하드웨어 구성 데이터의 위치를 나타 내기위한 것입니다.

보드의 상당 부분에서 제조업체는 NVMEM에 일부 데이터를 저장하여 운영 체제에서 이러한 정보를 검색하고 이에 대한 조치를 취할 수 있습니다. 분명히, 운영 체제는 이러한 데이터를 어디서 검색 할 것인지, 저장 장치에 저장되는 위치를 알아야합니다.

이 문서는 이것을 문서화하기위한 것입니다.


= Data providers =
Contains bindings specific to provider drivers and data cells as children
of this node.

Optional properties:
 read-only: Mark the provider as read only.

= Data cells =
These are the child nodes of the provider which contain data cell
information like offset and size in nvmem provider.

Required properties:
reg:	specifies the offset in byte within the storage device.

= 데이터 제공 업체 =
이 노드의 자식으로 공급자 드라이버 및 데이터 셀에 특정한 바인딩을 포함합니다.

선택적 속성 :
  읽기 전용 : 제공자를 읽기 전용으로 표시하십시오.

= 데이터 셀 =
이들은 nvmem 제공자의 오프셋 및 크기와 같은 데이터 셀 정보를 포함하는 공급자의 하위 노드입니다.

필수 속성 :
reg : 저장 장치 내의 바이트 단위 오프셋을 지정합니다.

Optional properties:
선택적 속성 :

bits:	Is pair of bit location and number of bits, which specifies offset
	in bit and number of bits within the address range specified by reg property.
	Offset takes values from 0-7.
비트 : 비트 위치 쌍과 비트 수로, reg 속성으로 지정된 주소 범위 내의 비트 수와 비트 수를 지정합니다. 오프셋은 0-7의 값을 취합니다.


For example:

	/* Provider */
	qfprom: qfprom@00700000 {
		...

		/* Data cells */
		tsens_calibration: calib@404 {
			reg = <0x404 0x10>;
		};

		tsens_calibration_bckp: calib_bckp@504 {
			reg = <0x504 0x11>;
			bits = <6 128>
		};

		pvs_version: pvs-version@6 {
			reg = <0x6 0x2>
			bits = <7 2>
		};

		speed_bin: speed-bin@c{
			reg = <0xc 0x1>;
			bits = <2 3>;

		};
		...
	};

= Data consumers =
Are device nodes which consume nvmem data cells/providers.

Required-properties:
nvmem-cells: list of phandle to the nvmem data cells.
nvmem-cell-names: names for the each nvmem-cells specified. Required if
	nvmem-cells is used.

Optional-properties:
nvmem	: list of phandles to nvmem providers.
nvmem-names: names for the each nvmem provider. required if nvmem is used.

For example:

	tsens {
		...
		nvmem-cells = <&tsens_calibration>;
		nvmem-cell-names = "calibration";
	};


	= 데이터 소비자 =
nvmem 데이터 셀 / 공급자를 소비하는 장치 노드입니다.

필수 속성 :
nvmem-cells : nvmem 데이터 셀에 대한 phandle 목록입니다.
nvmem-cell-names : 지정된 각 nvmem-cells의 이름입니다. nvmem-cells이 사용되는 경우 필요합니다.

선택적 속성 :
nvmem : nvmem 제공자에 대한 phandles 목록입니다.
nvmem-names : 각 nvmem 제공자의 이름입니다. nvmem이 사용될 경우 필요합니다.

예 :

tsens {
...
nvmem-cells = <& tsens_calibration>;
nvmem-cell-names = "calibration";
};
```

## Doc/DeviceDriver/devicetree/bindings/nvmen/qfprom.txt
```
= Qualcomm QFPROM device tree bindings =

This binding is intended to represent QFPROM which is found in most QCOM SOCs.

Required properties:
- compatible: should be "qcom,qfprom"
- reg: Should contain registers location and length

= Data cells =
Are child nodes of qfprom, bindings of which as described in
bindings/nvmem/nvmem.txt

= Qualcomm QFPROM 장치 트리 바인딩 =

이 바인딩은 대부분의 QCOM SOC에있는 QFPROM을 나타 내기위한 것입니다.

필수 속성 :
- 호환 가능 : "qcom, qfprom"이어야합니다.
- reg : 레지스터 위치와 길이를 포함해야합니다.

= 데이터 셀 =
qfprom의 자식 노드는 bindings / nvmem / nvmem.txt에 설명 된 것과 같은 바인딩입니다.



Example:

	qfprom: qfprom@00700000 {
		compatible 	= "qcom,qfprom";
		reg		= <0x00700000 0x8000>;
		...
		/* Data cells */
		tsens_calibration: calib@404 {
			reg = <0x4404 0x10>;
		};
	};


= Data consumers =
Are device nodes which consume nvmem data cells.
= 데이터 소비자 =
nvmem 데이터 셀을 소비하는 장치 노드입니다.

For example:

	tsens {
		...
		nvmem-cells = <&tsens_calibration>;
		nvmem-cell-names = "calibration";
	};
```

## Doc/DeviceDriver/devicetree/bindings/nvmen/rockchip-efuse.txt
```
= Rockchip eFuse device tree bindings =

Required properties:
- compatible: Should be "rockchip,rockchip-efuse"
- reg: Should contain the registers location and exact eFuse size
- clocks: Should be the clock id of eFuse
- clock-names: Should be "pclk_efuse"

= Data cells =
Are child nodes of eFuse, bindings of which as described in
bindings/nvmem/nvmem.txt

= Rockchip eFuse 장치 트리 바인딩 =

필수 속성 :
- 호환 : "rockchip, rockchip-efuse"이어야합니다.
- reg : 레지스터 위치와 정확한 eFuse 크기를 포함해야합니다.
- clocks : eFuse의 clock ID 여야합니다.
- clock-names : "pclk_efuse"여야합니다.

= 데이터 셀 =
bindings / nvmem / nvmem.txt에 설명되어있는 바인딩 eFuse의 자식 노드입니다.

Example:

	efuse: efuse@ffb40000 {
		compatible = "rockchip,rockchip-efuse";
		reg = <0xffb40000 0x20>;
		#address-cells = <1>;
		#size-cells = <1>;
		clocks = <&cru PCLK_EFUSE256>;
		clock-names = "pclk_efuse";

		/* Data cells */
		cpu_leakage: cpu_leakage {
			reg = <0x17 0x1>;
		};
	};

= Data consumers =
Are device nodes which consume nvmem data cells.

= 데이터 소비자 =
nvmem 데이터 셀을 소비하는 장치 노드입니다.

Example:

	cpu_leakage {
		...
		nvmem-cells = <&cpu_leakage>;
		nvmem-cell-names = "cpu_leakage";
	};
```
