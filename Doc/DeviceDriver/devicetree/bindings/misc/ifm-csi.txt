## Doc/DeviceDriver/devicetree/bindings/nvmen/vf610-ocotp.txt
```
On-Chip OTP Memory for Freescale Vybrid

Required Properties:
  compatible:
  - "fsl,vf610-ocotp" for VF5xx/VF6xx
  #address-cells : Should be 1
  #size-cells : Should be 1
  reg : Address and length of OTP controller and fuse map registers
  clocks : ipg clock we associate with the OCOTP peripheral

프리 스케일 Vybrid 용 온칩 OTP 메모리

필수 등록 정보 :
   호환 가능 :
   - VF5xx / VF6xx의 경우 "fsl, vf610-ocotp"
   # 주소 - 셀 : 1이어야합니다.
   # 크기 - 셀 : 1이어야합니다.
   reg : OTP 컨트롤러 및 퓨즈 맵 레지스터의 주소 및 길이
   clocks : 우리가 OCOTP 주변 장치와 연관시키는 ipg clock


Example for Vybrid VF5xx/VF6xx:

	ocotp: ocotp@400a5000 {
		compatible = "fsl,vf610-ocotp";
		#address-cells = <1>;
		#size-cells = <1>;
		reg = <0x400a5000 0xCF0>;
		clocks = <&clks VF610_CLK_OCOTP>;
	};
```
