## Doc/DeviceDriver/devicetree/bindings/opp/ti-omap5-opp-domain.txt
```
Texas Instruments OMAP compatible OPP domain description
TI OMAP 호환 OPP 도메인 설명

This binding uses the "<supply-name>-opp-domain" binding documented at [1]
and describes the OPP domain devices typically used on Texas Instruments
OMAP compatible SoC family of processors.
이 바인딩은 [1]에 문서화 된 "<supply-name> -opp-domain"바인딩을 사용하고 Texas Instruments OMAP 호환 SoC 프로세서 제품군에서 일반적으로 사용되는 OPP 도메인 디바이스를 설명합니다.

OMAP5, DRA7, and AM57 family of SoCs have Class0 AVS eFuse registers which
contain data that can be used to adjust voltages programmed for some of their
supplies for more efficient operation. These are provided to the OPP domain
driver so that when a voltage transition is requested by the OPP core, we can
make an adjustment to the voltage before setting the supply.
SoC의 OMAP5, DRA7 및 AM57 제품군에는 Class0 AVS eFuse 레지스터가있어 보다 효율적인 작동을 위해 일부 전원에 대해 프로그래밍 된 전압을 조정하는 데 사용할 수있는 데이터가 포함되어 있습니다. OPP 도메인 드라이버에 제공되므로 OPP 코어에서 전압 전이를 요청할 때 전원을 설정하기 전에 전압을 조정할 수 있습니다.

Also, some supplies may have an associated vbb-supply which is an Adaptive Body
Bias regulator which much be transitioned in a specific sequence with regards
to the vdd-supply and clk when making an OPP transition, and this driver handles
that sequencing.
또한, 일부 전원 공급 장치는 vdd 전원 공급 장치와 clk와 관련하여 특정 시퀀스에서 많이 전환되는  Adaptive Body
Bias regulator 인 관련 vbb 공급 장치를 가질 수 있으며 OPP 전환시이 드라이버는 해당 시퀀싱을 처리합니다.

[1] Documentation/devicetree/bindings/opp/opp.txt

Required Properties:
- compatible: Should be one of:
	"ti,omap-oppdm" - basic OPP domain controlling VDD and VBB
	"ti,omap5-oppdm" - OMAP5+ optimized voltages in efuse(class0)VDD
			    along with VBB
	"ti,omap5-core-oppdm" - OMAP5+ optimized voltages in efuse(class0) VDD
			    but no VBB.
- vdd-supply: phandle to regulator controlling VDD supply
- vbb-supply: phandle to regulator controlling Body Bias supply (optional if
  "ti,omap5-core-oppdm")
  (Usually Adaptive Body Bias regulator)
- #oppdm-cells: shall be <0>
- reg: Address and length of the efuse register set for the device (mandatory
	only for "ti,omap5-oppdm")
- ti,efuse-settings: An array of u32 tuple items providing information about
	optimized efuse configuration. Each item consists of the following:
	volt: voltage in uV - reference voltage (OPP voltage)
	efuse_offseet: efuse offset from reg where the optimized voltage is stored.
- ti,absolute-max-voltage-uv: absolute maximum voltage for the OPP domain.

필수 등록 정보 :
- compatible : 다음 중 하나 여야합니다.
"ti, omap-oppdm"- VDD 및 VBB를 제어하는 기본 OPP 도메인
"ti, omap5-oppdm"- VBF와 함께 efuse (class0) VDD에서 OMAP5 + 최적화 전압
"ti, omap5-core-oppdm"- OMAP5 +는 efuse (class0) VDD에서 최적화 된 전압이지만 VBB는 사용하지 않습니다.

- vdd-supply : VDD 공급을 제어하는 레귤레이터에 대한 phandle

- vbb-supply : 바디 바이어스 전원을 제어하는 레귤레이터에 대한 phandle ( "ti, omap5-core-oppdm"옵션 인 경우)
   (보통 적응 형 바디 바이어스 레귤레이터)

- # oppdm-cells : <0>이어야합니다.

- reg : 장치에 설정된 efuse 레지스터의 주소와 길이 ( "ti, omap5-oppdm"에 대해서만 필수)

- ti, efuse-settings : 최적화 된 efuse 구성에 대한 정보를 제공하는 u32 tuple 항목의 배열입니다. 각 항목은 다음으로 구성됩니다.
volt : uV 단위의 전압 - 기준 전압 (OPP 전압) efuse_offseet : 최적화 된 전압이 저장된 reg에서 efuse 오프셋.

- ti, absolute-max-voltage-uv : OPP 도메인의 절대 최대 전압.



Example:

/* Basic OMAP OPP Domain with no Class0 support */
/ * Class0 지원이없는 기본 OMAP OPP 도메인 * /

oppdm_mpu: oppdm@1 {
	compatible = "ti,omap-oppdm";
	#oppdm-cells = <0>;

	vdd-supply = <&vcc>;
	vbb-supply = <&abb_mpu>;
};

/* OMAP OPP Domain with Class0 registers */
/ * Class0 레지스터가있는 OMAP OPP 도메인 * /
oppdm_mpu: oppdm@4a003b20 {
	compatible = "ti,omap5-oppdm";
	#oppdm-cells = <0>;
	vdd-supply = <&vcc>;
	vbb-supply = <&abb_mpu>;
	reg = <0x4a003b20 0x8>;
	ti,efuse-settings = <
	/* uV   offset */
	1060000 0x0
	1160000 0x4
	1210000 0x8
	>;
	ti,absolute-max-voltage-uv = <1500000>;
};

oppdm_core: oppdm@4a003d20 {
	compatible = "ti,omap5-core-oppdm";
	#oppdm-cells = <0>;
	vdd-supply = <&smps4>;
	reg = <0x4a003b20 0x4>;
	ti,efuse-settings = <
	/* uV   offset */
	1060000 0x0
	>;
};
```

## Doc/DeviceDriver/devicetree/bindings/phy/apm-xgene-phy.txt
```
* APM X-Gene 15Gbps Multi-purpose PHY nodes

PHY nodes are defined to describe on-chip 15Gbps Multi-purpose PHY. Each
PHY (pair of lanes) has its own node.

Required properties:
- compatible		: Shall be "apm,xgene-phy".
- reg			: PHY memory resource is the SDS PHY access resource.
- #phy-cells		: Shall be 1 as it expects one argument for setting
			  the mode of the PHY. Possible values are 0 (SATA),
			  1 (SGMII), 2 (PCIe), 3 (USB), and 4 (XFI).

PHY 노드는 온칩 15Gbps 다목적 PHY를 설명하기 위해 정의됩니다. 각 PHY (한 쌍의 레인)에는 자체 노드가 있습니다.

필수 속성 :
- compatible : "apm, xgene-phy"여야합니다.
- reg : PHY 메모리 리소스는 SDS PHY 액세스 리소스입니다.
- # phy-cells : PHY의 모드를 설정하는 데 하나의 인수가 필요하므로 1이됩니다. 가능한 값은 0 (SATA), 1 (SGMII), 2 (PCIe), 3 (USB) 및 4 (XFI)입니다.




Optional properties:
- status		: Shall be "ok" if enabled or "disabled" if disabled.
			  Default is "ok".
- clocks		: Reference to the clock entry.
- apm,tx-eye-tuning	: Manual control to fine tune the capture of the serial
			  bit lines from the automatic calibrated position.
			  Two set of 3-tuple setting for each (up to 3)
			  supported link speed on the host. Range from 0 to
			  127 in unit of one bit period. Default is 10.
- apm,tx-eye-direction	: Eye tuning manual control direction. 0 means sample
			  data earlier than the nominal sampling point. 1 means
			  sample data later than the nominal sampling point.
			  Two set of 3-tuple setting for each (up to 3)
			  supported link speed on the host. Default is 0.
- apm,tx-boost-gain	: Frequency boost AC (LSB 3-bit) and DC (2-bit)
			  gain control. Two set of 3-tuple setting for each
			  (up to 3) supported link speed on the host. Range is
			  between 0 to 31 in unit of dB. Default is 3.
- apm,tx-amplitude	: Amplitude control. Two set of 3-tuple setting for
			  each (up to 3) supported link speed on the host.
			  Range is between 0 to 199500 in unit of uV.
			  Default is 199500 uV.
- apm,tx-pre-cursor1	: 1st pre-cursor emphasis taps control. Two set of
			  3-tuple setting for each (up to 3) supported link
			  speed on the host. Range is 0 to 273000 in unit of
			  uV. Default is 0.
- apm,tx-pre-cursor2	: 2st pre-cursor emphasis taps control. Two set of
			  3-tuple setting for each (up to 3) supported link
			  speed on the host. Range is 0 to 127400 in unit uV.
			  Default is 0x0.
- apm,tx-post-cursor	: Post-cursor emphasis taps control. Two set of
			  3-tuple setting for Gen1, Gen2, and Gen3. Range is
			  between 0 to 0x1f in unit of 18.2mV. Default is 0xf.
- apm,tx-speed		: Tx operating speed. One set of 3-tuple for each
			  supported link speed on the host.
			   0 = 1-2Gbps
			   1 = 2-4Gbps (1st tuple default)
			   2 = 4-8Gbps
			   3 = 8-15Gbps (2nd tuple default)
			   4 = 2.5-4Gbps
			   5 = 4-5Gbps
			   6 = 5-6Gbps
			   7 = 6-16Gbps (3rd tuple default)

NOTE: PHY override parameters are board specific setting.


선택적 속성 :
- status : 사용 가능할 경우 "ok", 사용 불가능할 경우 "disabled"이어야합니다.
기본값은 "ok"입니다.
- clocks : clock entry에 대한 참조.
- apm, tx-eye-tuning : 자동 조정 위치에서 직렬 비트 라인 캡쳐를 미세 조정하는 수동 제어.
호스트에서 지원되는 각 링크 속도 (최대 3)에 대해 3 세트 3 튜플 설정합니다. 1 비트 단위로 0에서 127 범위입니다. 기본값은 10입니다.
- apm, tx-eye-direction : 아이 튜닝 수동 제어 방향. 0은 nominal sampling point 이전의 샘플 데이터를 의미합니다. 1은 nominal sampling point보다 늦은 샘플 데이터를 의미합니다. 호스트에서 지원되는 각 링크 속도에 대해 최대 3 개의 3 튜플 설정의 두 세트 기본값은 0입니다.
- apm, tx-boost-gain : 주파수 부스트 AC (LSB 3 비트) 및 DC (2 비트) 이득 제어. 호스트에서 지원되는 각 링크 속도에 대해 최대 3 개의 3 튜플 설정의 두 세트 범위는 0에서 31 사이의 단위 (dB)입니다. 기본값은 3입니다.
- apm, tx-amplitude : 진폭 제어. 호스트에서 지원되는 각 링크 속도 (최대 3)에 대해 3 세트 3 튜플 설정합니다. 범위는 uV 단위로 0에서 199500 사이입니다. 기본값은 199500 uV입니다.
- apm, tx-pre-cursor1 : 1st pre-cursor emphasis taps control. 호스트에서 지원되는 각 링크 속도 (최대 3)에 대해 3 세트 3 튜플 설정합니다.범위는 uV 단위로 0에서 273000입니다. 기본값은 0입니다.
- apm, tx-pre-cursor2 :2st pre-cursor emphasis taps control. 호스트에서 지원되는 각 링크 속도 (최대 3)에 대해 3 세트 3 튜플 설정합니다. 범위는 uV 단위로 0 ~ 127400입니다.
기본값은 0x0입니다.
- apm, tx-post-cursor : Post-cursor emphasis taps control. Gen1, Gen2 및 Gen3에 대한 두 개의 3 튜플 설정 범위는 0에서 0x1f까지이며, 단위는 18.2mV입니다. 기본값은 0xf입니다.
- apm, tx-speed : Tx 동작 속도. 호스트에서 지원되는 각 링크 속도의 1 세트 3 튜플.
0 = 1-2Gbps
1 = 2-4Gbps (첫 번째 튜플 기본값)
2 = 4-8Gbps
3 = 8-15Gbps (2 번째 튜플 기본값)
4 = 2.5-4Gbps
5 = 4-5Gbps
6 = 5-6Gbps
7 = 6-16Gbps (세 번째 튜플 기본값)

참고 : PHY 무시 매개 변수는 보드 별 설정입니다.




Example:
		phy1: phy@1f21a000 {
			compatible = "apm,xgene-phy";
			reg = <0x0 0x1f21a000 0x0 0x100>;
			#phy-cells = <1>;
			status = "disabled";
		};

		phy2: phy@1f22a000 {
			compatible = "apm,xgene-phy";
			reg = <0x0 0x1f22a000 0x0 0x100>;
			#phy-cells = <1>;
			status = "ok";
		};

		phy3: phy@1f23a000 {
			compatible = "apm,xgene-phy";
			reg = <0x0 0x1f23a000 0x0 0x100>;
			#phy-cells = <1>;
			status = "ok";
		};
```

## Doc/DeviceDriver/devicetree/bindings/phy/berlin-sata-phy.txt
```
Berlin SATA PHY
---------------

Required properties:
- compatible: should be one of
    "marvell,berlin2-sata-phy"
    "marvell,berlin2q-sata-phy"
- address-cells: should be 1
- size-cells: should be 0
- phy-cells: from the generic PHY bindings, must be 1
- reg: address and length of the register
- clocks: reference to the clock entry

Sub-nodes:
Each PHY should be represented as a sub-node.

Sub-nodes required properties:
- reg: the PHY number

동일 속성 :
- compatible : 다음 중 하나 여야합니다.
     "marvell, berlin2-sata-phy"
     "marvell, berlin2q-sata-phy"
- address-cells : 1이어야합니다.
-size-cells : 0이어야합니다.
- phy-cells : 일반 PHY 바인딩에서 1이어야합니다.
- reg : 레지스터의 주소와 길이
- clocks : clock entry에 대한 참조

하위 노드 :
각 PHY는 하위 노드로 표시되어야합니다.

서브 노드 필수 등록 정보 :
- 등록 번호 : PHY 번호



Example:
	sata_phy: phy@f7e900a0 {
		compatible = "marvell,berlin2q-sata-phy";
		reg = <0xf7e900a0 0x200>;
		clocks = <&chip CLKID_SATA>;
		#address-cells = <1>;
		#size-cells = <0>;
		#phy-cells = <1>;

		sata-phy@0 {
			reg = <0>;
		};

		sata-phy@1 {
			reg = <1>;
		};
	};
```

## Doc/DeviceDriver/devicetree/bindings/phy/berlin-usb-phy.txt
```
* Marvell Berlin USB PHY

Required properties:
- compatible: "marvell,berlin2-usb-phy" or "marvell,berlin2cd-usb-phy"
- reg: base address and length of the registers
- #phys-cells: should be 0
- resets: reference to the reset controller

필수 속성 :
- compatible : "marvell, berlin2-usb-phy"또는 "marvell, berlin2cd-usb-phy"
- reg : 레지스터의 기본 주소와 길이
- # phys-cells : 0이어야합니다.
- resets : reset controller에 대한 참조


Example:

	usb-phy@f774000 {
		compatible = "marvell,berlin2-usb-phy";
		reg = <0xf774000 0x128>;
		#phy-cells = <0>;
		resets = <&chip 0x104 14>;
	};
```

## Doc/DeviceDriver/devicetree/bindings/phy/brcm,brcmstb-sata-phy.txt
```
* Broadcom SATA3 PHY for STB

Required properties:
- compatible: should be one or more of
     "brcm,bcm7445-sata-phy"
     "brcm,phy-sata3"
- address-cells: should be 1
- size-cells: should be 0
- reg: register range for the PHY PCB interface
- reg-names: should be "phy"

Sub-nodes:
  Each port's PHY should be represented as a sub-node.

Sub-nodes required properties:
- reg: the PHY number
- phy-cells: generic PHY binding; must be 0
Optional:
- brcm,enable-ssc: use spread spectrum clocking (SSC) on this port

필수 속성 :
- compatible : 다음 중 하나 이상이어야합니다.
      "brcm, bcm7445-sata-phy"
      "brcm, phy-sata3"
- address-cells : 1이어야합니다.
-  size-cells : 0이어야합니다.
- reg : PHY PCB 인터페이스의 레지스터 범위
- reg-names : "phy"여야합니다.

Sub-nodes:
   각 포트의 PHY는 Sub-nodes로 표시되어야합니다.

서브 노드 필수 등록 정보 :
- reg : PHY 번호
- phy-cells : 일반 PHY 바인딩. 0이어야합니다.
Optional:
- brcm, enable-ssc :이 포트에서 SSC (Spread Spectrum Clocking) 사용


Example:

	sata-phy@f0458100 {
		compatible = "brcm,bcm7445-sata-phy", "brcm,phy-sata3";
		reg = <0xf0458100 0x1e00>, <0xf045804c 0x10>;
		reg-names = "phy";
		#address-cells = <1>;
		#size-cells = <0>;

		sata-phy@0 {
			reg = <0>;
			#phy-cells = <0>;
		};

		sata-phy@1 {
			reg = <1>;
			#phy-cells = <0>;
		};
	};
```

## Doc/DeviceDriver/devicetree/bindings/phy/brcm,cygnus-pcie-phy.txt
```
Broadcom Cygnus PCIe PHY

Required properties:
- compatible: must be "brcm,cygnus-pcie-phy"
- reg: base address and length of the PCIe PHY block
- #address-cells: must be 1
- #size-cells: must be 0

Each PCIe PHY should be represented by a child node

Required properties For the child node:
- reg: the PHY ID
0 - PCIe RC 0
1 - PCIe RC 1
- #phy-cells: must be 0


필수 속성 :
- compatible : "brcm, cygnus-pcie-phy"여야합니다.
- reg : PCIe PHY 블록의 기본 주소 및 길이
- # address-cells : 1이어야합니다.
- # size-cells : 0이어야합니다.

각 PCIe PHY는 하위 노드로 나타내야합니다.

필수 속성 자식 노드 :
- reg : PHY ID
0 - PCIe RC 0
1 - PCIe RC 1
- # phy-cells : 0이어야합니다.



Example:
	pcie_phy: phy@0301d0a0 {
		compatible = "brcm,cygnus-pcie-phy";
		reg = <0x0301d0a0 0x14>;

		pcie0_phy: phy@0 {
			reg = <0>;
			#phy-cells = <0>;
		};

		pcie1_phy: phy@1 {
			reg = <1>;
			#phy-cells = <0>;
		};
	};

	/* users of the PCIe phy */
	/ * PCIe phy 사용자 * /

	pcie0: pcie@18012000 {
		...
		...
		phys = <&pcie0_phy>;
		phy-names = "pcie-phy";
	};

	pcie1: pcie@18013000 {
		...
		...
		phys = <pcie1_phy>;
		phy-names = "pcie-phy";
	};
```

## Doc/DeviceDriver/devicetree/bindings/phy/brcm,kona-usb2-phy.txt
```
BROADCOM KONA USB2 PHY

Required properties:
 - compatible: brcm,kona-usb2-phy
 - reg: offset and length of the PHY registers
 - #phy-cells: must be 0
Refer to phy/phy-bindings.txt for the generic PHY binding properties


필수 속성 :
  - compatible : brcm, kona-usb2-phy
  - reg : PHY 레지스터의 오프셋 및 길이
  - # phy-cells : 0이어야합니다.
generic PHY binding 속성은 phy / phy-bindings.txt를 참조하십시오.

Example:

	usbphy: usb-phy@3f130000 {
		compatible = "brcm,kona-usb2-phy";
		reg = <0x3f130000 0x28>;
		#phy-cells = <0>;
	};
```

## Doc/DeviceDriver/devicetree/bindings/phy/calxeda-combophy.txt
```
Calxeda Highbank Combination Phys for SATA

Properties:
- compatible : Should be "calxeda,hb-combophy"
- #phy-cells: Should be 1.
- reg : Address and size for Combination Phy registers.
- phydev: device ID for programming the combophy.

등록 정보 :
- compatible : "calxeda, hb-combophy"여야합니다.
- # phy-cells : 1이어야합니다.
- reg : Combination Phy 레지스터의 주소와 크기.
- phydev : combophy 프로그래밍을위한 장치 ID.


Example:

	combophy5: combo-phy@fff5d000 {
		compatible = "calxeda,hb-combophy";
		#phy-cells = <1>;
		reg = <0xfff5d000 0x1000>;
		phydev = <31>;
	};
```

## Doc/DeviceDriver/devicetree/bindings/phy/dm816x-phy.txt
```
Device tree binding documentation for am816x USB PHY
=========================

Required properties:
- compatible : should be "ti,dm816x-usb-phy"
- reg : offset and length of the PHY register set.
- reg-names : name for the phy registers
- clocks : phandle to the clock
- clock-names : name of the clock
- syscon: phandle for the syscon node to access misc registers
- #phy-cells : from the generic PHY bindings, must be 1


필수 속성 :
- compatible : "ti, dm816x-usb-phy"여야합니다.
- reg : PHY 레지스터 세트의 오프셋 및 길이.
- reg-names : phy 레지스터의 이름
- clocks : clocks에 phandle
- clock-names : the clock의 이름
- syscon : syscon 노드가 misc 레지스터에 액세스하기위한 phandle
- # phy-cells : 일반 PHY 바인딩에서 1이어야합니다.


Example:

usb_phy0: usb-phy@20 {
	compatible = "ti,dm8168-usb-phy";
	reg = <0x20 0x8>;
	reg-names = "phy";
	clocks = <&main_fapll 6>;
	clock-names = "refclk";
	#phy-cells = <0>;
	syscon = <&scm_conf>;
};
```
