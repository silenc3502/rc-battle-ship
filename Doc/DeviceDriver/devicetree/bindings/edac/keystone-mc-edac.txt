## Doc/DeviceDriver/devicetree/bindings/edac/keystone-mc-edac.txt
```
* Keystone DDR3 Memory Controller EDAC device bindings

Keystone MC EDAC node is defined to describe the DDR3 memory controller
ECC error detection hardware. The hardware is capable of auto correcting
1 bit ECC errors. 2 bit ECC errors are uncorrectable and triggers an
interrupt and handled by the edac ecc error driver which currently enables
only interrupt for uncorrectable errors.

The following section describes the EDAC DT node binding.

Required properties:
- compatible		: Shall be "ti,keystone-ddr3-mc-edac"
- reg			: DDR3 MC base address
- interrupts		: ECC error interrupt
- interrupt-parent	: Interrupt controller node

Example:
	ddr3edac {
		compatible = "ti,keystone-ddr3-mc-edac";
		reg = <0x21010000 0x200>;
		interrupts = <GIC_SPI 448 IRQ_TYPE_EDGE_RISING>;
		interrupt-parent = <&gic>;
	};

/*
* Keystone DDR3 메모리 컨트롤러 EDAC 장치 바인딩

Keystone MC EDAC 노드는 DDR3 메모리 컨트롤러 ECC 오류 감지 하드웨어를 설명하기 위해 정의됩니다.

 하드웨어는 1 비트 ECC 오류를 자동으로 수정할 수 있습니다. 

2 비트 ECC 오류는 수정할 수 없으며 인터럽트를 트리거하고 현재 수정할 수없는 오류에 대해 인터럽트만 활성화하는 

edac ecc 오류 드라이버에 의해 처리됩니다.

다음 절에서는 EDAC DT 노드 바인딩에 대해 설명합니다.

필수 속성 :
- 호환 가능 : "ti, keystone-ddr3-mc-edac"
- reg : DDR3 MC 기본 주소
- 인터럽트 : ECC 오류 인터럽트
- interrupt-parent : 컨트롤러 노드를 중단합니다.


Example:
	ddr3edac {
		compatible = "ti,keystone-ddr3-mc-edac";
		reg = <0x21010000 0x200>;
		interrupts = <GIC_SPI 448 IRQ_TYPE_EDGE_RISING>;
		interrupt-parent = <&gic>;
	};

*/
```

## Doc/DeviceDriver/devicetree/bindings/eeprom/at25.txt
```
EEPROMs (SPI) compatible with Atmel at25.

Required properties:
- compatible : "atmel,at25".
- reg : chip select number
- spi-max-frequency : max spi frequency to use
- pagesize : size of the eeprom page
- size : total eeprom size in bytes
- address-width : number of address bits (one of 8, 16, or 24)

Optional properties:
- spi-cpha : SPI shifted clock phase, as per spi-bus bindings.
- spi-cpol : SPI inverse clock polarity, as per spi-bus bindings.
- read-only : this parameter-less property disables writes to the eeprom

Obsolete legacy properties are can be used in place of "size", "pagesize",
"address-width", and "read-only":
- at25,byte-len : total eeprom size in bytes
- at25,addr-mode : addr-mode flags, as defined in include/linux/spi/eeprom.h
- at25,page-size : size of the eeprom page

Additional compatible properties are also allowed.


Atemel at25와 호환되는 EEPROM (SPI).

필수 속성 :
- 호환 : "atmel, at25"
- reg : 칩 선택 번호
- spi-max-frequency : 사용할 최대 spi 주파수
- pagesize : eeprom 페이지의 크기
- 크기 : 총 eeprom 크기 (바이트)
- address-width : 주소 비트 수 (8, 16 또는 24 중 하나)

선택적 속성 :
- spi-cpha : SPI는 SPI 버스 바인딩에 따라 클럭 위상을 쉬프트합니다.
- spi-cpol : SPI 버스의 바인딩 당 SPI 반대로 클럭 극성.
- 읽기 전용 :이 매개 변수가없는 속성은 eeprom에 대한 쓰기를 비활성화합니다.

더 이상 사용되지 않는 레거시 속성은 "size", "pagesize"대신 사용할 수 있습니다.
"address-width"및 "read-only":
- at25, byte-len : 총 eeprom 크기 (바이트)
- at25, addr-mode : include / linux / spi / eeprom.h에 정의 된 addr-mode 플래그
- at25, page-size : eeprom 페이지의 크기

추가로 호환되는 속성도 사용할 수 있습니다.


Example:
	at25@0 {
		compatible = "atmel,at25", "st,m95256";
		reg = <0>
		spi-max-frequency = <5000000>;
		spi-cpha;
		spi-cpol;

		pagesize = <64>;
		size = <32768>;
		address-width = <16>;
	};
```

## Doc/DeviceDriver/devicetree/bindings/eeprom/eeprom.txt
```
EEPROMs (I2C)

Required properties:

  - compatible : should be "<manufacturer>,<type>"
		 If there is no specific driver for <manufacturer>, a generic
		 driver based on <type> is selected. Possible types are:
		 24c00, 24c01, 24c02, 24c04, 24c08, 24c16, 24c32, 24c64,
		 24c128, 24c256, 24c512, 24c1024, spd

  - reg : the I2C address of the EEPROM

Optional properties:

  - pagesize : the length of the pagesize for writing. Please consult the
               manual of your device, that value varies a lot. A wrong value
	       may result in data loss! If not specified, a safety value of
	       '1' is used which will be very slow.

  - read-only: this parameterless property disables writes to the eeprom

필수 속성 :

   - compatible : "<manufacturer>, <type>"이어야합니다. <manufacturer>에 대한 특정 드라이버가 없으면 <type>을 기반으로하는 일반 드라이버가 선택됩니다. 가능한 유형은 다음과 같습니다.
24c00, 24c01, 24c02, 24c04, 24c08, 24c16, 24c32, 24c64,
24c128, 24c256, 24c512, 24c1024, spd

   - reg : EEPROM의 I2C 주소

선택적 속성 :

   - pagesize : 쓰기를위한 페이지 크기의 길이. 장치의 설명서를 참조하십시오. 그 값은 많이 다릅니다. 잘못된 값은 데이터 손실을 초래할 수 있습니다! 지정하지 않으면 '1'의 안전 값이 사용되며 이는 매우 느립니다.

   - 읽기 전용 :이 매개 변수없는 속성은 eeprom에 대한 쓰기를 비활성화합니다.



Example:

eeprom@52 {
	compatible = "atmel,24c32";
	reg = <0x52>;
	pagesize = <32>;
};
```

## Doc/DeviceDriver/devicetree/bindings/extcon/extcon-arizona.txt
```
Cirrus Logic Arizona class audio SoCs

These devices are audio SoCs with extensive digital capabilities and a range
of analogue I/O.

This document lists Extcon specific bindings, see the primary binding document:
  ../mfd/arizona.txt

Optional properties:

  - wlf,hpdet-channel : Headphone detection channel.
    ARIZONA_ACCDET_MODE_HPL or 1 - Headphone detect mode is set to HPDETL
    ARIZONA_ACCDET_MODE_HPR or 2 - Headphone detect mode is set to HPDETR
    If this node is not mentioned or if the value is unknown, then
    headphone detection mode is set to HPDETL.


이 장치는 광범위한 디지털 기능과 다양한 아날로그 I / O를 갖춘 오디오 SoC입니다.

이 문서는 Extcon 특정 바인딩을 나열합니다. 기본 바인딩 문서를 참조하십시오.
   ../mfd/arizona.txt

선택적 속성 :

   - wlf, hpdet-channel : 헤드폰 감지 채널.
     ARIZONA_ACCDET_MODE_HPL 또는 1 - 헤드폰 감지 모드가 HPDETL로 설정됩니다.
     ARIZONA_ACCDET_MODE_HPR 또는 2 - 헤드폰 감지 모드가 HPDETR로 설정됩니다.
     이 노드가 언급되지 않았거나 값이 알려지지 않은 경우 헤드폰 탐지 모드는 HPDETL로 설정됩니다.
```

## Doc/DeviceDriver/devicetree/bindings/extcon/extcon-palmas.txt
```
EXTCON FOR PALMAS/TWL CHIPS

PALMAS USB COMPARATOR
Required Properties:
 - compatible: should contain one of:
   * "ti,palmas-usb-vid".
   * "ti,twl6035-usb-vid".
   * "ti,palmas-usb" (DEPRECATED - use "ti,palmas-usb-vid").
   * "ti,twl6035-usb" (DEPRECATED - use "ti,twl6035-usb-vid").

Optional Properties:
 - ti,wakeup : To enable the wakeup comparator in probe
 - ti,enable-id-detection: Perform ID detection. If id-gpio is specified
		it performs id-detection using GPIO else using OTG core.
 - ti,enable-vbus-detection: Perform VBUS detection.
 - id-gpio: gpio for GPIO ID detection. See gpio binding.
 - debounce-delay-ms: debounce delay for GPIO ID pin in milliseconds.

palmas-usb {
       compatible = "ti,twl6035-usb", "ti,palmas-usb";
       ti,wakeup;
};




선택적 속성 :
  - ti,wakeup : probe 에서  wakeup comparator 를 활성화하려면
  - ti, enable-id-detection : ID 감지를 수행합니다. id-gpio가 지정되면 OTG 코어를 사용하는 GPIO를 사용하여 id-detection을 수행합니다.
  - ti, enable-vbus-detection : VBUS 감지를 수행합니다.
  - id-gpio : GPIO ID 감지를위한 gpio. gpio 바인딩을 참조하십시오.
  - debounce-delay-ms : GPIO ID 핀의 디 바운스 지연 (밀리 초 단위).

palmas-usb {
        compatible = "ti, twl6035-usb", "ti, palmas-usb";
        ti,wakeup;
};
```

## Doc/DeviceDriver/devicetree/bindings/extcon/extcon-rt8973a.txt
```
* Richtek RT8973A - Micro USB Switch device

The Richtek RT8973A is Micro USB Switch with OVP and I2C interface. The RT8973A
is a USB port accessory detector and switch that is optimized to protect low
voltage system from abnormal high input voltage (up to 28V) and supports high
speed USB operation. Also, RT8973A support 'auto-configuration' mode.
If auto-configuration mode is enabled, RT8973A would control internal h/w patch
for USB D-/D+ switching.

Required properties:
- compatible: Should be "richtek,rt8973a-muic"
- reg: Specifies the I2C slave address of the MUIC block. It should be 0x14
- interrupt-parent: Specifies the phandle of the interrupt controller to which
  the interrupts from rt8973a are delivered to.
- interrupts: Interrupt specifiers for detection interrupt sources.

* Richtek RT8973A - 마이크로 USB 스위치 장치

Richtek RT8973A는 OVP 및 I2C 인터페이스가있는 마이크로 USB 스위치입니다.

RT8973A는 비정상적인 높은 입력 전압 (최대 28V)으로부터 저전압 시스템을 보호하고 고속 USB 작동을 지원하도록 최적화 된 USB 포트 액세서리 검출기 및 스위치입니다. 또한 RT8973A는 '자동 구성'모드를 지원합니다.

자동 구성 모드가 활성화되면 RT8973A는 USB D- / D + 스위칭을위한 내부 h / w 패치를 제어합니다.

필수 속성 :
- 호환 가능 : "richtek, rt8973a-muic"이어야합니다.
- reg : MUIC 블록의 I2C 슬레이브 주소를 지정합니다. 0x14 여야합니다.
- interrupt-parent : rt8973a로부터의 인터럽트가 전달되는 인터럽트 컨트롤러의 phandle을 지정합니다.
- interrupts : 탐지 인터럽트 소스에 대한 인터럽트 지정자입니다.





Example:

	rt8973a@14 {
		compatible = "richtek,rt8973a-muic";
		interrupt-parent = <&gpx1>;
		interrupts = <5 0>;
		reg = <0x14>;
	};
```

## Doc/DeviceDriver/devicetree/bindings/extcon/extcon-sm5502.txt
```
* SM5502 MUIC (Micro-USB Interface Controller) device

The Silicon Mitus SM5502 is a MUIC (Micro-USB Interface Controller) device
which can detect the state of external accessory when external accessory is
attached or detached and button is pressed or released. It is interfaced to
the host controller using an I2C interface.

Required properties:
- compatible: Should be "siliconmitus,sm5502-muic"
- reg: Specifies the I2C slave address of the MUIC block. It should be 0x25
- interrupt-parent: Specifies the phandle of the interrupt controller to which
  the interrupts from sm5502 are delivered to.
- interrupts: Interrupt specifiers for detection interrupt sources.

* SM5502 MUIC (마이크로 -USB 인터페이스 컨트롤러) 장치

Silicon Mitus SM5502는 외부 액세서리를 장착하거나 분리하고 버튼을 누르거나 놓을 때 외부 액세서리의 상태를 감지 할 수있는 MUIC (Micro-USB Interface Controller) 장치입니다. I2C 인터페이스를 사용하여 호스트 컨트롤러에 인터페이스됩니다.

필수 속성 :
- 호환 : "siliconmitus, sm5502-muic"이어야합니다.
- reg : MUIC 블록의 I2C 슬레이브 주소를 지정합니다. 0x25 여야합니다.
- interrupt-parent : sm5502의 인터럽트가 전달되는 인터럽트 컨트롤러의 phandle을 지정합니다.
- interrupts : 탐지 인터럽트 소스에 대한 인터럽트 지정자입니다.




Example:

	sm5502@25 {
		compatible = "siliconmitus,sm5502-muic";
		interrupt-parent = <&gpx1>;
		interrupts = <5 0>;
		reg = <0x25>;
	};
```

## Doc/DeviceDriver/devicetree/bindings/extcon/extcon-usb-gpio.txt
```
USB GPIO Extcon device

This is a virtual device used to generate USB cable states from the USB ID pin
connected to a GPIO pin.

Required properties:
- compatible: Should be "linux,extcon-usb-gpio"

Either one of id-gpio or vbus-gpio must be present. Both can be present as well.
- id-gpio: gpio for USB ID pin. See gpio binding.
- vbus-gpio: gpio for USB VBUS pin.

GPIO 핀에 연결된 USB ID 핀에서 USB 케이블 상태를 생성하는 데 사용되는 가상 장치입니다.

필수 속성 :
- 호환 : "linux, extcon-usb-gpio"여야합니다.

id-gpio 또는 vbus-gpio 중 하나가 있어야합니다. 둘 다 존재할 수 있습니다.
- id-gpio : gpio for USB ID 핀. gpio 바인딩을 참조하십시오.
- vbus-gpio : USB VBUS 핀용 gpio.

Example: Examples of extcon-usb-gpio node in dra7-evm.dts as listed below:
	extcon_usb1 {
		compatible = "linux,extcon-usb-gpio";
		id-gpio = <&gpio6 1 GPIO_ACTIVE_HIGH>;
	}

	&omap_dwc3_1 {
		extcon = <&extcon_usb1>;
	};
```
