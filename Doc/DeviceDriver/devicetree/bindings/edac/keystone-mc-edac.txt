## Doc/DeviceDriver/devicetree/bindings/fpga/altera-socfpga-fpga-mgr.txt
```
Altera SOCFPGA FPGA Manager

Required properties:
- compatible : should contain "altr,socfpga-fpga-mgr"
- reg        : base address and size for memory mapped io.
               - The first index is for FPGA manager register access.
               - The second index is for writing FPGA configuration data.
- interrupts : interrupt for the FPGA Manager device.

필수 속성 :
- 호환 가능 : "altr, socfpga-fpga-mgr"을 포함해야합니다.
- reg : 메모리 매핑 된 기본 주소와 크기.
                - 첫 번째 인덱스는 FPGA 매니저 레지스터 액세스를위한 것입니다.
                - 두 번째 인덱스는 FPGA 구성 데이터를 쓰는 데 사용됩니다.
- interrupts : FPGA Manager 디바이스에 대한 인터럽트입니다.
Example:

	hps_0_fpgamgr: fpgamgr@ff706000 {
		compatible = "altr,socfpga-fpga-mgr";
		reg = <0xFF706000 0x1000
		       0xFFB90000 0x1000>;
		interrupts = <0 175 4>;
	};
```

## Doc/DeviceDriver/devicetree/bindings/fpga/xilinx-zynq-fpga-mgr.txt
```
Xilinx Zynq FPGA Manager

Required properties:
- compatible:		should contain "xlnx,zynq-devcfg-1.0"
- reg:			base address and size for memory mapped io
- interrupts:		interrupt for the FPGA manager device
- clocks:		phandle for clocks required operation
- clock-names:		name for the clock, should be "ref_clk"
- syscon:		phandle for access to SLCR registers

필수 속성 :
- compatible : "xlnx, zynq-devcfg-1.0"을 포함해야합니다.
- reg : 메모리 매핑 된 기본 주소 및 크기
- 인터럽트 : FPGA 매니저 디바이스에 대한 인터럽트
- clocks : clocks 작동에 필요한 phandle
- clock-names : clock의 name이고, "ref_clk"여야합니다.
- syscon : SLCR 레지스터에 액세스하기위한 phandle



Example:
	devcfg: devcfg@f8007000 {
		compatible = "xlnx,zynq-devcfg-1.0";
		reg = <0xf8007000 0x100>;
		interrupts = <0 8 4>;
		clocks = <&clkc 12>;
		clock-names = "ref_clk";
		syscon = <&slcr>;
	};
```

## Doc/DeviceDriver/devicetree/bindings/fuse/nvidia,tegra20-fuse.txt
```
NVIDIA Tegra20/Tegra30/Tegr114/Tegra124 fuse block.

Required properties:
- compatible : For Tegra20, must contain "nvidia,tegra20-efuse".  For Tegra30,
  must contain "nvidia,tegra30-efuse".  For Tegra114, must contain
  "nvidia,tegra114-efuse".  For Tegra124, must contain "nvidia,tegra124-efuse".
  Otherwise, must contain "nvidia,<chip>-efuse", plus one of the above, where
  <chip> is tegra132.
  Details:
  nvidia,tegra20-efuse: Tegra20 requires using APB DMA to read the fuse data
	due to a hardware bug. Tegra20 also lacks certain information which is
	available in later generations such as fab code, lot code, wafer id,..
  nvidia,tegra30-efuse, nvidia,tegra114-efuse and nvidia,tegra124-efuse:
	The differences between these SoCs are the size of the efuse array,
	the location of the spare (OEM programmable) bits and the location of
	the speedo data.
- reg: Should contain 1 entry: the entry gives the physical address and length
       of the fuse registers.
- clocks: Must contain an entry for each entry in clock-names.
  See ../clocks/clock-bindings.txt for details.
- clock-names: Must include the following entries:
  - fuse
- resets: Must contain an entry for each entry in reset-names.
  See ../reset/reset.txt for details.
- reset-names: Must include the following entries:
 - fuse

VIDIA Tegra20 / Tegra30 / Tegr114 / Tegra124 퓨즈 블록.

필수 속성 :
- compatible : Tegra20의 경우 "nvidia, tegra20-efuse"를 포함해야합니다. Tegra30의 경우 "nvidia, tegra30-efuse"를 포함해야합니다. Tegra114의 경우 "nvidia, tegra114-efuse"를 포함해야합니다. Tegra124의 경우 "nvidia, tegra124-efuse"를 포함해야합니다.
   그렇지 않으면 위의 "nvidia, <chip> -efuse"와 <chip>이 tegra132 인 곳에 있어야합니다.

Details:

   nvidia, tegra20-efuse : Tegra20은 하드웨어 버그로 인해 APB DMA를 사용하여 퓨즈 데이터를 읽어야합니다. Tegra20에는 또한 팹 코드, 로트 코드, 웨이퍼 ID 등과 같은 이후 세대에서 사용할 수있는 특정 정보가 없습니다.

   nvidia, tegra30-efuse, nvidia, tegra114-efuse 및 nvidia, tegra124-efuse :
이러한 SoC의 차이점은 efuse 어레이의 크기, 스페어 (OEM 프로그래밍 가능) 비트의 위치 및 speedo data의 위치입니다.

- reg : 1 개의 엔트리를 포함해야한다 : 엔트리는 물리적 주소와 퓨즈 레지스터의 길이를 제공한다.

- clocks : clock-name의 각 항목에 대한 항목을 포함해야합니다. 자세한 내용은 ../clocks/clock-bindings.txt를 참조하십시오.

- clock-names : 다음 항목을 포함해야합니다.

   - 퓨즈
- reset : reset-names의 각 항목에 대한 항목을 포함해야합니다.
   자세한 내용은 ../reset/reset.txt를 참조하십시오.

- reset-names : 다음 항목을 포함해야합니다.
  - 퓨즈



Example:

	fuse@7000f800 {
		compatible = "nvidia,tegra20-efuse";
		reg = <0x7000f800 0x400>,
		      <0x70000000 0x400>;
		clocks = <&tegra_car TEGRA20_CLK_FUSE>;
		clock-names = "fuse";
		resets = <&tegra_car 39>;
		reset-names = "fuse";
	};
```

## Doc/DeviceDriver/devicetree/bindings/fwserial/Kconfig
```kconfig
config FIREWIRE_SERIAL
       tristate "TTY over Firewire"
       depends on FIREWIRE && TTY
       help
          This enables TTY over IEEE 1394, providing high-speed serial
	  connectivity to cabled peers. This driver implements a
	  ad-hoc transport protocol and is currently limited to
	  Linux-to-Linux communication.

	  To compile this driver as a module, say M here:  the module will
	  be called firewire-serial.
#	 이는 IEEE 1394를 통한 TTY를 가능하게하여 케이블 연결된 피어에 고속 직렬 연결을 제공합니다.
#	 이 드라이버는 ad-hoc 전송 프로토콜을 구현하며 현재 Linux-Linux 통신으로 제한되어 있습니다.
#
#	이 드라이버를 모듈로 컴파일하려면 여기에서 M이라고 말하면됩니다 : 모듈은 firewire-serial이라고합니다.

if FIREWIRE_SERIAL

config FWTTY_MAX_TOTAL_PORTS
       int "Maximum number of serial ports supported"
       default "64"
       help
          Set this to the maximum number of serial ports you want the
	  firewire-serial driver to support.
#	//firewire-serial 드라이버가 지원할 최대 시리얼 포트 수를 설정하십시오.

config FWTTY_MAX_CARD_PORTS
       int "Maximum number of serial ports supported per adapter"
       range 0 FWTTY_MAX_TOTAL_PORTS
       default "32"
       help
          Set this to the maximum number of serial ports each firewire
	  adapter supports. The actual number of serial ports registered
	  is set with the module parameter "ttys".
#	//Firewire 어댑터가 지원하는 직렬 포트의 최대 수로 설정하십시오. 
#	등록 된 실제 직렬 포트 수는 "ttys"모듈 매개 변수로 설정됩니다.

endif
```

## Doc/DeviceDriver/devicetree/bindings/gpu/nvidia,gk20a.txt
```
NVIDIA GK20A Graphics Processing Unit

Required properties:
- compatible: "nvidia,<chip>-<gpu>"
  Currently recognized values:
  - nvidia,tegra124-gk20a
- reg: Physical base address and length of the controller's registers.
  Must contain two entries:
  - first entry for bar0
  - second entry for bar1
- interrupts: Must contain an entry for each entry in interrupt-names.
  See ../interrupt-controller/interrupts.txt for details.
- interrupt-names: Must include the following entries:
  - stall
  - nonstall
- vdd-supply: regulator for supply voltage.
- clocks: Must contain an entry for each entry in clock-names.
  See ../clocks/clock-bindings.txt for details.
- clock-names: Must include the following entries:
  - gpu
  - pwr
- resets: Must contain an entry for each entry in reset-names.
  See ../reset/reset.txt for details.
- reset-names: Must include the following entries:
  - gpu

Example:

	gpu@0,57000000 {
		compatible = "nvidia,gk20a";
		reg = <0x0 0x57000000 0x0 0x01000000>,
		      <0x0 0x58000000 0x0 0x01000000>;
		interrupts = <GIC_SPI 157 IRQ_TYPE_LEVEL_HIGH>,
			     <GIC_SPI 158 IRQ_TYPE_LEVEL_HIGH>;
		interrupt-names = "stall", "nonstall";
		vdd-supply = <&vdd_gpu>;
		clocks = <&tegra_car TEGRA124_CLK_GPU>,
			 <&tegra_car TEGRA124_CLK_PLL_P_OUT5>;
		clock-names = "gpu", "pwr";
		resets = <&tegra_car 184>;
		reset-names = "gpu";
		status = "disabled";
	};

/*

NVIDIA GK20A 그래픽 처리 장치

필수 속성 :
- 호환 : "nvidia, <chip> - <gpu>"
  현재 인식 된 값 :
  - nvidia, tegra124-gk20a
- reg : 컨트롤러의 레지스터의 물리적 인 기본 주소와 길이.
  두 개의 항목이 있어야합니다.
  - bar0에 대한 첫 번째 항목
  - bar1에 대한 두 번째 항목
- 인터럽트 : 인터럽트 이름의 각 항목에 대한 항목을 포함해야합니다.
  자세한 내용은 ../interrupt-controller/interrupts.txt를 참조하십시오.
- interrupt-names : 다음 항목을 포함해야합니다.
  - 실속
  - 논 스톨
- vdd-supply : 전원 전압 레귤레이터.
- clocks : clock-name의 각 항목에 대한 항목을 포함해야합니다.
  자세한 내용은 ../clocks/clock-bindings.txt를 참조하십시오.
- clock-names : 다음 항목을 포함해야합니다.
  - GPU
  - pwr
- reset : reset-names에 각 항목에 대한 항목을 포함해야합니다.
  자세한 내용은 ../reset/reset.txt를 참조하십시오.
- reset-names : 다음 항목을 포함해야합니다.
  - GPU


Example:

	gpu@0,57000000 {
		compatible = "nvidia,gk20a";
		reg = <0x0 0x57000000 0x0 0x01000000>,
		      <0x0 0x58000000 0x0 0x01000000>;
		interrupts = <GIC_SPI 157 IRQ_TYPE_LEVEL_HIGH>,
			     <GIC_SPI 158 IRQ_TYPE_LEVEL_HIGH>;
		interrupt-names = "stall", "nonstall";
		vdd-supply = <&vdd_gpu>;
		clocks = <&tegra_car TEGRA124_CLK_GPU>,
			 <&tegra_car TEGRA124_CLK_PLL_P_OUT5>;
		clock-names = "gpu", "pwr";
		resets = <&tegra_car 184>;
		reset-names = "gpu";
		status = "disabled";
	};

*/
```

## Doc/DeviceDriver/devicetree/bindings/gpu/samsung-g2d.txt
```
* Samsung 2D Graphics Accelerator

Required properties:
  - compatible : value should be one among the following:
	(a) "samsung,s5pv210-g2d" for G2D IP present in S5PV210 & Exynos4210 SoC
	(b) "samsung,exynos4212-g2d" for G2D IP present in Exynos4x12 SoCs
	(c) "samsung,exynos5250-g2d" for G2D IP present in Exynos5250 SoC

  - reg : Physical base address of the IP registers and length of memory
	  mapped region.

  - interrupts : G2D interrupt number to the CPU.
  - clocks : from common clock binding: handle to G2D clocks.
  - clock-names : names of clocks listed in clocks property, in the same
		  order, depending on SoC type:
		  - for S5PV210 and Exynos4 based SoCs: "fimg2d" and
		    "sclk_fimg2d"
		  - for Exynos5250 SoC: "fimg2d".

Example:
	g2d@12800000 {
		compatible = "samsung,s5pv210-g2d";
		reg = <0x12800000 0x1000>;
		interrupts = <0 89 0>;
		clocks = <&clock 177>, <&clock 277>;
		clock-names = "sclk_fimg2d", "fimg2d";
		status = "disabled";
	};


/*

* 삼성 2D 그래픽 가속기

필수 속성 :
   - compatible : 값은 다음 중 하나 여야합니다.
(a) S5PV210 및 Exynos4210 SoC에있는 G2D IP 용 "samsung, s5pv210-g2d"
(b) Exynos4x12 SoC에있는 G2D IP를위한 "samsung, exynos4212-g2d"
(c) Exynos5250 SoC에있는 G2D IP 용 "samsung, exynos5250-g2d"

   - reg : IP 레지스터의 물리적 기본 주소와 메모리의 길이
맵핑 된 영역.

   - interrupts : G2D CPU에 대한 인터럽트 번호.
   - 클럭 : 공통 클럭 바인딩에서 : G2D 클럭으로 처리합니다.
   - clock-names : clocks에 나열된 clock의 이름
SoC 유형에 따라 다름 :
- S5PV210 및 Exynos4 기반 SoC의 경우 : "fimg2d"및 "sclk_fimg2d"
- Exynos5250 SoC의 경우 : "fimg2d".


Example:
	g2d@12800000 {
		compatible = "samsung,s5pv210-g2d";
		reg = <0x12800000 0x1000>;
		interrupts = <0 89 0>;
		clocks = <&clock 177>, <&clock 277>;
		clock-names = "sclk_fimg2d", "fimg2d";
		status = "disabled";
	};

*/
```

## Doc/DeviceDriver/devicetree/bindings/gpu/samsung-rotator.txt
```
* Samsung Image Rotator

Required properties:
  - compatible : value should be one of the following:
	(a) "samsung,exynos4210-rotator" for Rotator IP in Exynos4210
	(b) "samsung,exynos4212-rotator" for Rotator IP in Exynos4212/4412
	(c) "samsung,exynos5250-rotator" for Rotator IP in Exynos5250

  - reg : Physical base address of the IP registers and length of memory
	  mapped region.

  - interrupts : Interrupt specifier for rotator interrupt, according to format
		 specific to interrupt parent.

  - clocks : Clock specifier for rotator clock, according to generic clock
	     bindings. (See Documentation/devicetree/bindings/clock/exynos*.txt)

  - clock-names : Names of clocks. For exynos rotator, it should be "rotator".

Example:
	rotator@12810000 {
		compatible = "samsung,exynos4210-rotator";
		reg = <0x12810000 0x1000>;
		interrupts = <0 83 0>;
		clocks = <&clock 278>;
		clock-names = "rotator";
	};

/*
* 삼성 이미지 회전 장치

필수 속성 :
   - compatible : value는 다음 중 하나 여야합니다.
(a) Exynos4210의 Rotator IP 용 "samsung, exynos4210-rotator"
(b) Exynos4212 / 4412의 Rotator IP 용 "samsung, exynos4212-rotator"
Exynos5250의 Rotator IP를위한 (c) "samsung, exynos5250-rotator"

   - reg : IP 레지스터의 물리적 기본 주소와 메모리의 길이
맵핑 된 영역.

   - 인터럽트 : 형식에 따라 로테이터 인터럽트에 대한 인터럽트 지정자
부모에게 방해 특정.

   - clocks : 일반 시계에 따른 로테이터 클럭에 대한 클록 지정자
바인딩. (Documentation / devicetree / bindings / clock / exynos * .txt를 참조하십시오)

   - clock-names : 시계의 이름. exynos rotator의 경우 "rotator"여야합니다

Example:
	rotator@12810000 {
		compatible = "samsung,exynos4210-rotator";
		reg = <0x12810000 0x1000>;
		interrupts = <0 83 0>;
		clocks = <&clock 278>;
		clock-names = "rotator";
	};

*/
```

## Doc/DeviceDriver/devicetree/bindings/gpu/ti-bb2d.txt
```
* Texas Instruments BB2D blitter module

This binding describes the 2D BitBlit (BB2D) graphics accelerator
subsystem based on the GC320 core from Vivante Corporation available
in Texas Instruments SoCs.

Required properties:
  - compatible: value should take the following format:
        "ti,<soc>-bb2d", "vivante,<gpuversion>"
    accepted values:
     (a) "ti,dra7-bb2d", "vivante,gc320" for TI DRA7xx / AM57x

  - reg : base address and length of BB2D IP registers
  - interrupts : BB2D interrupt line number
  - ti,hwmods : name of the hwmod associated with BB2D module
  - clocks : handle to BB2D functional clock
  - clock-names : fclk

Example for DRA7x SoC:
        bb2d: bb2d@59000000 {
            compatible = "ti,dra7-bb2d", "vivante,gc320";
            reg = <0x59000000 0x0700>;
            interrupts = <GIC_SPI 120 IRQ_TYPE_LEVEL_HIGH>;
            ti,hwmods = "bb2d";
            clocks = <&dpll_core_h24x2_ck>;
            clock-names = "fclk";
        };

/*
* Texas Instruments BB2D 블 리터 모듈

이 바인딩은 2D BitBlit (BB2D) 그래픽 가속기를 설명합니다.
서브 시스템은 텍사스 인스트루먼트 SoC에서 사용 가능한 Vivante Corporation의 GC320 코어를 기반으로합니다.

필수 속성 :
   - 호환 : 값은 "ti, <soc> -bb2d", "vivante, <gpuversion>"형식을 취해야합니다.
     허용 된 값 :
      (a) TI DRA7xx / AM57x의 경우 "ti, dra7-bb2d", "vivante, gc320"

   - reg : BB2D IP 레지스터의 기본 주소와 길이
   - 인터럽트 : BB2D 인터럽트 회선 번호
   - ti, hwmods : BB2D 모듈과 관련된 hwmod의 이름
   - clock : BB2D 기능 clock 처리
   - clock 이름 : fclk


Example for DRA7x SoC:
        bb2d: bb2d@59000000 {
            compatible = "ti,dra7-bb2d", "vivante,gc320";
            reg = <0x59000000 0x0700>;
            interrupts = <GIC_SPI 120 IRQ_TYPE_LEVEL_HIGH>;
            ti,hwmods = "bb2d";
            clocks = <&dpll_core_h24x2_ck>;
            clock-names = "fclk";
        };


*/
```
