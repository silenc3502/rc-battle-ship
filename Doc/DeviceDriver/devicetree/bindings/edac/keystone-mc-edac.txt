## Doc/DeviceDriver/devicetree/bindings/exynos/exynos_dp.txt
```
The Exynos display port interface should be configured based on
the type of panel connected to it.

We use two nodes:
	-dp-controller node
	-dptx-phy node(defined inside dp-controller node)

For the DP-PHY initialization, we use the dptx-phy node.
Required properties for dptx-phy: deprecated, use phys and phy-names
	-reg: deprecated
		Base address of DP PHY register.
	-samsung,enable-mask: deprecated
		The bit-mask used to enable/disable DP PHY.

For the Panel initialization, we read data from dp-controller node.
Required properties for dp-controller:
	-compatible:
		should be "samsung,exynos5-dp".
	-reg:
		physical base address of the controller and length
		of memory mapped region.
	-interrupts:
		interrupt combiner values.
	-clocks:
		from common clock binding: handle to dp clock.
	-clock-names:
		from common clock binding: Shall be "dp".
	-interrupt-parent:
		phandle to Interrupt combiner node.
	-phys:
		from general PHY binding: the phandle for the PHY device.
	-phy-names:
		from general PHY binding: Should be "dp".
	-samsung,color-space:
		input video data format.
			COLOR_RGB = 0, COLOR_YCBCR422 = 1, COLOR_YCBCR444 = 2
	-samsung,dynamic-range:
		dynamic range for input video data.
			VESA = 0, CEA = 1
	-samsung,ycbcr-coeff:
		YCbCr co-efficients for input video.
			COLOR_YCBCR601 = 0, COLOR_YCBCR709 = 1
	-samsung,color-depth:
		number of bits per colour component.
			COLOR_6 = 0, COLOR_8 = 1, COLOR_10 = 2, COLOR_12 = 3
	-samsung,link-rate:
		link rate supported by the panel.
			LINK_RATE_1_62GBPS = 0x6, LINK_RATE_2_70GBPS = 0x0A
	-samsung,lane-count:
		number of lanes supported by the panel.
			LANE_COUNT1 = 1, LANE_COUNT2 = 2, LANE_COUNT4 = 4
	- display-timings: timings for the connected panel as described by
		Documentation/devicetree/bindings/display/display-timing.txt

Optional properties for dp-controller:
	-interlaced:
		interlace scan mode.
			Progressive if defined, Interlaced if not defined
	-vsync-active-high:
		VSYNC polarity configuration.
			High if defined, Low if not defined
	-hsync-active-high:
		HSYNC polarity configuration.
			High if defined, Low if not defined
	-samsung,hpd-gpio:
		Hotplug detect GPIO.
			Indicates which GPIO should be used for hotplug
			detection
	-video interfaces: Device node can contain video interface port
			    nodes according to [1].

[1]: Documentation/devicetree/bindings/media/video-interfaces.txt

Example:

SOC specific portion:
	dp-controller {
		compatible = "samsung,exynos5-dp";
		reg = <0x145b0000 0x10000>;
		interrupts = <10 3>;
		interrupt-parent = <&combiner>;
		clocks = <&clock 342>;
		clock-names = "dp";

		phys = <&dp_phy>;
		phy-names = "dp";
	};

Board Specific portion:
	dp-controller {
		samsung,color-space = <0>;
		samsung,dynamic-range = <0>;
		samsung,ycbcr-coeff = <0>;
		samsung,color-depth = <1>;
		samsung,link-rate = <0x0a>;
		samsung,lane-count = <4>;

		display-timings {
			native-mode = <&lcd_timing>;
			lcd_timing: 1366x768 {
				clock-frequency = <70589280>;
				hactive = <1366>;
				vactive = <768>;
				hfront-porch = <40>;
				hback-porch = <40>;
				hsync-len = <32>;
				vback-porch = <10>;
				vfront-porch = <12>;
				vsync-len = <6>;
			};
		};

		ports {
			port@0 {
				dp_out: endpoint {
					remote-endpoint = <&bridge_in>;
				};
			};
		};
	};


/*
Exynos 디스플레이 포트 인터페이스는 연결된 디스플레이 유형에 따라 구성되어야합니다.

두 개의 노드를 사용합니다.
-dp-controller 노드
-dptx-phy 노드 (dp-controller 노드 내부에 정의 됨)

DP-PHY 초기화의 경우 dptx-phy 노드를 사용합니다.

dptx-phy의 필수 속성 : deprecated, phys 및 phy-names 사용
-reg : 더 이상 사용되지 않음

DP PHY 레지스터의 기본 주소.

-samsung, enable-mask : 더 이상 사용되지 않음

DP PHY를 활성화 / 비활성화하는 데 사용되는 비트 마스크입니다.

Panel 초기화를 위해 dp-controller 노드에서 데이터를 읽습니다.

dp-controller의 필수 등록 정보 :

호환 :

"samsung, exynos5-dp"여야합니다.

-reg :

컨트롤러의 물리적 기본 주소 및 메모리 맵핑 영역의 길이

인터럽트 :

인터럽트 결합기 값.
-clocks :
기본 클럭 바인딩에서 : dp 클럭으로 처리하십시오.
-clock-names :
기본 클럭 바인딩에서 : "dp"가되어야합니다.
-interrupt-parent :
p핸들 인터럽트 결합기 노드.

-phys :

일반 PHY 바인딩에서 : PHY 장치의 p핸들.

-phy-names :

일반 PHY 바인딩에서 : "dp"여야합니다.

삼성, 색 공간 :

입력 비디오 데이터 형식.

COLOR_RGB = 0, COLOR_YCBCR422 = 1, COLOR_YCBCR444 = 2

-samsung, dynamic-range :

입력 비디오 데이터의 동적 범위.

VESA = 0, CEA = 1

-samsung, ycbcr-coeff :

입력 비디오에 대한 YCbCr 동시 효용

COLOR_YCBCR601 = 0, COLOR_YCBCR709 = 1

삼성, 색 농도 :

색성분 당 비트 수.

COLOR_6 = 0, COLOR_8 = 1, COLOR_10 = 2, COLOR_12 = 3

- 삼성, 링크 속도 :

링크 속도는 패널에서 지원합니다.

LINK_RATE_1_62GBPS = 0x6, LINK_RATE_2_70GBPS = 0x0A

- 삼성, 레인 수 :

패널이 지원하는 레인 수입니다.

LANE_COUNT1 = 1, LANE_COUNT2 = 2, LANE_COUNT4 = 4

- 디스플레이 타이밍 :에 의해 설명 된 바와 같이 연결된 패널의 타이밍

Documentation/devicetree/bindings/display/display-timing.txt


dp-controller의 선택적 속성 :

-interlaced :

인터레이스 스캔 모드.

프로그레시브 (정의 된 경우), 인터레이스 (정의되지 않은 경우)

-vsync-active-high :

VSYNC 극성 구성.

정의 된 경우 높음, 정의되지 않은 경우 낮음

-hsync-active-high :

HSYNC 극성 구성.

정의 된 경우 높음, 정의되지 않은 경우 낮음

-samsung, hpd-gpio :

핫 플러그 ??GPIO를 감지합니다.

핫 플러그 ??감지에 사용할 GPIO를 나타냅니다.

- 비디오 인터페이스 : 장치 노드는 [1]에 따라 비디오 인터페이스 포트 노드를 포함 할 수 있습니다.

[1] : Documentation / devicetree / bindings / media / video-interfaces.txt

Example:

SOC specific portion:
	dp-controller {
		compatible = "samsung,exynos5-dp";
		reg = <0x145b0000 0x10000>;
		interrupts = <10 3>;
		interrupt-parent = <&combiner>;
		clocks = <&clock 342>;
		clock-names = "dp";

		phys = <&dp_phy>;
		phy-names = "dp";
	};

Board Specific portion:
	dp-controller {
		samsung,color-space = <0>;
		samsung,dynamic-range = <0>;
		samsung,ycbcr-coeff = <0>;
		samsung,color-depth = <1>;
		samsung,link-rate = <0x0a>;
		samsung,lane-count = <4>;

		display-timings {
			native-mode = <&lcd_timing>;
			lcd_timing: 1366x768 {
				clock-frequency = <70589280>;
				hactive = <1366>;
				vactive = <768>;
				hfront-porch = <40>;
				hback-porch = <40>;
				hsync-len = <32>;
				vback-porch = <10>;
				vfront-porch = <12>;
				vsync-len = <6>;
			};
		};

		ports {
			port@0 {
				dp_out: endpoint {
					remote-endpoint = <&bridge_in>;
				};
			};
		};
	};

*/
```

## Doc/DeviceDriver/devicetree/bindings/exynos/exynos_dsim.txt
```
Exynos MIPI DSI Master

Required properties:
  - compatible: value should be one of the following
		"samsung,exynos3250-mipi-dsi" /* for Exynos3250/3472 SoCs */
		"samsung,exynos4210-mipi-dsi" /* for Exynos4 SoCs */
		"samsung,exynos4415-mipi-dsi" /* for Exynos4415 SoC */
		"samsung,exynos5410-mipi-dsi" /* for Exynos5410/5420/5440 SoCs */
		"samsung,exynos5433-mipi-dsi" /* for Exynos5433 SoCs */
  - reg: physical base address and length of the registers set for the device
  - interrupts: should contain DSI interrupt
  - clocks: list of clock specifiers, must contain an entry for each required
    entry in clock-names
  - clock-names: should include "bus_clk"and "sclk_mipi" entries
		 the use of "pll_clk" is deprecated
  - phys: list of phy specifiers, must contain an entry for each required
    entry in phy-names
  - phy-names: should include "dsim" entry
  - vddcore-supply: MIPI DSIM Core voltage supply (e.g. 1.1V)
  - vddio-supply: MIPI DSIM I/O and PLL voltage supply (e.g. 1.8V)
  - samsung,pll-clock-frequency: specifies frequency of the oscillator clock
  - #address-cells, #size-cells: should be set respectively to <1> and <0>
    according to DSI host bindings (see MIPI DSI bindings [1])

Optional properties:
  - power-domains: a phandle to DSIM power domain node

Child nodes:
  Should contain DSI peripheral nodes (see MIPI DSI bindings [1]).

Video interfaces:
  Device node can contain video interface port nodes according to [2].
  The following are properties specific to those nodes:

  port node inbound:
    - reg: (required) must be 0.
  port node outbound:
    - reg: (required) must be 1.

  endpoint node connected from mic node (reg = 0):
    - remote-endpoint: specifies the endpoint in mic node. This node is required
		       for Exynos5433 mipi dsi. So mic can access to panel node
		       thoughout this dsi node.
  endpoint node connected to panel node (reg = 1):
    - remote-endpoint: specifies the endpoint in panel node. This node is
		       required in all kinds of exynos mipi dsi to represent
		       the connection between mipi dsi and panel.
    - samsung,burst-clock-frequency: specifies DSI frequency in high-speed burst
      mode
    - samsung,esc-clock-frequency: specifies DSI frequency in escape mode

[1]: Documentation/devicetree/bindings/display/mipi-dsi-bus.txt
[2]: Documentation/devicetree/bindings/media/video-interfaces.txt

Example:

	dsi@11C80000 {
		compatible = "samsung,exynos4210-mipi-dsi";
		reg = <0x11C80000 0x10000>;
		interrupts = <0 79 0>;
		clocks = <&clock 286>, <&clock 143>;
		clock-names = "bus_clk", "sclk_mipi";
		phys = <&mipi_phy 1>;
		phy-names = "dsim";
		vddcore-supply = <&vusb_reg>;
		vddio-supply = <&vmipi_reg>;
		power-domains = <&pd_lcd0>;
		#address-cells = <1>;
		#size-cells = <0>;
		samsung,pll-clock-frequency = <24000000>;

		panel@1 {
			reg = <0>;
			...
			port {
				panel_ep: endpoint {
					remote-endpoint = <&dsi_ep>;
				};
			};
		};

		ports {
			#address-cells = <1>;
			#size-cells = <0>;

			port@0 {
				reg = <0>;
				decon_to_mic: endpoint {
					remote-endpoint = <&mic_to_decon>;
				};
			};

			port@1 {
				reg = <1>;
				dsi_ep: endpoint {
					reg = <0>;
					samsung,burst-clock-frequency = <500000000>;
					samsung,esc-clock-frequency = <20000000>;
					remote-endpoint = <&panel_ep>;
				};
			};
		};
	};

/*
Exynos MIPI DSI 마스터

필수 속성 :
??- compatible : value는 다음 중 하나 여야합니다.
"syn, exynos3250-mipi-dsi"/ * Exynos3250 / 3472 SoC * /
"samsung, exynos4210-mipi-dsi"/ * Exynos4 SoC * /
"syn, exynos4415-mipi-dsi"/ * Exynos4415 SoC * /
"syn, exynos5410-mipi-dsi"/ * Exynos5410 / 5420 / 5440 SoC * /
"samsung, exynos5433-mipi-dsi"/ * Exynos5433 SoC * /
??- reg : 장치에 설정된 레지스터의 물리적 기본 주소 및 길이
??- 인터럽트 : DSI 인터럽트를 포함해야합니다.
??- clocks : 클럭 지정자 목록. 각 필수 항목을 포함해야합니다.

클럭 이름의 항목
??- clock-names : "bus_clk"및 "sclk_mipi"항목을 포함해야합니다.
"pll_clk"의 사용은 더 이상 사용되지 않습니다.
??- phys : phy 지정자 목록이며 각 필수 항목에 대한 항목이 있어야합니다.

phy-name 항목
- phy-names : "dsim"항목을 포함해야합니다
- vddcore-supply : MIPI DSIM 코어 전원 (예 : 1.1V)
- vddio 공급 : MIPI DSIM I / O 및 PLL 전압 공급 (예 : 1.8V)
- samsung, pll-clock-frequency : 오실레이터 클럭 주파수를 지정합니다.
- # address-cells # size-cells : 각각 <1>과 <0>으로 설정해야합니다.
DSI 호스트 바인딩 (MIPI DSI 바인딩 [1] 참조)에 따라

선택적 속성 :
??- 전력 도메인 : DSIM 전력 도메인 노드에 대한 p 핸들

자식 노드 :
??DSI 주변 노드를 포함해야합니다 (MIPI DSI 바인딩 [1] 참조).

비디오 인터페이스 :
??디바이스 노드는 [2]에 따라 비디오 인터페이스 포트 노드를 포함 할 수 있습니다.
??다음은 해당 노드의 고유 한 속성입니다.

??포트 노드 인바운드 :
????- reg : (필수)는 0이어야합니다.
??포트 노드 아웃 바운드 :
????- reg : (필수)는 1이어야합니다.

mic 노드 (reg = 0)에서 연결된 엔드 포인트 노드 :

- remote-endpoint : mic 노드의 끝점을 지정합니다. 
이 노드는 Exynos5433 mipi dsi 필요합니다. 
그래서 mic는 이 DSN 노드를 통해 패널 노드에 액세스 할 수 있습니다.
??패널 노드에 연결된 끝점 노드 (reg = 1) :
????- remote-endpoint : 패널 노드에서 엔드 포인트를 지정합니다. 이 노드는
모든 종류의 exynos mipi dsi에서 나타낼 필요가 있음
mipi dsi와 패널 간의 연결.
????- samsung, burst-clock-frequency : 고속 버스트에서 DSI 주파수를 지정합니다.
??????방법
????- samsung, esc-clock-frequency : 이스케이프 모드에서 DSI 주파수를 지정합니다.

[1] : Documentation / devicetree / bindings / display / mipi-dsi-bus.txt
[2] : Documentation / devicetree / bindings / media / video-interfaces.txt

Example:

	dsi@11C80000 {
		compatible = "samsung,exynos4210-mipi-dsi";
		reg = <0x11C80000 0x10000>;
		interrupts = <0 79 0>;
		clocks = <&clock 286>, <&clock 143>;
		clock-names = "bus_clk", "sclk_mipi";
		phys = <&mipi_phy 1>;
		phy-names = "dsim";
		vddcore-supply = <&vusb_reg>;
		vddio-supply = <&vmipi_reg>;
		power-domains = <&pd_lcd0>;
		#address-cells = <1>;
		#size-cells = <0>;
		samsung,pll-clock-frequency = <24000000>;

		panel@1 {
			reg = <0>;
			...
			port {
				panel_ep: endpoint {
					remote-endpoint = <&dsi_ep>;
				};
			};
		};

		ports {
			#address-cells = <1>;
			#size-cells = <0>;

			port@0 {
				reg = <0>;
				decon_to_mic: endpoint {
					remote-endpoint = <&mic_to_decon>;
				};
			};

			port@1 {
				reg = <1>;
				dsi_ep: endpoint {
					reg = <0>;
					samsung,burst-clock-frequency = <500000000>;
					samsung,esc-clock-frequency = <20000000>;
					remote-endpoint = <&panel_ep>;
				};
			};
		};
	};


*/
```

## Doc/DeviceDriver/devicetree/bindings/exynos/exynos_hdmi.txt
```
Device-Tree bindings for drm hdmi driver

Required properties:
- compatible: value should be one among the following:
	1) "samsung,exynos5-hdmi" <DEPRECATED>
	2) "samsung,exynos4210-hdmi"
	3) "samsung,exynos4212-hdmi"
	4) "samsung,exynos5420-hdmi"
- reg: physical base address of the hdmi and length of memory mapped
	region.
- interrupts: interrupt number to the cpu.
- hpd-gpio: following information about the hotplug gpio pin.
	a) phandle of the gpio controller node.
	b) pin number within the gpio controller.
	c) optional flags and pull up/down.
- clocks: list of clock IDs from SoC clock driver.
	a) hdmi: Gate of HDMI IP bus clock.
	b) sclk_hdmi: Gate of HDMI special clock.
	c) sclk_pixel: Pixel special clock, one of the two possible inputs of
		HDMI clock mux.
	d) sclk_hdmiphy: HDMI PHY clock output, one of two possible inputs of
		HDMI clock mux.
	e) mout_hdmi: It is required by the driver to switch between the 2
		parents i.e. sclk_pixel and sclk_hdmiphy. If hdmiphy is stable
		after configuration, parent is set to sclk_hdmiphy else
		sclk_pixel.
- clock-names: aliases as per driver requirements for above clock IDs:
	"hdmi", "sclk_hdmi", "sclk_pixel", "sclk_hdmiphy" and "mout_hdmi".
- ddc: phandle to the hdmi ddc node
- phy: phandle to the hdmi phy node
- samsung,syscon-phandle: phandle for system controller node for PMU.

Example:

	hdmi {
		compatible = "samsung,exynos4212-hdmi";
		reg = <0x14530000 0x100000>;
		interrupts = <0 95 0>;
		hpd-gpio = <&gpx3 7 1>;
		ddc = <&hdmi_ddc_node>;
		phy = <&hdmi_phy_node>;
		samsung,syscon-phandle = <&pmu_system_controller>;
	};

/*
drm hdmi 드라이버의 장치 트리 바인딩

필수 속성 :
- compatible : 값은 다음 중 하나 여야합니다.
1) "samsung, exynos5-hdmi"<DEPRECATED>
2) "samsung, exynos4210-hdmi"
3) "samsung, exynos4212-hdmi"
4) "samsung, exynos5420-hdmi"
- reg : hdmi의 물리적 기본 주소와 메모리 매핑 영역의 길이.
- interrupts : CPU에 대한 인터럽트 번호.
- hpd-gpio : hotplug gpio 핀에 대한 정보.
a) gpio 컨트롤러 노드의 phandle.
b) gpio 컨트롤러 내의 핀 번호.
c) 선택적 플래그 및 위 / 아래로 당기기.
- clocks : SoC 클럭 드라이버의 클록 ID 목록.
a) hdmi : HDMI IP 버스 클록의 게이트.
b) sclk_hdmi : HDMI 특수 클럭의 게이트입니다.
c) sclk_pixel : 픽셀 특수 클럭, 두 가지 가능한 입력 중 하나
HDMI 클럭 mux.
d) sclk_hdmiphy : HDMI PHY 클록 출력, 두 가지 가능한 입력 중 하나
HDMI 클럭 mux.
e) mout_hdmi : 드라이버가 두 부모 사이를 전환하는 데 필요합니다 (sclk_pixel 및 sclk_hdmiphy).
 구성 후 hdmiphy가 안정적이면 parent는 sclk_hdmiphy 이외의 sclk_pixel로 설정됩니다.
sclk_pixel.
- clock-names : 위의 클럭 ID에 대한 드라이버 요구 사항 별 별칭 :
"hdmi", "sclk_hdmi", "sclk_pixel", "sclk_hdmiphy"및 "mout_hdmi"입니다.
- ddc : hdmi ddc 노드에 대한 phandle
- phy : hdmi phy 노드에 대한 phandle
- samsung, syscon-phandle : PMU 용 시스템 컨트롤러 노드 용 phandle.

Example:

	hdmi {
		compatible = "samsung,exynos4212-hdmi";
		reg = <0x14530000 0x100000>;
		interrupts = <0 95 0>;
		hpd-gpio = <&gpx3 7 1>;
		ddc = <&hdmi_ddc_node>;
		phy = <&hdmi_phy_node>;
		samsung,syscon-phandle = <&pmu_system_controller>;
	};


*/
```

## Doc/DeviceDriver/devicetree/bindings/exynos/exynos_hdmiphy.txt
```
Device-Tree bindings for hdmiphy driver

Required properties:
- compatible: value should be one of the following:
	1) "samsung,exynos5-hdmiphy" <DEPRECATED>
	2) "samsung,exynos4210-hdmiphy".
	3) "samsung,exynos4212-hdmiphy".
- reg: I2C address of the hdmiphy device.

Example:

	hdmiphy {
		compatible = "samsung,exynos4210-hdmiphy";
		reg = <0x38>;
	};
/*
hdmiphy 드라이버에 대한 장치 트리 바인딩

필수 속성 :
- compatible : value는 다음 중 하나 여야합니다.
1) "samsung, exynos5-hdmiphy"<사용을 권장하지 않음>
2) "samsung, exynos4210-hdmiphy".
3) "samsung, exynos4212-hdmiphy".
- reg : hdmiphy 장치의 I2C 주소입니다.

Example:

	hdmiphy {
		compatible = "samsung,exynos4210-hdmiphy";
		reg = <0x38>;
	};

*/
```
