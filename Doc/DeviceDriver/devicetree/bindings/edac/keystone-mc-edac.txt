## Doc/DeviceDriver/devicetree/bindings/gpu/ti-sgx.txt
```
Texas Instruments SGX 3D Graphics Processing Unit

SGX is a 3D Graphics Processing Unit from Imagination Technologies. SGX is
codename for 5th generation / Series 5 of PowerVR chipset family. This binding
describes PowerVR SGX GPU integrated in Texas Instrument SoCs.

Required properties:
 - compatible : value should take the following format:
	"ti,<soc>-<gpuversion>", "img,<gpuversion>"

   accepted values:
	(a) "ti,dra7-sgx544", "img,sgx544" for TI DRA7xx / AM57x
	(b) "ti,am4376-sgx530", "img,sgx530" for TI AM43x
	(c) "ti,am3352-sgx530", "img,sgx530" for TI AM33x
 - reg: base address and length of the SGX registers
 - interrupts : SGX interrupt number
 - ti,hwmods: Name of the hwmod associated with the SGX
 - clocks : from SoC clock binding

Optional properties:
 - reg-names : names of registers listed in reg property in same order
 - clock-names : names of clocks listed in clocks property in the same order

Example:
	sgx@0x56000000 {
		compatible = "ti,dra7-sgx544", "img,sgx544";
		reg = <0x5600fe00 0x200>;
		reg-names = "gpu_ocp_base";
		interrupts = <GIC_SPI 16 IRQ_TYPE_LEVEL_HIGH>;
		ti,hwmods = "gpu";
		clocks = <&l3_iclk_div>, <&gpu_core_gclk_mux>,
			 <&gpu_hyd_gclk_mux>;
		clock-names = "iclk", "fclk1", "fclk2";
	};


/*

Texas Instruments SGX 3D 그래픽 처리 장치

SGX는 Imagination Technologies의 3D 그래픽 처리 장치입니다. SGX는 PowerVR 칩셋 제품군의 5 세대 / 5 시리즈의 코드 명입니다. 이 바인딩은 Texas Instruments SoC에 통합 된 PowerVR SGX GPU에 대해 설명합니다.

필수 속성 :
 - compatible : 값은 다음 형식을 취해야합니다.
"ti, <soc> - <gpuversion>", "img, <gpuversion>"

   허용 된 값 :
(a) TI DRA7xx / AM57x의 경우 "ti, dra7-sgx544", "img, sgx544"
(b) TI AM43x의 경우 "ti, am4376-sgx530", "img, sgx530"
(c) TI AM33x의 경우 "ti, am3352-sgx530", "img, sgx530"
 - reg : SGX 레지스터의 기본 주소 및 길이
 - 인터럽트 : SGX 인터럽트 번호
 - ti, hwmods : SGX와 연관된 hwmod의 이름입니다.
 - clock : SoC clock 바인딩

선택적 속성 :
 - reg-names : reg 속성에 같은 순서로 나열된 레지스터의 이름
 - clock-names : clocks 속성에 같은 순서로 나열된 clock의 이름


Example:
	sgx@0x56000000 {
		compatible = "ti,dra7-sgx544", "img,sgx544";
		reg = <0x5600fe00 0x200>;
		reg-names = "gpu_ocp_base";
		interrupts = <GIC_SPI 16 IRQ_TYPE_LEVEL_HIGH>;
		ti,hwmods = "gpu";
		clocks = <&l3_iclk_div>, <&gpu_core_gclk_mux>,
			 <&gpu_hyd_gclk_mux>;
		clock-names = "iclk", "fclk1", "fclk2";
	};



*/
```

## Doc/DeviceDriver/devicetree/bindings/h8300/cpu.txt
```
* H8/300 CPU bindings

Required properties:

- compatible: Compatible property value should be "renesas,h8300".
- clock-frequency: Contains the clock frequency for CPU, in Hz.

* H8 / 300 CPU 바인딩

필수 속성 :

- compatible : 호환되는 속성 값은 "renesas, h8300"이어야합니다.
- clock-frequency : CPU의 클록 주파수 (Hz)를 포함합니다.



Example:

		cpu@0 {
			compatible = "renesas,h8300";
			clock-frequency = <20000000>;
		};
```

## Doc/DeviceDriver/devicetree/bindings/hsi/client-devices.txt
```
Each HSI port is supposed to have one child node, which
symbols the remote device connected to the HSI port. The
following properties are standardized for HSI clients:

Required HSI configuration properties:

- hsi-channel-ids:	A list of channel ids

- hsi-rx-mode:		Receiver Bit transmission mode ("stream" or "frame")
- hsi-tx-mode:		Transmitter Bit transmission mode ("stream" or "frame")
- hsi-mode:		May be used instead hsi-rx-mode and hsi-tx-mode if
			the transmission mode is the same for receiver and
			transmitter
- hsi-speed-kbps:	Max bit transmission speed in kbit/s
- hsi-flow:		RX flow type ("synchronized" or "pipeline")
- hsi-arb-mode:		Arbitration mode for TX frame ("round-robin", "priority")

Optional HSI configuration properties:

- hsi-channel-names:	A list with one name per channel specified in the
			hsi-channel-ids property

각 HSI 포트에는 원격 장치가 HSI 포트에 연결된 기호가있고 하나의 자식 노드가 있어야합니다. HSI 클라이언트에 대해 다음 속성이 표준화되었습니다.

필수 HSI 구성 등록 정보 :

- hsi-channel-ids : 채널 ID 목록

- hsi-rx-mode : 수신기 비트 전송 모드 ( "stream" or "frame")
- hsi-tx-mode : 송신기 비트 전송 모드 ( "stream" or "frame")
- hsi-mode : 수신기와 송신기의 전송 모드가 동일하면 hsi-rx-mode 및 hsi-tx-mode 대신 사용할 수 있습니다.

- hsi-speed-kbps : 최대 비트 전송 속도 (kbit / s)

- hsi-flow : RX 흐름 유형 ( "synchronized" or "pipeline" )

- hsi-arb-mode : TX 프레임의 조정 모드 ( "round-robin", "priority") 선택적 HSI 구성 속성 :

- hsi-channel-names : hsi-channel-ids 등록 정보에 지정된 채널당 하나의 이름을 가진 목록




Device Tree node example for an HSI client:
HSI 클라이언트의 장치 트리 노드 예제 :

hsi-controller {
	hsi-port {
		modem: hsi-client {
			compatible = "nokia,n900-modem";

			hsi-channel-ids = <0>, <1>, <2>, <3>;
			hsi-channel-names = "mcsaab-control",
					    "speech-control",
					    "speech-data",
					    "mcsaab-data";
			hsi-speed-kbps = <55000>;
			hsi-mode = "frame";
			hsi-flow = "synchronized";
			hsi-arb-mode = "round-robin";

			/* more client specific properties */
			/ * 더 많은 클라이언트 특정 속성 * /
		};
	};
};
```

## Doc/DeviceDriver/devicetree/bindings/hsi/nokia-modem.txt
```
Nokia modem client bindings

The Nokia modem HSI client follows the common HSI client binding
and inherits all required properties. The following additional
properties are needed by the Nokia modem HSI client:

Required properties:
- compatible:		Should be one of
      "nokia,n900-modem"
- hsi-channel-names:	Should contain the following strings
      "mcsaab-control"
      "speech-control"
      "speech-data"
      "mcsaab-data"
- gpios:		Should provide a GPIO handler for each GPIO listed in
                        gpio-names
- gpio-names:		Should contain the following strings
      "cmt_apeslpx"
      "cmt_rst_rq"
      "cmt_en"
      "cmt_rst"
      "cmt_bsi"
- interrupts:		Should be IRQ handle for modem's reset indication

Nokia 모뎀 클라이언트 바인딩

Nokia 모뎀 HSI 클라이언트는 일반적인 HSI 클라이언트 바인딩을 따르고 모든 필수 속성을 상속합니다. 다음 추가 속성은 Nokia 모뎀 HSI 클라이언트에 필요합니다.

필수 속성 :
- 호환 : "nokia, n900-modem"중 하나 여야합니다.
- hsi-channel-names : 다음 문자열을 포함해야합니다.
       "mcsaab-control"
       "음성 통제"
       "음성 데이터"
       "mcsaab-data"
- gpios : gpio-names에 나열된 각 GPIO에 대해 GPIO 처리기를 제공해야합니다.

- gpio-names : 다음 문자열을 포함해야합니다.
       "cmt_apeslpx"
       "cmt_rst_rq"
       "cmt_en"
       "cmt_rst"
       "cmt_bsi"

- 인터럽트 : 모뎀의 재설정 표시를 위해 IRQ 핸들이 있어야합니다.



Example:

&ssi_port {
	modem: hsi-client {
		compatible = "nokia,n900-modem";

		pinctrl-names = "default";
		pinctrl-0 = <&modem_pins>;

		hsi-channel-ids = <0>, <1>, <2>, <3>;
		hsi-channel-names = "mcsaab-control",
				    "speech-control",
				    "speech-data",
				    "mcsaab-data";
		hsi-speed-kbps = <55000>;
		hsi-mode = "frame";
		hsi-flow = "synchronized";
		hsi-arb-mode = "round-robin";

		interrupts-extended = <&gpio3 8 IRQ_TYPE_EDGE_FALLING>; /* 72 */

		gpios = <&gpio3  6 GPIO_ACTIVE_HIGH>, /* 70 */
			<&gpio3  9 GPIO_ACTIVE_HIGH>, /* 73 */
			<&gpio3 10 GPIO_ACTIVE_HIGH>, /* 74 */
			<&gpio3 11 GPIO_ACTIVE_HIGH>, /* 75 */
			<&gpio5 29 GPIO_ACTIVE_HIGH>; /* 157 */
		gpio-names = "cmt_apeslpx",
			     "cmt_rst_rq",
			     "cmt_en",
			     "cmt_rst",
			     "cmt_bsi";
	};
};
```
