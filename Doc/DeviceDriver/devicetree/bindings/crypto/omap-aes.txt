## Doc/DeviceDriver/devicetree/bindings/display/brcm,bcm-vc4.txt
```
Broadcom VC4 (VideoCore4) GPU

The VC4 device present on the Raspberry Pi includes a display system
with HDMI output and the HVS (Hardware Video Scaler) for compositing
display planes.

Required properties for VC4:
- compatible:	Should be "brcm,bcm2835-vc4"

Required properties for Pixel Valve:
- compatible:	Should be one of "brcm,bcm2835-pixelvalve0",
		  "brcm,bcm2835-pixelvalve1", or "brcm,bcm2835-pixelvalve2"
- reg:		Physical base address and length of the PV's registers
- interrupts:	The interrupt number
		  See bindings/interrupt-controller/brcm,bcm2835-armctrl-ic.txt

Required properties for HVS:
- compatible:	Should be "brcm,bcm2835-hvs"
- reg:		Physical base address and length of the HVS's registers
- interrupts:	The interrupt number
		  See bindings/interrupt-controller/brcm,bcm2835-armctrl-ic.txt

Required properties for HDMI
- compatible:	Should be "brcm,bcm2835-hdmi"
- reg:		Physical base address and length of the two register ranges
		  ("HDMI" and "HD", in that order)
- interrupts:	The interrupt numbers
		  See bindings/interrupt-controller/brcm,bcm2835-armctrl-ic.txt
- ddc:		phandle of the I2C controller used for DDC EDID probing
- clocks:	a) hdmi: The HDMI state machine clock
		b) pixel: The pixel clock.

Optional properties for HDMI:
- hpd-gpios:	The GPIO pin for HDMI hotplug detect (if it doesn't appear
		  as an interrupt/status bit in the HDMI controller
		  itself).  See bindings/pinctrl/brcm,bcm2835-gpio.txt

Example:
pixelvalve@7e807000 {
	compatible = "brcm,bcm2835-pixelvalve2";
	reg = <0x7e807000 0x100>;
	interrupts = <2 10>; /* pixelvalve */
};

hvs@7e400000 {
	compatible = "brcm,bcm2835-hvs";
	reg = <0x7e400000 0x6000>;
	interrupts = <2 1>;
};

hdmi: hdmi@7e902000 {
	compatible = "brcm,bcm2835-hdmi";
	reg = <0x7e902000 0x600>,
	      <0x7e808000 0x100>;
	interrupts = <2 8>, <2 9>;
	ddc = <&i2c2>;
	hpd-gpios = <&gpio 46 GPIO_ACTIVE_HIGH>;
	clocks = <&clocks BCM2835_PLLH_PIX>,
		 <&clocks BCM2835_CLOCK_HSM>;
	clock-names = "pixel", "hdmi";
};

vc4: gpu {
	compatible = "brcm,bcm2835-vc4";
};


/*

Broadcom VC4 (VideoCore4) GPU

Raspberry Pi에있는 VC4 장치에는 HDMI 출력이있는 디스플레이 시스템과 디스플레이 평면을 합성하기위한 HVS (하드웨어 비디오 스케일러)가 있습니다.

VC4의 필수 속성 :
- 호환 가능 : "brcm, bcm2835-vc4"이어야합니다.

픽셀 밸브의 필수 속성 :
- 호환 : "brcm, bcm2835-ixelvalve0"중 하나 여야합니다.
"brcm, bcm2835-pixelvalve1"또는 "brcm, bcm2835-pixelvalve2"
- reg : PV의 레지스터의 물리적 인 기본 주소와 길이
- interrupts : 인터럽트 번호
bindings / interrupt-controller / brcm, bcm2835-armctrl-ic.txt를 참조하십시오.

HVS의 필수 속성 :
- 호환 가능 : "brcm, bcm2835-hvs"여야합니다.
- reg : HVS 레지스터의 물리적 인 기본 주소와 길이
- interrupts : 인터럽트 번호
bindings / interrupt-controller / brcm, bcm2835-armctrl-ic.txt를 참조하십시오.

HDMI의 필수 속성
- 호환 : "brcm, bcm2835-hdmi"여야합니다.
- reg : 두 개의 레지스터 범위의 물리적 기본 주소 및 길이
( "HDMI"및 "HD"순으로)
- 인터럽트 : 인터럽트 번호
bindings / interrupt-controller / brcm, bcm2835-armctrl-ic.txt를 참조하십시오.
- ddc : DDC EDID 프로빙에 사용되는 I2C 컨트롤러의 phandle
- 클럭 : a) hdmi : HDMI 상태 머신 클럭
b) 픽셀 : 픽셀 클럭.

HDMI의 선택적 속성 :
- hpd-gpios : HDMI 핫 플러그 ​​감지 용 GPIO 핀 (HDMI 컨트롤러 자체에 인터럽트 / 상태 비트로 나타나지 않는 경우). bindings / pinctrl / brcm, bcm2835-gpio.txt를 참조하십시오.

Example:
pixelvalve@7e807000 {
	compatible = "brcm,bcm2835-pixelvalve2";
	reg = <0x7e807000 0x100>;
	interrupts = <2 10>; /* pixelvalve */
};

hvs@7e400000 {
	compatible = "brcm,bcm2835-hvs";
	reg = <0x7e400000 0x6000>;
	interrupts = <2 1>;
};

hdmi: hdmi@7e902000 {
	compatible = "brcm,bcm2835-hdmi";
	reg = <0x7e902000 0x600>,
	      <0x7e808000 0x100>;
	interrupts = <2 8>, <2 9>;
	ddc = <&i2c2>;
	hpd-gpios = <&gpio 46 GPIO_ACTIVE_HIGH>;
	clocks = <&clocks BCM2835_PLLH_PIX>,
		 <&clocks BCM2835_CLOCK_HSM>;
	clock-names = "pixel", "hdmi";
};

vc4: gpu {
	compatible = "brcm,bcm2835-vc4";
};

*/
```

## Doc/DeviceDriver/devicetree/bindings/display/bridge/adi,adv7511.txt
```
Analog Device ADV7511(W)/13 HDMI Encoders
-----------------------------------------

The ADV7511, ADV7511W and ADV7513 are HDMI audio and video transmitters
compatible with HDMI 1.4 and DVI 1.0. They support color space conversion,
S/PDIF, CEC and HDCP.

Required properties:

- compatible: Should be one of "adi,adv7511", "adi,adv7511w" or "adi,adv7513"
- reg: I2C slave address

The ADV7511 supports a large number of input data formats that differ by their
color depth, color format, clock mode, bit justification and random
arrangement of components on the data bus. The combination of the following
properties describe the input and map directly to the video input tables of the
ADV7511 datasheet that document all the supported combinations.

- adi,input-depth: Number of bits per color component at the input (8, 10 or
  12).
- adi,input-colorspace: The input color space, one of "rgb", "yuv422" or
  "yuv444".
- adi,input-clock: The input clock type, one of "1x" (one clock cycle per
  pixel), "2x" (two clock cycles per pixel), "ddr" (one clock cycle per pixel,
  data driven on both edges).

The following input format properties are required except in "rgb 1x" and
"yuv444 1x" modes, in which case they must not be specified.

- adi,input-style: The input components arrangement variant (1, 2 or 3), as
  listed in the input format tables in the datasheet.
- adi,input-justification: The input bit justification ("left", "evenly",
  "right").

Optional properties:

- interrupts: Specifier for the ADV7511 interrupt
- pd-gpios: Specifier for the GPIO connected to the power down signal

- adi,clock-delay: Video data clock delay relative to the pixel clock, in ps
  (-1200 ps .. 1600 ps). Defaults to no delay.
- adi,embedded-sync: The input uses synchronization signals embedded in the
  data stream (similar to BT.656). Defaults to separate H/V synchronization
  signals.

Required nodes:

The ADV7511 has two video ports. Their connections are modelled using the OF
graph bindings specified in Documentation/devicetree/bindings/graph.txt.

- Video port 0 for the RGB or YUV input
- Video port 1 for the HDMI output


Example
-------

	adv7511w: hdmi@39 {
		compatible = "adi,adv7511w";
		reg = <39>;
		interrupt-parent = <&gpio3>;
		interrupts = <29 IRQ_TYPE_EDGE_FALLING>;

		adi,input-depth = <8>;
		adi,input-colorspace = "rgb";
		adi,input-clock = "1x";
		adi,input-style = <1>;
		adi,input-justification = "evenly";

		ports {
			#address-cells = <1>;
			#size-cells = <0>;

			port@0 {
				reg = <0>;
				adv7511w_in: endpoint {
					remote-endpoint = <&dpi_out>;
				};
			};

			port@1 {
				reg = <1>;
				adv7511_out: endpoint {
					remote-endpoint = <&hdmi_connector_in>;
				};
			};
		};
	};

/*
Analog Device ADV7511(W)/13 HDMI Encoders

ADV7511, ADV7511W 棺 ADV7513绰 HDMI 1.4 棺 DVI 1.0苞 龋券登绰 HDMI 坷叼坷 棺 厚叼坷 价脚扁涝聪促. 
祸 傍埃 函券, S / PDIF, CEC, HDCP甫 瘤盔窍绊 乐嚼聪促.

鞘荐 加己 :

- 龋券 : "adi, adv7511", "adi, adv7511w"肚绰 "adi, adv7513"吝 窍唱 咯具钦聪促.
- reg : I2C 浇饭捞宏 林家

ADV7511篮 阿扁 促弗 涝仿 单捞磐 器杆阑 瘤盔钦聪促.
祸惑 表捞, 祸惑 屈侥, 努废 葛靛, 厚飘 沥纺 棺 单捞磐 滚胶狼 备己 夸家 烙狼 硅摹 殿捞 乐嚼聪促.
促澜 漂己狼 炼钦篮 涝仿阑 汲疙窍绊 瘤盔登绰 葛电 炼钦阑 巩辑拳 茄 ADV7511 单捞磐 矫飘狼 
厚叼坷 涝仿 抛捞喉俊 流立 甘俏钦聪促.

- adi, input-depth : 涝仿俊辑 祸 备己 夸家 寸 厚飘 荐 (8, 10 肚绰
12).

- adi, input-colorspace : 涝仿 祸惑 傍埃, "rgb", "yuv422"肚绰
"yuv444".

- adi, input-clock : "1x"(侨伎 寸 1 努钒 荤捞努), 
"2x"(侨伎 寸 2 努钒 荤捞努) "ddr"(侨伎 寸 1 努废 荤捞努 俊瘤).

"rgb 1x"客 "yuv444 1x"葛靛甫 力寇窍绊 促澜狼 涝仿 屈侥狼 加己捞 鞘夸钦聪促.

- adi, input-style : 单捞磐 矫飘狼 涝仿 器杆 抛捞喉俊 扁犁登绢乐绰 涝仿 夸家狼 硅摹 函屈 (1,2 肚绰 3).
 - adi, input-justification : 涝仿 厚飘 沥纺 ( "left", "evenly", "right").

可记 加己 :
 - 牢磐反飘 : ADV7511 牢磐反飘 瘤沥磊
 - pd-gpios : 颇况 促款 脚龋俊 楷搬等 GPIO 瘤沥磊
 - adi 努钒 瘤楷 : 侨伎 努钒俊 措茄 厚叼坷 单捞磐 努钒 瘤楷 (ps (-1200 ps ... 1600 ps)). 扁夯利栏肺 瘤楷篮 绝嚼聪促.
- adi, embedded-sync : 涝仿 单捞磐 胶飘覆俊 器窃 等 悼扁 脚龋甫 荤侩钦聪促 (BT.656客 鞍捞). 扁夯利栏肺 H / V 悼扁 脚龋啊 盒府邓聪促.

鞘夸茄 畴靛 :
ADV7511绰 滴 俺狼 厚叼坷 器飘啊 乐嚼聪促. 弊 楷搬篮 Documentation / devicetree / bindings / graph.txt俊辑 瘤沥等 OF 弊贰橇 官牢爹阑 荤侩窍咯 葛胆傅邓聪促.
 - RGB 肚绰 YUV 涝仿狼 厚叼坷 器飘 0
 - HDMI 免仿 厚叼坷 器飘 1

Example

	adv7511w: hdmi@39 {
		compatible = "adi,adv7511w";
		reg = <39>;
		interrupt-parent = <&gpio3>;
		interrupts = <29 IRQ_TYPE_EDGE_FALLING>;

		adi,input-depth = <8>;
		adi,input-colorspace = "rgb";
		adi,input-clock = "1x";
		adi,input-style = <1>;
		adi,input-justification = "evenly";

		ports {
			#address-cells = <1>;
			#size-cells = <0>;

			port@0 {
				reg = <0>;
				adv7511w_in: endpoint {
					remote-endpoint = <&dpi_out>;
				};
			};

			port@1 {
				reg = <1>;
				adv7511_out: endpoint {
					remote-endpoint = <&hdmi_connector_in>;
				};
			};
		};
	};


*/
```

## Doc/DeviceDriver/devicetree/bindings/display/bridge/tda998x.txt
```
Device-Tree bindings for the NXP TDA998x HDMI transmitter

Required properties;
  - compatible: must be "nxp,tda998x"

  - reg: I2C address

Optional properties:
  - interrupts: interrupt number and trigger type
	default: polling

  - pinctrl-0: pin control group to be used for
	screen plug/unplug interrupt.

  - pinctrl-names: must contain a "default" entry.

  - video-ports: 24 bits value which defines how the video controller
	output is wired to the TDA998x input - default: <0x230145>

  - audio-ports: array of 8-bit values, 2 values per one DAI[1].
	The first value defines the DAI type: TDA998x_SPDIF or TDA998x_I2S[2].
	The second value defines the tda998x AP_ENA reg content when the DAI
	in question is used. The implementation allows one or two DAIs. If two
	DAIs are defined, they must be of different type.

[1] Documentation/sound/alsa/soc/DAI.txt
[2] include/dt-bindings/display/tda998x.h

Example:

#include <dt-bindings/display/tda998x.h>

	tda998x: hdmi-encoder {
		compatible = "nxp,tda998x";
		reg = <0x70>;
		interrupt-parent = <&gpio0>;
		interrupts = <27 2>;		/* falling edge */
		pinctrl-0 = <&pmx_camera>;
		pinctrl-names = "default";
		video-ports = <0x230145>;

		#sound-dai-cells = <2>;
			     /*	DAI-format	AP_ENA reg value */
		audio-ports = <	TDA998x_SPDIF	0x04
				TDA998x_I2S	0x03>;

	};

/*
NXP TDA998x HDMI 价脚扁狼 厘摹 飘府 官牢爹

鞘荐 加己;
- 龋券 啊瓷 : "nxp, tda998x"咯具钦聪促.


- 殿废 : I2C 林家

可记 加己 :
- 牢磐反飘 : 牢磐反飘 锅龋客 飘府芭 蜡屈

扁夯蔼 : 弃傅

 - pinctrl-0 : 胶农赴 敲矾弊 / 攫敲矾弊 牢磐反飘俊 荤侩窍绰 巧 力绢 弊缝.

- pinctrl-names : "default"亲格阑 器窃秦具钦聪促.

- video-ports : 厚叼坷 牧飘费矾狼 沥狼 规过阑 沥狼窍绰 24 厚飘 蔼

"扁夯"亲格.

- 厚叼坷 器飘 : 厚叼坷 牧飘费矾狼 沥狼 规过阑 沥狼窍绰 24 厚飘 蔼
免仿篮 TDA998x 涝仿 - 扁夯蔼 : <0x230145>

- audio-ports : 8 厚飘 蔼狼 硅凯 茄 DAI [1] 寸 2 俺狼 蔼.

霉 锅掳 蔼篮 DAI 蜡屈阑 沥狼钦聪促 : TDA998x_SPDIF 肚绰 TDA998x_I2S [2].

蔼篮 DAI 蜡屈阑 沥狼钦聪促 (TDA998x_SPDIF 肚绰 TDA998x_I2S [2]).

滴 锅掳 蔼篮 tda998x AP_ENA reg甫 沥狼钦聪促.

滴 锅掳 蔼篮 巩力狼 DAI啊 荤侩登绰 版快狼 tda998x AP_ENA reg狼 郴侩阑 沥狼钦聪促. 

捞 备泅篮 窍唱 肚绰 滴 俺狼 DAI啊 倾侩邓聪促. 

滴 DAI啊 沥狼登绢乐绰 版快 促弗 蜡屈捞绢具钦聪促.

Example:

#include <dt-bindings/display/tda998x.h>

	tda998x: hdmi-encoder {
		compatible = "nxp,tda998x";
		reg = <0x70>;
		interrupt-parent = <&gpio0>;
		interrupts = <27 2>;		

/* falling edge */
		pinctrl-0 = <&pmx_camera>;
		pinctrl-names = "default";
		

video-ports = <0x230145>;

		#sound-dai-cells = <2>;
			     /*	DAI-format	AP_ENA reg 

value */
		audio-ports = <	TDA998x_SPDIF	0x04
				TDA998x_I2S	0x03>;

	};

*/
```

## Doc/DeviceDriver/devicetree/bindings/display/bridge/thine,thc63lvdm83d.txt
```
THine Electronics THC63LVDM83D LVDS serializer
----------------------------------------------

The THC63LVDM83D is an LVDS serializer designed to support pixel data
transmission between a host and a flat panel.

Required properties:

- compatible: Should be "thine,thc63lvdm83d"

Optional properties:

- pwdn-gpios: Power down control GPIO

Required nodes:

The THC63LVDM83D has two video ports. Their connections are modeled using the
OFgraph bindings specified in Documentation/devicetree/bindings/graph.txt.

- Video port 0 for CMOS/TTL input
- Video port 1 for LVDS output


Example
-------

	lvds_enc: encoder@0 {
		compatible = "thine,thc63lvdm83d";

		ports {
			#address-cells = <1>;
			#size-cells = <0>;

			port@0 {
				reg = <0>;

				lvds_enc_in: endpoint@0 {
					remote-endpoint = <&rgb_out>;
				};
			};

			port@1 {
				reg = <1>;

				lvds_enc_out: endpoint@0 {
					remote-endpoint = <&panel_in>;
				};
			};
		};
	};


/*
THine Electronics THC63LVDM83D LVDS 矫府倔 扼捞历
----------------------------------------------

THC63LVDM83D绰 龋胶飘客 乞搁 菩澄 埃狼 侨伎 单捞磐 傈价阑 瘤盔窍档废 汲拌等 LVDS 矫府倔 扼捞历涝聪促.


鞘荐 加己 :

- 龋券 : "thine, thc63lvdm83d"咯具钦聪促.

急琶利 加己 :

- pwdn-gpios : 傈盔 力绢 GPIO

鞘荐 畴靛 :

THC63LVDM83D俊绰 2 俺狼 厚叼坷 器飘啊 乐嚼聪促. 
弊 楷搬篮 Documentation / devicetree / bindings / graph.txt俊辑 瘤沥等 OFgraph 官牢爹阑 荤侩窍咯 葛胆傅邓聪促.

- CMOS / TTL 涝仿阑困茄 厚叼坷 器飘 0
- LVDS 免仿阑困茄 厚叼坷 器飘 1


Example
-------

	lvds_enc: encoder@0 {
		compatible = "thine,thc63lvdm83d";

		ports {
			#address-cells = <1>;
			#size-cells = <0>;

			port@0 {
				reg = <0>;

				lvds_enc_in: endpoint@0 {
					remote-endpoint = <&rgb_out>;
				};
			};

			port@1 {
				reg = <1>;

				lvds_enc_out: endpoint@0 {
					remote-endpoint = <&panel_in>;
				};
			};
		};
	};

*/
```

## Doc/DeviceDriver/devicetree/bindings/display/cirrus,clps711x-fb.txt
```
* Currus Logic CLPS711X Framebuffer

Required properties:
- compatible: Shall contain "cirrus,clps711x-fb".
- reg       : Physical base address and length of the controller's registers +
              location and size of the framebuffer memory.
- clocks    : phandle + clock specifier pair of the FB reference clock.
- display   : phandle to a display node as described in
              Documentation/devicetree/bindings/display/display-timing.txt.
              Additionally, the display node has to define properties:
  - bits-per-pixel: Bits per pixel.
  - ac-prescale   : LCD AC bias frequency. This frequency is the required
                    AC bias frequency for a given manufacturer's LCD plate.
  - cmap-invert   : Invert the color levels (Optional).

Optional properties:
- lcd-supply: Regulator for LCD supply voltage.

Example:
	fb: fb@800002c0 {
		compatible = "cirrus,ep7312-fb", "cirrus,clps711x-fb";
		reg = <0x800002c0 0xd44>, <0x60000000 0xc000>;
		clocks = <&clks 2>;
		lcd-supply = <&reg5v0>;
		display = <&display>;
	};

	display: display {
		model = "320x240x4";
		native-mode = <&timing0>;
		bits-per-pixel = <4>;
		ac-prescale = <17>;

		display-timings {
			timing0: 320x240 {
				hactive = <320>;
				hback-porch = <0>;
				hfront-porch = <0>;
				hsync-len = <0>;
				vactive = <240>;
				vback-porch = <0>;
				vfront-porch = <0>;
				vsync-len = <0>;
				clock-frequency = <6500000>;
			};
		};
	};

/*

* Currus Logic CLPS711X 프레임 버퍼

필수 속성 :
- compatible : "cirrus, clps711x-fb"를 포함해야합니다.
- reg : 컨트롤러의 레지스터의 실제 기본 주소 및 길이 +
              프레임 버퍼 메모리의 위치 및 크기.
- 클록 : FB 기준 클록의 phandle + 클럭 지정자 쌍.
- 디스플레이 : 설명 된 바와 같이 디스플레이 노드에 연결
              Documentation / devicetree / bindings / display / display-timing.txt.
              또한 디스플레이 노드는 속성을 정의해야합니다.
  - 비트 / 픽셀 : 픽셀 당 비트.
  - ac-prescale : LCD AC 바이어스 주파수. 이 주파수는 주어진 제조업체의 LCD 플레이트에 필요한 AC 바이어스 주파수입니다.
  - cmap-invert : 색상 레벨을 뒤집습니다 (선택 사항).

선택적 속성 :
- LCD 전원 : LCD 전원 전압 레귤레이터.



Example:
	fb: fb@800002c0 {
		compatible = "cirrus,ep7312-fb", "cirrus,clps711x-fb";
		reg = <0x800002c0 0xd44>, <0x60000000 0xc000>;
		clocks = <&clks 2>;
		lcd-supply = <&reg5v0>;
		display = <&display>;
	};

	display: display {
		model = "320x240x4";
		native-mode = <&timing0>;
		bits-per-pixel = <4>;
		ac-prescale = <17>;

		display-timings {
			timing0: 320x240 {
				hactive = <320>;
				hback-porch = <0>;
				hfront-porch = <0>;
				hsync-len = <0>;
				vactive = <240>;
				vback-porch = <0>;
				vfront-porch = <0>;
				vsync-len = <0>;
				clock-frequency = <6500000>;
			};
		};
	};


*/
```
