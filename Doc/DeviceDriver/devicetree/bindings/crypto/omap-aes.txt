## Doc/DeviceDriver/devicetree/bindings/display/exynos/samsung-fimd.txt
```
Device-Tree bindings for Samsung SoC display controller (FIMD)

FIMD (Fully Interactive Mobile Display) is the Display Controller for the
Samsung series of SoCs which transfers the image data from a video memory
buffer to an external LCD interface.

Required properties:
- compatible: value should be one of the following
		"samsung,s3c2443-fimd"; /* for S3C24XX SoCs */
		"samsung,s3c6400-fimd"; /* for S3C64XX SoCs */
		"samsung,s5pv210-fimd"; /* for S5PV210 SoC */
		"samsung,exynos3250-fimd"; /* for Exynos3250/3472 SoCs */
		"samsung,exynos4210-fimd"; /* for Exynos4 SoCs */
		"samsung,exynos4415-fimd"; /* for Exynos4415 SoC */
		"samsung,exynos5250-fimd"; /* for Exynos5 SoCs */

- reg: physical base address and length of the FIMD registers set.

- interrupt-parent: should be the phandle of the fimd controller's
		parent interrupt controller.

- interrupts: should contain a list of all FIMD IP block interrupts in the
		 order: FIFO Level, VSYNC, LCD_SYSTEM. The interrupt specifier
		 format depends on the interrupt controller used.

- interrupt-names: should contain the interrupt names: "fifo", "vsync",
	"lcd_sys", in the same order as they were listed in the interrupts
        property.

- pinctrl-0: pin control group to be used for this controller.

- pinctrl-names: must contain a "default" entry.

- clocks: must include clock specifiers corresponding to entries in the
         clock-names property.

- clock-names: list of clock names sorted in the same order as the clocks
               property. Must contain "sclk_fimd" and "fimd".

Optional Properties:
- power-domains: a phandle to FIMD power domain node.
- samsung,invert-vden: video enable signal is inverted
- samsung,invert-vclk: video clock signal is inverted
- display-timings: timing settings for FIMD, as described in document [1].
		Can be used in case timings cannot be provided otherwise
		or to override timings provided by the panel.
- samsung,sysreg: handle to syscon used to control the system registers
- i80-if-timings: timing configuration for lcd i80 interface support.
  - cs-setup: clock cycles for the active period of address signal is enabled
              until chip select is enabled.
              If not specified, the default value(0) will be used.
  - wr-setup: clock cycles for the active period of CS signal is enabled until
              write signal is enabled.
              If not specified, the default value(0) will be used.
  - wr-active: clock cycles for the active period of CS is enabled.
               If not specified, the default value(1) will be used.
  - wr-hold: clock cycles for the active period of CS is disabled until write
             signal is disabled.
             If not specified, the default value(0) will be used.

  The parameters are defined as:

    VCLK(internal)  __|??????|_____|??????|_____|??????|_____|??????|_____|??
                      :            :            :            :            :
    Address Output  --:<XXXXXXXXXXX:XXXXXXXXXXXX:XXXXXXXXXXXX:XXXXXXXXXXXX:XX
                      | cs-setup+1 |            :            :            :
                      |<---------->|            :            :            :
    Chip Select     ???????????????|____________:____________:____________|??
                                   | wr-setup+1 |            | wr-hold+1  |
                                   |<---------->|            |<---------->|
    Write Enable    ????????????????????????????|____________|???????????????
                                                | wr-active+1|
                                                |<---------->|
    Video Data      ----------------------------<XXXXXXXXXXXXXXXXXXXXXXXXX>--

The device node can contain 'port' child nodes according to the bindings defined
in [2]. The following are properties specific to those nodes:
- reg: (required) port index, can be:
		0 - for CAMIF0 input,
		1 - for CAMIF1 input,
		2 - for CAMIF2 input,
		3 - for parallel output,
		4 - for write-back interface

[1]: Documentation/devicetree/bindings/display/display-timing.txt
[2]: Documentation/devicetree/bindings/media/video-interfaces.txt

Example:

SoC specific DT entry:

	fimd@11c00000 {
		compatible = "samsung,exynos4210-fimd";
		interrupt-parent = <&combiner>;
		reg = <0x11c00000 0x20000>;
		interrupt-names = "fifo", "vsync", "lcd_sys";
		interrupts = <11 0>, <11 1>, <11 2>;
		clocks = <&clock 140>, <&clock 283>;
		clock-names = "sclk_fimd", "fimd";
		power-domains = <&pd_lcd0>;
		status = "disabled";
	};

Board specific DT entry:

	fimd@11c00000 {
		pinctrl-0 = <&lcd_clk &lcd_data24 &pwm1_out>;
		pinctrl-names = "default";
		status = "okay";
	};


/*
伙己 SoC 叼胶敲饭捞 牧飘费矾 (FIMD) 侩 叼官捞胶 飘府 官牢爹

FIMD (Fully Interactive Mobile Display)绰 厚叼坷 皋葛府俊辑 捞固瘤 单捞磐甫 傈价窍绰 SoC 矫府令狼 叼胶敲饭捞 牧飘费矾涝聪促
滚欺甫 寇何 LCD 牢磐其捞胶俊 楷搬钦聪促.

鞘荐 加己 :
- compatible : value绰 促澜 吝 窍唱 咯具钦聪促.
"samsung, s3c2443-fimd"; / * S3C24XX SoC 侩 * /
"samsung, s3c6400-fimd"; / * S3C64XX SoC 侩 * /
"伙己, s5pv210-fimd"; / * S5PV210 SoC * /
"samsung, exynos3250-fimd"; / * Exynos3250 / 3472 SoC 侩 * /
"samsung, exynos4210-fimd"; / * Exynos4 SoC 侩 * /
"samsung, exynos4415-fimd"; / * Exynos4415 SoC * /
"samsung, exynos5250-fimd"; / * Exynos5 SoC 侩 * /

- reg : FIMD 饭瘤胶磐 技飘狼 拱府利 扁夯 林家 棺 辨捞涝聪促.

- interrupt-parent : fimd 牧飘费矾狼 惑困 牢磐反飘 牧飘费矾狼 phandle捞绢具钦聪促.

- 牢磐反飘 : FIFO 饭骇, VSYNC, LCD_SYSTEM 鉴辑肺 葛电 FIMD IP 喉废 牢磐反飘 格废阑 器窃秦具钦聪促. 

牢磐反飘 瘤沥磊 屈侥篮 荤侩 等 牢磐反飘 牧飘费矾俊 蝶扼 促辅聪促.

- interrupt-names : interrupts 加己俊 唱凯等 鉴辑措肺 "fifo", "vsync", "lcd_sys"客 鞍篮 牢磐反飘 捞抚阑 器窃秦具钦聪促.

- pinctrl-0 :捞 牧飘费矾俊 荤侩且 巧 牧飘费 弊缝.

- pinctrl-names : "扁夯"亲格阑 器窃秦具钦聪促.

- clocks : clock-names 加己狼 亲格俊 秦寸窍绰 努钒 瘤沥磊甫 器窃秦具钦聪促.

- clock-names : 努钒 捞抚苞 鞍篮 鉴辑肺 沥纺 等 努钒 捞抚 格废. "sclk_fimd"棺 "fimd"甫 器窃秦具钦聪促.

急琶利 加己 :

- 傈仿 档皋牢 : FIMD 傈仿 档皋牢 畴靛俊 措茄 phandle涝聪促.

- samsung, invert-vden : 厚叼坷 牢 俊捞喉 脚龋啊 馆傈 凳

- samsung, invert-vclk : 厚叼坷 努钒 脚龋啊 馆傈 凳

- 叼胶敲饭捞 鸥捞怪 : 巩辑 [1]俊辑 汲疙茄 FIMD狼 鸥捞怪 汲沥.

鸥捞怪阑 崔府 力傍窍芭唱 菩澄俊辑 力傍窍绰 鸥捞怪阑 公矫且 荐绝绰 版快 荤侩且 荐 乐嚼聪促.

- samsung, sysreg : 矫胶袍 饭瘤胶磐甫 力绢窍绰 单 荤侩登绰 syscon 勤甸

- i80-if-timing : lcd i80 牢磐其捞胶 瘤盔阑困茄 鸥捞怪 备己.

- cs-setup : 抹 急琶捞 劝己拳 瞪 锭鳖瘤 林家 脚龋狼 劝己 扁埃俊 措茄 努废 荤捞努捞 劝己拳邓聪促.

瘤沥窍瘤 臼栏搁 扁夯蔼 (0)捞 荤侩邓聪促.

- wr-setup : 静扁 脚龋啊 劝己拳 瞪 锭鳖瘤 CS 脚龋狼 劝己 扁埃俊 措茄 努钒 荤捞努捞 劝己拳邓聪促.

瘤沥窍瘤 臼栏搁 扁夯蔼 (0)捞 荤侩邓聪促.

- wr-active : CS狼 劝己 扁埃俊 措茄 努钒 荤捞努捞 劝己拳邓聪促.

瘤沥窍瘤 臼栏搁 扁夯蔼 (1)捞 荤侩邓聪促.

- wr-hold : 静扁 脚龋啊 厚劝己拳 瞪 锭鳖瘤 CS狼 劝己 扁埃俊 措茄 努钒 荤捞努捞 厚劝己拳邓聪促.

瘤沥窍瘤 臼栏搁 扁夯蔼 (0)捞 荤侩邓聪促.

概俺 函荐绰 促澜苞 鞍捞 沥狼邓聪促.

????VCLK (郴何) __ | ?????? | _____ | ?????? | _____ | ?????? | _____ | ?????? | _____ | ??
??????????????????????: : : : :
????林家 免仿 - : <XXXXXXXXXXX : XXXXXXXXXXXX : XXXXXXXXXXXX : XXXXXXXXXXXX : XX
??????????????????????| CS 汲摹 + 1 | : : :
??????????????????????| <----------> | : : :
????抹 急琶 ????????????? | | ____________ : ____________ : ____________ | ??
???????????????????????????????????| wr-setup + 1 | | wr-hold + 1 |
???????????????????????????????????| <----------> | | <----------> |
????静扁 啊瓷 ?????????????????????????????? | | ____________ | ?????????????
????????????????????????????????????????????????| wr 劝己 + 1 |
????????????????????????????????????????????????| <----------> |
????厚叼坷 单捞磐 ---------------------------- <XXXXXXXXXXXXXXXXXXXXXXXXX> -


厘摹 畴靛绰 [2]俊辑 沥狼 等 官牢爹俊 蝶扼 '器飘'磊侥 畴靛甫 器窃 且 荐 乐嚼聪促. 

促澜篮 秦寸 畴靛俊 漂沥茄 殿废 沥焊涝聪促.

- reg : (鞘荐) 器飘 牢郸胶绰 促澜苞 鞍嚼聪促.

0 - CAMIF0 涝仿狼 版快,
1 - CAMIF1 涝仿狼 版快,
2 - CAMIF2 涝仿狼 版快,
3 - 捍纺 免仿狼 版快,
4 - write-back 牢磐其捞胶

[1] : Documentation / devicetree / bindings / display / display-timing.txt
[2] : Documentation / devicetree / bindings / media / video-interfaces.txt


Example:

SoC specific DT entry:

	fimd@11c00000 {
		compatible = "samsung,exynos4210-fimd";
		interrupt-parent = <&combiner>;
		reg = <0x11c00000 0x20000>;
		interrupt-names = "fifo", "vsync", "lcd_sys";
		interrupts = <11 0>, <11 1>, <11 2>;
		clocks = <&clock 140>, <&clock 283>;
		clock-names = "sclk_fimd", "fimd";
		power-domains = <&pd_lcd0>;
		status = "disabled";
	};

Board specific DT entry:

	fimd@11c00000 {
		pinctrl-0 = <&lcd_clk &lcd_data24 &pwm1_out>;
		pinctrl-names = "default";
		status = "okay";
	};

*/
```

## Doc/DeviceDriver/devicetree/bindings/display/fsl,dcu.txt
```
Device Tree bindings for Freescale DCU DRM Driver

Required properties:
- compatible:		Should be one of
	* "fsl,ls1021a-dcu".
	* "fsl,vf610-dcu".

- reg:			Address and length of the register set for dcu.
- clocks:		From common clock binding: handle to dcu clock.
- clock-names:		From common clock binding: Shall be "dcu".
- big-endian		Boolean property, LS1021A DCU registers are big-endian.
- fsl,panel:		The phandle to panel node.

Examples:
dcu: dcu@2ce0000 {
	compatible = "fsl,ls1021a-dcu";
	reg = <0x0 0x2ce0000 0x0 0x10000>;
	clocks = <&platform_clk 0>;
	clock-names = "dcu";
	big-endian;
	fsl,panel = <&panel>;
};

/*

橇府 胶纳老 DCU DRM 靛扼捞滚甫困茄 叼官捞胶 飘府 官牢爹

鞘荐 加己 :
- 龋券 啊瓷 : 促澜 吝 窍唱 咯具钦聪促.
* "fsl, ls1021a-dcu".
* "fsl, vf610-dcu".

- reg : dcu俊 汲沥等 饭瘤胶磐狼 林家客 辨捞.
- 努钒 : 傍烹 努废 官牢爹俊辑 : dcu 努钒栏肺 贸府钦聪促.
- clock-names : 傍烹 矫拌 官牢爹俊辑 : "dcu"啊登绢具钦聪促.
- big-endian Boolean property, LS1021A DCU 饭瘤胶磐绰 big-endian涝聪促.
- fsl, panel : 菩澄 畴靛俊 措茄 phandle.

Examples:
dcu: dcu@2ce0000 {
	compatible = "fsl,ls1021a-dcu";
	reg = <0x0 0x2ce0000 0x0 0x10000>;
	clocks = <&platform_clk 0>;
	clock-names = "dcu";
	big-endian;
	fsl,panel = <&panel>;
};

*/
```

## Doc/DeviceDriver/devicetree/bindings/display/imx/fsl,imx-fb.txt
```
Freescale imx21 Framebuffer

This framebuffer driver supports devices imx1, imx21, imx25, and imx27.

Required properties:
- compatible : "fsl,<chip>-fb", chip should be imx1 or imx21
- reg : Should contain 1 register ranges(address and length)
- interrupts : One interrupt of the fb dev

Required nodes:
- display: Phandle to a display node as described in
	Documentation/devicetree/bindings/display/display-timing.txt
	Additional, the display node has to define properties:
	- bits-per-pixel: Bits per pixel
	- fsl,pcr: LCDC PCR value

Optional properties:
- lcd-supply: Regulator for LCD supply voltage.
- fsl,dmacr: DMA Control Register value. This is optional. By default, the
	register is not modified as recommended by the datasheet.
- fsl,lpccr: Contrast Control Register value. This property provides the
	default value for the contrast control register.
	If that property is omitted, the register is zeroed.
- fsl,lscr1: LCDC Sharp Configuration Register value.

Example:

	imxfb: fb@10021000 {
		compatible = "fsl,imx21-fb";
		interrupts = <61>;
		reg = <0x10021000 0x1000>;
		display = <&display0>;
	};

	...

	display0: display0 {
		model = "Primeview-PD050VL1";
		native-mode = <&timing_disp0>;
		bits-per-pixel = <16>;
		fsl,pcr = <0xf0c88080>;	/* non-standard but required */
		display-timings {
			timing_disp0: 640x480 {
				hactive = <640>;
				vactive = <480>;
				hback-porch = <112>;
				hfront-porch = <36>;
				hsync-len = <32>;
				vback-porch = <33>;
				vfront-porch = <33>;
				vsync-len = <2>;
				clock-frequency = <25000000>;
			};
		};
	};

/*
橇府 胶纳老 imx21 橇饭烙 滚欺

捞 橇饭烙 滚欺 靛扼捞滚绰 厘摹 imx1, imx21, imx25 棺 imx27阑 瘤盔钦聪促.

鞘荐 加己 :
- 龋券 : "fsl, <chip> -fb", 抹篮 imx1 肚绰 imx21捞绢具 窃
- reg : 1 俺狼 饭瘤胶磐 裹困 (林家客 辨捞)甫 器窃秦具 窃.
- 牢磐反飘 : fb dev狼 茄 牢磐反飘

鞘荐 畴靛 :
- display : Documentation / devicetree / bindings / display / display-timing.txt俊 汲疙 等 巴贸烦 叼胶敲饭捞 畴靛肺 phandle阑 楷搬钦聪促.
眠啊肺, 钎矫 畴靛绰 漂己阑 沥狼秦具钦聪促.
- 侨伎 寸 厚飘 荐 : 侨伎 寸 厚飘 荐
- fsl, pcr : LCDC PCR 蔼

急琶利 加己 :
- LCD 傈盔 : LCD 傈盔 傈拘 饭敝饭捞磐.
- fsl, dmacr : DMA 力绢 饭瘤胶磐 蔼. 捞巴篮 急琶 荤亲涝聪促. 
扁夯利栏肺 饭瘤胶磐绰 单捞磐 矫飘俊辑 鼻厘 茄措肺 荐沥登瘤 臼嚼聪促.
- fsl, lpccr : Contrast Control Register 蔼涝聪促. 捞 加己篮 措厚 牧飘费 饭瘤胶磐狼 扁夯蔼阑 力傍钦聪促.
秦寸 加己阑 积帆窍搁 饭瘤胶磐啊 0涝聪促.
- fsl, lscr1 : LCDC 箕橇 汲沥 饭瘤胶磐 蔼.

Example:

	imxfb: fb@10021000 {
		compatible = "fsl,imx21-fb";
		interrupts = <61>;
		reg = <0x10021000 0x1000>;
		display = <&display0>;
	};

	...

	display0: display0 {
		model = "Primeview-PD050VL1";
		native-mode = <&timing_disp0>;
		bits-per-pixel = <16>;
		fsl,pcr = <0xf0c88080>;	/* non-standard but required */
		display-timings {
			timing_disp0: 640x480 {
				hactive = <640>;
				vactive = <480>;
				hback-porch = <112>;
				hfront-porch = <36>;
				hsync-len = <32>;
				vback-porch = <33>;
				vfront-porch = <33>;
				vsync-len = <2>;
				clock-frequency = <25000000>;
			};
		};
	};

*/
```
