## Doc/DeviceDriver/devicetree/bindings/crypto/omap-aes.txt
```
OMAP SoC AES crypto Module

Required properties:

- compatible : Should contain entries for this and backward compatible
  AES versions:
  - "ti,omap2-aes" for OMAP2.
  - "ti,omap3-aes" for OMAP3.
  - "ti,omap4-aes" for OMAP4 and AM33XX.
  Note that the OMAP2 and 3 versions are compatible (OMAP3 supports
  more algorithms) but they are incompatible with OMAP4.
- ti,hwmods: Name of the hwmod associated with the AES module
- reg : Offset and length of the register set for the module
- interrupts : the interrupt-specifier for the AES module.

Optional properties:
- dmas: DMA specifiers for tx and rx dma. See the DMA client binding,
	Documentation/devicetree/bindings/dma/dma.txt
- dma-names: DMA request names should include "tx" and "rx" if present.



필수 속성 :

- compatible :이 버전과 역 호환이 가능한 AES 버전에 대한 항목을 포함해야합니다.
 - OMAP2의 경우 "ti, omap2-aes".
   - OMAP3의 경우 "ti, omap3-aes"
   - OMAP4 및 AM33XX의 경우 "ti, omap4-aes"
OMAP2 및 3 버전은 호환 가능하지만 (OMAP3은 더 많은 알고리즘을 지원함) OMAP4와 호환되지 않습니다.
- ti, hwmods : AES 모듈과 연관된 hwmod의 이름
- reg : 모듈에 설정된 레지스터 오프셋 및 길이
- interrupts : AES 모듈의 인터럽트 지정자.

선택적 속성 :
- dmas : tx 및 rx dma에 대한 DMA 지정자입니다. DMA 클라이언트 바인딩 문서 / devicetree / bindings / dma / dma.txt를 참조하십시오.
- dma-names : DMA 요청 names 은 "tx"와 "rx"를 포함해야합니다.


Example:
	/* AM335x */
	aes: aes@53500000 {
		compatible = "ti,omap4-aes";
		ti,hwmods = "aes";
		reg = <0x53500000 0xa0>;
		interrupts = <102>;
		dmas = <&edma 6>,
		       <&edma 5>;
		dma-names = "tx", "rx";
	};
```

## Doc/DeviceDriver/devicetree/bindings/crypto/omap-des.txt
```
OMAP SoC DES crypto Module

Required properties:

- compatible : Should contain "ti,omap4-des"
- ti,hwmods: Name of the hwmod associated with the DES module
- reg : Offset and length of the register set for the module
- interrupts : the interrupt-specifier for the DES module
- clocks : A phandle to the functional clock node of the DES module
           corresponding to each entry in clock-names
- clock-names : Name of the functional clock, should be "fck"

Optional properties:
- dmas: DMA specifiers for tx and rx dma. See the DMA client binding,
	Documentation/devicetree/bindings/dma/dma.txt
	Each entry corresponds to an entry in dma-names
- dma-names: DMA request names should include "tx" and "rx" if present


필수 속성 :

- compatible : "ti, omap4-des"를 포함해야합니다.
- ti, hwmods : DES 모듈과 연관된 hwmod의 이름
- reg : 모듈에 설정된 레지스터 오프셋 및 길이
- interrupts : DES 모듈의 인터럽트 지정자
- 클럭 : clock-name의 각 항목에 해당하는 DES 모듈의 기능 클록 노드에 대한 phandle
- clock-names : 기능 클록의 이름으로 "fck"여야합니다.

선택적 속성 :
- dmas : tx 및 rx dma에 대한 DMA 지정자입니다. DMA 클라이언트 바인딩 문서 / devicetree / bindings / dma / dma.txt를 참조하십시오.
각 항목은 dma-names의 항목에 해당합니다.
- dma-names : DMA 요청 이름은 "tx"및 "rx"(있는 경우)를 포함해야합니다.





Example:
	/* DRA7xx SoC */
	des: des@480a5000 {
		compatible = "ti,omap4-des";
		ti,hwmods = "des";
		reg = <0x480a5000 0xa0>;
		interrupts = <GIC_SPI 82 IRQ_TYPE_LEVEL_HIGH>;
		dmas = <&sdma 117>, <&sdma 116>;
		dma-names = "tx", "rx";
		clocks = <&l3_iclk_div>;
		clock-names = "fck";
	};
```

## Doc/DeviceDriver/devicetree/bindings/crypto/omap-sham.txt
```
OMAP SoC SHA crypto Module

Required properties:

- compatible : Should contain entries for this and backward compatible
  SHAM versions:
  - "ti,omap2-sham" for OMAP2 & OMAP3.
  - "ti,omap4-sham" for OMAP4 and AM33XX.
  - "ti,omap5-sham" for OMAP5, DRA7 and AM43XX.
- ti,hwmods: Name of the hwmod associated with the SHAM module
- reg : Offset and length of the register set for the module
- interrupts : the interrupt-specifier for the SHAM module.

Optional properties:
- dmas: DMA specifiers for the rx dma. See the DMA client binding,
	Documentation/devicetree/bindings/dma/dma.txt
- dma-names: DMA request name. Should be "rx" if a dma is present.


필수 속성 :

- 호환 :이 항목과 이전 버전과의 호환 가능 항목을 포함해야합니다.
   SHAM 버전 :
   - OMAP2 & OMAP3의 경우 "ti, omap2-sham"
   - OMAP4 및 AM33XX의 경우 "ti, omap4-sham"
   - OMAP5, DRA7 및 AM43XX의 경우 "ti, omap5-sham"
- ti, hwmods : SHAM 모듈과 연관된 hwmod의 이름
- reg : 모듈에 설정된 레지스터 오프셋 및 길이
- interrupts : SHAM 모듈의 인터럽트 지정자.


선택적 속성 :
- dmas : rx dma에 대한 DMA 지정자. DMA 클라이언트 바인딩 Documentation / devicetree / bindings / dma / dma.txt를 참조하십시오.
- dma-names : DMA 요청 이름입니다. dma가 있으면 "rx"이어야합니다.










Example:
	/* AM335x */
	sham: sham@53100000 {
		compatible = "ti,omap4-sham";
		ti,hwmods = "sham";
		reg = <0x53100000 0x200>;
		interrupts = <109>;
		dmas = <&edma 36>;
		dma-names = "rx";
	};
```

## Doc/DeviceDriver/devicetree/bindings/crypto/picochip-spacc.txt
```
Picochip picoXcell SPAcc (Security Protocol Accelerator) bindings

Picochip picoXcell devices contain crypto offload engines that may be used for
IPSEC and femtocell layer 2 ciphering.

Required properties:
  - compatible : "picochip,spacc-ipsec" for the IPSEC offload engine
    "picochip,spacc-l2" for the femtocell layer 2 ciphering engine.
  - reg : Offset and length of the register set for this device
  - interrupt-parent : The interrupt controller that controls the SPAcc
    interrupt.
  - interrupts : The interrupt line from the SPAcc.
  - ref-clock : The input clock that drives the SPAcc.

Picochip picoXcell 장치는 IPSEC 및 펨토 셀 2 계층 암호화에 사용될 수있는 암호화 오프로드 엔진을 포함합니다.

필수 속성 :
   - 호환 가능 : 펨토 셀 계층 2 암호화 엔진을위한 IPSEC 오프로드 엔진 "picochip, spacc-l2"의 경우 "picochip, spacc-ipsec"
   - reg :이 장치에 설정된 레지스터 오프셋 및 길이
   - interrupt-parent : SPAcc 인터럽트를 제어하는 인터럽트 컨트롤러.
   - interrupts : SPAcc로부터의 인터럽트 라인.
   - ref-clock : SPAcc를 구동하는 입력 클럭입니다.




Example SPAcc node:

spacc@10000 {
	compatible = "picochip,spacc-ipsec";
	reg = <0x100000 0x10000>;
	interrupt-parent = <&vic0>;
	interrupts = <24>;
	ref-clock = <&ipsec_clk>, "ref";
};
```

## Doc/DeviceDriver/devicetree/bindings/crypto/qcom-qce.txt
```
Qualcomm crypto engine driver

Required properties:

- compatible  : should be "qcom,crypto-v5.1"
- reg         : specifies base physical address and size of the registers map
- clocks      : phandle to clock-controller plus clock-specifier pair
- clock-names : "iface" clocks register interface
                "bus" clocks data transfer interface
                "core" clocks rest of the crypto block
- dmas        : DMA specifiers for tx and rx dma channels. For more see
                Documentation/devicetree/bindings/dma/dma.txt
- dma-names   : DMA request names should be "rx" and "tx"

필수 속성 :

- 호환 가능 : "qcom, crypto-v5.1"이어야합니다.
- reg : 기본 물리적 주소와 레지스터 맵의 크기를 지정합니다.
- clocks : phandle에서 clock-controller 및 clock-specifier 쌍으로
- clock-names : "iface"클럭 등록 인터페이스 
				"bus"클럭 데이터 전송 인터페이스 
				"core"클럭 나머지 클럭 블럭
- dmas : tx 및 rx dma 채널에 대한 DMA 지정자입니다. 자세한 내용은 Documentation / devicetree / bindings / dma / dma.txt를 참조하십시오.
- dma-names : DMA 요청 이름은 "rx"및 "tx"이어야합니다.



Example:
	crypto@fd45a000 {
		compatible = "qcom,crypto-v5.1";
		reg = <0xfd45a000 0x6000>;
		clocks = <&gcc GCC_CE2_AHB_CLK>,
			 <&gcc GCC_CE2_AXI_CLK>,
			 <&gcc GCC_CE2_CLK>;
		clock-names = "iface", "bus", "core";
		dmas = <&cryptobam 2>, <&cryptobam 3>;
		dma-names = "rx", "tx";
	};
```

## Doc/DeviceDriver/devicetree/bindings/crypto/samsung-sss.txt
```
Samsung SoC SSS (Security SubSystem) module

The SSS module in S5PV210 SoC supports the following:
S5PV210 SoC의 SSS 모듈은 다음을 지원합니다.

-- Feeder (FeedCtrl)
-- Advanced Encryption Standard (AES)
- 고급 암호화 표준 (AES)

-- Data Encryption Standard (DES)/3DES
- 데이터 암호화 표준 (DES) / 3DES

-- Public Key Accelerator (PKA)
- 공개 키 가속기 (PKA)

-- SHA-1/SHA-256/MD5/HMAC (SHA-1/SHA-256/MD5)/PRNG

-- PRNG: Pseudo Random Number Generator
- PRNG : 의사 난수 생성기

The SSS module in Exynos4 (Exynos4210) and
Exynos5 (Exynos5420 and Exynos5250) SoCs
Exynos4 (Exynos4210) 및 Exynos5 (Exynos5420 및 Exynos5250) SoC의 SSS 모듈

supports the following also:
다음을 지원합니다.

-- ARCFOUR (ARC4)
-- True Random Number Generator (TRNG)
- 진정한 난수 생성기 (TRNG)

-- Secure Key Manager
- 보안 키 관리자

Required properties:

- compatible : Should contain entries for this and backward compatible
  SSS versions:
  - "samsung,s5pv210-secss" for S5PV210 SoC.
  - "samsung,exynos4210-secss" for Exynos4210, Exynos4212, Exynos4412, Exynos5250,
		Exynos5260 and Exynos5420 SoCs.
- 호환 :이 항목과 이전 버전과의 호환 가능 항목을 포함해야합니다.
   SSS 버전 :
   - S5PV210 SoC 용 "samsung, s5pv210-secss".
   Exynos4210, Exynos4212, Exynos4412, Exynos5250, Exynos5260 및 Exynos5420 SoC 용 "samsung, exynos4210-secss".

- reg : Offset and length of the register set for the module
- reg : 모듈에 설정된 레지스터 오프셋 및 길이

- interrupts : interrupt specifiers of SSS module interrupts, should contain
		following entries:
		- first : feed control interrupt (required for all variants),
		- second : hash interrupt (required only for samsung,s5pv210-secss).
- 인터럽트 : SSS 모듈 인터럽트의 인터럽트 지정자는 다음 항목을 포함해야합니다.
- 첫 번째 : 피드 제어 인터럽트 (모든 변형에 필요),
- 두 번째 : 해시 인터럽트 (samsung, s5pv210-secss에만 필요).


- clocks : list of clock phandle and specifier pairs for all clocks  listed in
		clock-names property.
- clocks : clock-names 속성에 나열된 모든 clocks에 대한 clocks phandle 및 지정자 쌍 목록입니다.

- clock-names : list of device clock input names; should contain one entry "secss".
- clock-names : 장치 클럭 입력 이름 목록. 하나의 항목 "secss"를 포함해야합니다.
```

## Doc/DeviceDriver/devicetree/bindings/crypto/sun4i-ss.txt
```
* Allwinner Security System found on A20 SoC

Required properties:
- compatible : Should be "allwinner,sun4i-a10-crypto".
- reg: Should contain the Security System register location and length.
- interrupts: Should contain the IRQ line for the Security System.
- clocks : List of clock specifiers, corresponding to ahb and ss.
- clock-names : Name of the functional clock, should be
	* "ahb" : AHB gating clock
	* "mod" : SS controller clock

Optional properties:
 - resets : phandle + reset specifier pair
 - reset-names : must contain "ahb"

필수 속성 :
- compatible : "allwinner, sun4i-a10-crypto"여야합니다.
- reg : 보안 시스템 레지스터 위치와 길이를 포함해야합니다.
- interrupts : 보안 시스템에 대한 IRQ 라인을 포함해야합니다.
- clocks : ahb 및 ss에 해당하는 시계 지정자 목록입니다.
- clock-names : 기능 클록의 이름 은 아래와 같아야 한다.
* "ahb": AHB 게이팅 시계
* "mod": SS 컨트롤러 클럭

선택적 속성 :
  - 재설정 : phandle + 재설정 지정자 쌍
  - reset-names : "ahb"를 포함해야합니다.


Example:
	crypto: crypto-engine@01c15000 {
		compatible = "allwinner,sun4i-a10-crypto";
		reg = <0x01c15000 0x1000>;
		interrupts = <GIC_SPI 86 IRQ_TYPE_LEVEL_HIGH>;
		clocks = <&ahb_gates 5>, <&ss_clk>;
		clock-names = "ahb", "mod";
	};
```

## Doc/DeviceDriver/devicetree/bindings/devfreq/event/exynos-ppmu.txt
```
* Samsung Exynos PPMU (Platform Performance Monitoring Unit) device

The Samsung Exynos SoC has PPMU (Platform Performance Monitoring Unit) for
each IP. PPMU provides the primitive values to get performance data. These
PPMU events provide information of the SoC's behaviors so that you may
use to analyze system performance, to make behaviors visible and to count
usages of each IP (DMC, CPU, RIGHTBUS, LEFTBUS, CAM interface, LCD, G3D, MFC).
The Exynos PPMU driver uses the devfreq-event class to provide event data
to various devfreq devices. The devfreq devices would use the event data when
derterming the current state of each IP.

Required properties:
- compatible: Should be "samsung,exynos-ppmu" or "samsung,exynos-ppmu-v2.
- reg: physical base address of each PPMU and length of memory mapped region.

Optional properties:
- clock-names : the name of clock used by the PPMU, "ppmu"
- clocks : phandles for clock specified in "clock-names" property

* 삼성 Exynos PPMU (플랫폼 성능 모니터링 장치) 장치

삼성 Exynos SoC는 각 IP별로 PPMU (Platform Performance Monitoring Unit)를 보유하고 있습니다. PPMU는 performance data 를 얻기 위해 기본 값을 제공합니다. 이러한 PPMU 이벤트는 시스템 성능 분석, 동작 표시 및 각 IP (DMC, CPU, RIGHTBUS, LEFTBUS, CAM 인터페이스, LCD, G3D, MFC)의 사용량 계산에 사용할 수 있도록 SoC의 동작에 대한 정보를 제공합니다.

Exynos PPMU 드라이버는 devfreq-event 클래스를 사용하여 다양한 devfreq 장치에 이벤트 데이터를 제공합니다. 각 IP의 현재 상태를 derterming 때 devfreq 장치는 이벤트 데이터를 사용합니다.


Example1 : PPMUv1 nodes in exynos3250.dtsi are listed below.
			exynos3250.dtsi의 PPMUv1 노드는 다음과 같습니다..

		ppmu_dmc0: ppmu_dmc0@106a0000 {
			compatible = "samsung,exynos-ppmu";
			reg = <0x106a0000 0x2000>;
			status = "disabled";
		};

		ppmu_dmc1: ppmu_dmc1@106b0000 {
			compatible = "samsung,exynos-ppmu";
			reg = <0x106b0000 0x2000>;
			status = "disabled";
		};

		ppmu_cpu: ppmu_cpu@106c0000 {
			compatible = "samsung,exynos-ppmu";
			reg = <0x106c0000 0x2000>;
			status = "disabled";
		};

		ppmu_rightbus: ppmu_rightbus@112a0000 {
			compatible = "samsung,exynos-ppmu";
			reg = <0x112a0000 0x2000>;
			clocks = <&cmu CLK_PPMURIGHT>;
			clock-names = "ppmu";
			status = "disabled";
		};

		ppmu_leftbus: ppmu_leftbus0@116a0000 {
			compatible = "samsung,exynos-ppmu";
			reg = <0x116a0000 0x2000>;
			clocks = <&cmu CLK_PPMULEFT>;
			clock-names = "ppmu";
			status = "disabled";
		};

Example2 : Events of each PPMU node in exynos3250-rinato.dts are listed below.
			exynos3250-rinato.dts에있는 각 PPMU 노드의 이벤트는 다음과 같습니다.

	&ppmu_dmc0 {
		status = "okay";

		events {
			ppmu_dmc0_3: ppmu-event3-dmc0 {
				event-name = "ppmu-event3-dmc0";
			};

			ppmu_dmc0_2: ppmu-event2-dmc0 {
				event-name = "ppmu-event2-dmc0";
			};

			ppmu_dmc0_1: ppmu-event1-dmc0 {
				event-name = "ppmu-event1-dmc0";
			};

			ppmu_dmc0_0: ppmu-event0-dmc0 {
				event-name = "ppmu-event0-dmc0";
			};
		};
	};

	&ppmu_dmc1 {
		status = "okay";

		events {
			ppmu_dmc1_3: ppmu-event3-dmc1 {
				event-name = "ppmu-event3-dmc1";
			};
		};
	};

	&ppmu_leftbus {
		status = "okay";

		events {
			ppmu_leftbus_3: ppmu-event3-leftbus {
				event-name = "ppmu-event3-leftbus";
			};
		};
	};

	&ppmu_rightbus {
		status = "okay";

		events {
			ppmu_rightbus_3: ppmu-event3-rightbus {
				event-name = "ppmu-event3-rightbus";
			};
		};
	};

Example3 : PPMUv2 nodes in exynos5433.dtsi are listed below.
			exynos5433.dtsi의 PPMUv2 노드는 다음과 같습니다.
			
		ppmu_d0_cpu: ppmu_d0_cpu@10480000 {
			compatible = "samsung,exynos-ppmu-v2";
			reg = <0x10480000 0x2000>;
			status = "disabled";
		};

		ppmu_d0_general: ppmu_d0_general@10490000 {
			compatible = "samsung,exynos-ppmu-v2";
			reg = <0x10490000 0x2000>;
			status = "disabled";
		};

		ppmu_d0_rt: ppmu_d0_rt@104a0000 {
			compatible = "samsung,exynos-ppmu-v2";
			reg = <0x104a0000 0x2000>;
			status = "disabled";
		};

		ppmu_d1_cpu: ppmu_d1_cpu@104b0000 {
			compatible = "samsung,exynos-ppmu-v2";
			reg = <0x104b0000 0x2000>;
			status = "disabled";
		};

		ppmu_d1_general: ppmu_d1_general@104c0000 {
			compatible = "samsung,exynos-ppmu-v2";
			reg = <0x104c0000 0x2000>;
			status = "disabled";
		};

		ppmu_d1_rt: ppmu_d1_rt@104d0000 {
			compatible = "samsung,exynos-ppmu-v2";
			reg = <0x104d0000 0x2000>;
			status = "disabled";
		};
```
