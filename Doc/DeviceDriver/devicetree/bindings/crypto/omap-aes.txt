## Doc/DeviceDriver/devicetree/bindings/display/arm,pl11x.txt
```
* ARM PrimeCell Color LCD Controller PL110/PL111

See also Documentation/devicetree/bindings/arm/primecell.txt

Required properties:

- compatible: must be one of:
	"arm,pl110", "arm,primecell"
	"arm,pl111", "arm,primecell"

- reg: base address and size of the control registers block

- interrupt-names: either the single entry "combined" representing a
	combined interrupt output (CLCDINTR), or the four entries
	"mbe", "vcomp", "lnbu", "fuf" representing the individual
	CLCDMBEINTR, CLCDVCOMPINTR, CLCDLNBUINTR, CLCDFUFINTR interrupts

- interrupts: contains an interrupt specifier for each entry in
	interrupt-names

- clock-names: should contain "clcdclk" and "apb_pclk"

- clocks: contains phandle and clock specifier pairs for the entries
	in the clock-names property. See
	Documentation/devicetree/binding/clock/clock-bindings.txt

Optional properties:

- memory-region: phandle to a node describing memory (see
	Documentation/devicetree/bindings/reserved-memory/reserved-memory.txt)
	to be used for the framebuffer; if not present, the framebuffer
	may be located anywhere in the memory

- max-memory-bandwidth: maximum bandwidth in bytes per second that the
	cell's memory interface can handle; if not present, the memory
	interface is fast enough to handle all possible video modes

Required sub-nodes:

- port: describes LCD panel signals, following the common binding
	for video transmitter interfaces; see
	Documentation/devicetree/bindings/media/video-interfaces.txt;
	when it is a TFT panel, the port's endpoint must define the
	following property:

	- arm,pl11x,tft-r0g0b0-pads: an array of three 32-bit values,
		defining the way CLD pads are wired up; first value
		contains index of the "CLD" external pin (pad) used
		as R0 (first bit of the red component), second value
	        index of the pad used as G0, third value index of the
		pad used as B0, see also "LCD panel signal multiplexing
		details" paragraphs in the PL110/PL111 Technical
		Reference Manuals; this implicitly defines available
		color modes, for example:
		- PL111 TFT 4:4:4 panel:
			arm,pl11x,tft-r0g0b0-pads = <4 15 20>;
		- PL110 TFT (1:)5:5:5 panel:
			arm,pl11x,tft-r0g0b0-pads = <1 7 13>;
		- PL111 TFT (1:)5:5:5 panel:
			arm,pl11x,tft-r0g0b0-pads = <3 11 19>;
		- PL111 TFT 5:6:5 panel:
			arm,pl11x,tft-r0g0b0-pads = <3 10 19>;
		- PL110 and PL111 TFT 8:8:8 panel:
			arm,pl11x,tft-r0g0b0-pads = <0 8 16>;
		- PL110 and PL111 TFT 8:8:8 panel, R & B components swapped:
			arm,pl11x,tft-r0g0b0-pads = <16 8 0>;


Example:

	clcd@10020000 {
		compatible = "arm,pl111", "arm,primecell";
		reg = <0x10020000 0x1000>;
		interrupt-names = "combined";
		interrupts = <0 44 4>;
		clocks = <&oscclk1>, <&oscclk2>;
		clock-names = "clcdclk", "apb_pclk";
		max-memory-bandwidth = <94371840>; /* Bps, 1024x768@60 16bpp */

		port {
			clcd_pads: endpoint {
				remote-endpoint = <&clcd_panel>;
				arm,pl11x,tft-r0g0b0-pads = <0 8 16>;
			};
		};

	};

	panel {
		compatible = "panel-dpi";

		port {
			clcd_panel: endpoint {
				remote-endpoint = <&clcd_pads>;
			};
		};

		panel-timing {
			clock-frequency = <25175000>;
			hactive = <640>;
			hback-porch = <40>;
			hfront-porch = <24>;
			hsync-len = <96>;
			vactive = <480>;
			vback-porch = <32>;
			vfront-porch = <11>;
			vsync-len = <2>;
		};
	};

/*
ARM PrimeCell 컬러 LCD 컨트롤러 PL110 / PL111

Documentation / devicetree / bindings / arm / primecell.txt도 참조하십시오.

필수 속성 :

- compatible : 다음 중 하나 여야합니다.
"팔, pl110", "팔, primecell"
"팔, pl111", "팔, primecell"

- reg : 제어 레지스터 블록의 기본 주소와 크기

- interrupt-names : a를 나타내는 "결합 된"단일 항목
결합 된 인터럽트 출력 (CLCDINTR) 또는 네 개의 항목
개인을 나타내는 "mbe", "vcomp", "lnbu", "fuf"
CLCDMBEINTR, CLCDVCOMPINTR, CLCDLNBUINTR, CLCDFUFINTR 인터럽트

- 인터럽트 : 각 항목에 대한 인터럽트 지정자를 포함합니다.
인터럽트 이름

- clock-names : "clcdclk"및 "apb_pclk"를 포함해야합니다.

- clocks : 항목에 대한 phandle 및 clock 지정자 쌍을 포함합니다.
clock-names 속성에. 만나다
Documentation / devicetree / binding / clock / clock-bindings.txt

선택적 속성 :

- memory-region : 메모리를 묘사하는 노드로 향하게한다.
문서 / devicetree / bindings / reserved-memory / reserved-memory.txt)
프레임 버퍼 용으로 사용된다. 존재하지 않으면, 프레임 버퍼
메모리의 어느 곳에 나 위치 할 수있다.

- max-memory-bandwidth : 최대 대역폭 (초당 바이트)
셀의 메모리 인터페이스가 처리 할 수 ​​있습니다. 존재하지 않으면, 메모리
인터페이스는 가능한 모든 비디오 모드를 처리 할 수있을 정도로 빠릅니다.

필수 하위 노드 :

- 포트 : 공통 바인딩에 따라 LCD 패널 신호를 설명합니다.
비디오 송신기 인터페이스 용. 만나다
Documentation / devicetree / bindings / media / video-interfaces.txt;
TFT 패널 인 경우 포트의 endpoint은 다음을 정의해야합니다.
다음 속성 :

- arm, pl11x, tft-r0g0b0-pads : 세 개의 32 비트 값 배열,
CLD 패드가 배선되는 방식을 정의합니다. 첫 번째 가치
사용 된 "CLD"외부 핀 (패드)의 색인을 포함합니다.
R0 (적색 성분의 첫 번째 비트), 두 번째 값
G0으로 사용 된 패드의 인덱스,
B0으로 사용되는 패드, "LCD 패널 신호 다중화
PL110 / PL111 기술 세부 사항 단락
참조 매뉴얼; 이것은 암묵적으로 이용 가능한 것을 정의한다.
색상 모드, 예 :
- PL111 TFT 4 : 4 : 4 패널 :
arm, pl11x, tft-r0g0b0-pads = <4 15 20>;
- PL110 TFT (1 :) 5 : 5 : 5 패널 :
arm, pl11x, tft-r0g0b0-pads = <1 7 13>;
- PL111 TFT (1 :) 5 : 5 : 5 패널 :
arm, pl11x, tft-r0g0b0-pads = <3 11 19>;
- PL111 TFT 5 : 6 : 5 패널 :
arm, pl11x, tft-r0g0b0-pads = <3 10 19>;
- PL110 및 PL111 TFT 8 : 8 : 8 패널 :
arm, pl11x, tft-r0g0b0-pads = <0 8 16>;
- PL110 및 PL111 TFT 8 : 8 : 8 패널, R & B 부품 교환 :
arm, pl11x, tft-r0g0b0-pads = <16 8 0>;

Example:

	clcd@10020000 {
		compatible = "arm,pl111", "arm,primecell";
		reg = <0x10020000 0x1000>;
		interrupt-names = "combined";
		interrupts = <0 44 4>;
		clocks = <&oscclk1>, <&oscclk2>;
		clock-names = "clcdclk", "apb_pclk";
		max-memory-bandwidth = <94371840>; /* Bps, 1024x768@60 16bpp */

		port {
			clcd_pads: endpoint {
				remote-endpoint = <&clcd_panel>;
				arm,pl11x,tft-r0g0b0-pads = <0 8 16>;
			};
		};

	};

	panel {
		compatible = "panel-dpi";

		port {
			clcd_panel: endpoint {
				remote-endpoint = <&clcd_pads>;
			};
		};

		panel-timing {
			clock-frequency = <25175000>;
			hactive = <640>;
			hback-porch = <40>;
			hfront-porch = <24>;
			hsync-len = <96>;
			vactive = <480>;
			vback-porch = <32>;
			vfront-porch = <11>;
			vsync-len = <2>;
		};
	};

*/
```

## Doc/DeviceDriver/devicetree/bindings/display/atmel,lcdc.txt
```
Atmel LCDC Framebuffer
-----------------------------------------------------

Required properties:
- compatible :
	"atmel,at91sam9261-lcdc" , 
	"atmel,at91sam9263-lcdc" ,
	"atmel,at91sam9g10-lcdc" ,
	"atmel,at91sam9g45-lcdc" ,
	"atmel,at91sam9g45es-lcdc" ,
	"atmel,at91sam9rl-lcdc" ,
	"atmel,at32ap-lcdc"
- reg : Should contain 1 register ranges(address and length).
	Can contain an additional register range(address and length)
	for fixed framebuffer memory. Useful for dedicated memories.
- interrupts : framebuffer controller interrupt
- display: a phandle pointing to the display node

Required nodes:
- display: a display node is required to initialize the lcd panel
	This should be in the board dts.
- default-mode: a videomode within the display with timing parameters
	as specified below.

Optional properties:
- lcd-supply: Regulator for LCD supply voltage.

Example:

	fb0: fb@0x00500000 {
		compatible = "atmel,at91sam9g45-lcdc";
		reg = <0x00500000 0x1000>;
		interrupts = <23 3 0>;
		pinctrl-names = "default";
		pinctrl-0 = <&pinctrl_fb>;
		display = <&display0>;
		status = "okay";
		#address-cells = <1>;
		#size-cells = <1>;

	};

Example for fixed framebuffer memory:

	fb0: fb@0x00500000 {
		compatible = "atmel,at91sam9263-lcdc";
		reg = <0x00700000 0x1000 0x70000000 0x200000>;
		[...]
	};

Atmel LCDC Display
-----------------------------------------------------
Required properties (as per of_videomode_helper):

 - atmel,dmacon: dma controller configuration
 - atmel,lcdcon2: lcd controller configuration
 - atmel,guard-time: lcd guard time (Delay in frame periods)
 - bits-per-pixel: lcd panel bit-depth.

Optional properties (as per of_videomode_helper):
 - atmel,lcdcon-backlight: enable backlight
 - atmel,lcdcon-backlight-inverted: invert backlight PWM polarity
 - atmel,lcd-wiring-mode: lcd wiring mode "RGB" or "BRG"
 - atmel,power-control-gpio: gpio to power on or off the LCD (as many as needed)

Example:
	display0: display {
		bits-per-pixel = <32>;
		atmel,lcdcon-backlight;
		atmel,dmacon = <0x1>;
		atmel,lcdcon2 = <0x80008002>;
		atmel,guard-time = <9>;
		atmel,lcd-wiring-mode = <1>;

		display-timings {
			native-mode = <&timing0>;
			timing0: timing0 {
				clock-frequency = <9000000>;
				hactive = <480>;
				vactive = <272>;
				hback-porch = <1>;
				hfront-porch = <1>;
				vback-porch = <40>;
				vfront-porch = <1>;
				hsync-len = <45>;
				vsync-len = <1>;
			};
		};
	};

/*

Atmel LCDC 프레임 버퍼
-------------------------------------------------- ---

필수 속성 :
- 호환 가능 :
"atmel, at91sam9261-lcdc",
"atmel, at91sam9263-lcdc",
"atmel, at91sam9g10-lcdc",
"atmel, at91sam9g45-lcdc",
"atmel, at91sam9g45es-lcdc",
"atmel, at91sam9rl-lcdc",
"atmel, at32ap-lcdc"
- reg : 1 개의 레지스터 범위 (주소와 길이)를 포함해야합니다.
고정 프레임 버퍼 메모리에 대한 추가 레지스터 범위 (주소 및 길이)를 포함 할 수 있습니다. 전용 메모리에 유용합니다.
- 인터럽트 : 프레임 버퍼 컨트롤러 인터럽트
- 디스플레이 : 디스플레이 노드를 가리키는 phandle

필수 노드 :
- 디스플레이 : 디스플레이 노드는 LCD 패널을 초기화하는 데 필요합니다.
이것은 보드 dts에 있어야합니다.
- default-mode : 아래 지정된 타이밍 매개 변수와 함께 디스플레이 내의 비디오 모드.

선택적 속성 :
- LCD 전원 : LCD 전원 전압 레귤레이터.


Example:

	fb0: fb@0x00500000 {
		compatible = "atmel,at91sam9g45-lcdc";
		reg = <0x00500000 0x1000>;
		interrupts = <23 3 0>;
		pinctrl-names = "default";
		pinctrl-0 = <&pinctrl_fb>;
		display = <&display0>;
		status = "okay";
		#address-cells = <1>;
		#size-cells = <1>;

	};


고정 프레임 버퍼 메모리의 예 :

	fb0: fb@0x00500000 {
		compatible = "atmel,at91sam9263-lcdc";
		reg = <0x00700000 0x1000 0x70000000 0x200000>;
		[...]
	};

Atmel LCDC 디스플레이
-------------------------------------------------- ---
필수 속성 (of_videomode_helper에 따라) :

 - atmel, dmacon : dma 컨트롤러 구성
 - atmel, lcdcon2 : lcd 컨트롤러 구성
 - atmel, 가드 타임 : 액정 보호 시간 (프레임 기간 지연)
 - 픽셀 당 비트 수 : LCD 패널 비트 수.

선택적 속성 (of_videomode_helper에 따라) :
 - atmel, lcdcon-backlight : 백라이트 사용
 - atmel, lcdcon-backlight- 역전 : 역전 PWM 역 극성
 - atmel, lcd-wiring-mode : lcd 배선 모드 "RGB"또는 "BRG"
 - atmel, power-control-gpio : gpio를 사용하여 LCD의 전원을 켜거나 끕니다 (필요한만큼).


Example:
	display0: display {
		bits-per-pixel = <32>;
		atmel,lcdcon-backlight;
		atmel,dmacon = <0x1>;
		atmel,lcdcon2 = <0x80008002>;
		atmel,guard-time = <9>;
		atmel,lcd-wiring-mode = <1>;

		display-timings {
			native-mode = <&timing0>;
			timing0: timing0 {
				clock-frequency = <9000000>;
				hactive = <480>;
				vactive = <272>;
				hback-porch = <1>;
				hfront-porch = <1>;
				vback-porch = <40>;
				vfront-porch = <1>;
				hsync-len = <45>;
				vsync-len = <1>;
			};
		};
	};

*/
```

## Doc/DeviceDriver/devicetree/bindings/display/atmel/hlcdc-dc.txt
```
Device-Tree bindings for Atmel's HLCDC (High LCD Controller) DRM driver

The Atmel HLCDC Display Controller is subdevice of the HLCDC MFD device.
See ../mfd/atmel-hlcdc.txt for more details.

Required properties:
 - compatible: value should be "atmel,hlcdc-display-controller"
 - pinctrl-names: the pin control state names. Should contain "default".
 - pinctrl-0: should contain the default pinctrl states.
 - #address-cells: should be set to 1.
 - #size-cells: should be set to 0.

Required children nodes:
 Children nodes are encoding available output ports and their connections
 to external devices using the OF graph reprensentation (see ../graph.txt).
 At least one port node is required.

Example:

	hlcdc: hlcdc@f0030000 {
		compatible = "atmel,sama5d3-hlcdc";
		reg = <0xf0030000 0x2000>;
		interrupts = <36 IRQ_TYPE_LEVEL_HIGH 0>;
		clocks = <&lcdc_clk>, <&lcdck>, <&clk32k>;
		clock-names = "periph_clk","sys_clk", "slow_clk";
		status = "disabled";

		hlcdc-display-controller {
			compatible = "atmel,hlcdc-display-controller";
			pinctrl-names = "default";
			pinctrl-0 = <&pinctrl_lcd_base &pinctrl_lcd_rgb888>;
			#address-cells = <1>;
			#size-cells = <0>;

			port@0 {
				#address-cells = <1>;
				#size-cells = <0>;
				reg = <0>;

				hlcdc_panel_output: endpoint@0 {
					reg = <0>;
					remote-endpoint = <&panel_input>;
				};
			};
		};

		hlcdc_pwm: hlcdc-pwm {
			compatible = "atmel,hlcdc-pwm";
			pinctrl-names = "default";
			pinctrl-0 = <&pinctrl_lcd_pwm>;
			#pwm-cells = <3>;
		};
	};

/*
Atmel狼 HLCDC (High LCD Controller) DRM 靛扼捞滚狼 厘摹 飘府 官牢爹

Atmel HLCDC 叼胶敲饭捞 牧飘费矾绰 HLCDC MFD 厘摹狼 窍困 厘摹涝聪促.
磊技茄 郴侩篮 .. / mfd / atmel-hlcdc.txt甫 曼炼窍绞矫坷.

鞘夸茄 加己 :
- 龋券己 : 蔼篮 "atmel, hlcdc-display-controller"肺秦具钦聪促.
- pinctrl-names : 巧 力绢 惑怕 捞抚. "扁夯"阑 器窃秦具钦聪促.
- pinctrl-0 : 扁夯 pinctrl 惑怕甫 器窃秦具钦聪促.
- # address-cells : 1肺 汲沥秦具钦聪促.
- # size-cells : 0栏肺 汲沥秦具钦聪促

鞘夸茄 磊侥 畴靛 :
磊侥 畴靛绰 荤侩 啊瓷茄 免仿 器飘客 OF 弊贰橇狼 钎泅阑 荤侩窍咯 寇何 厘摹客狼 楷搬阑 牢内爹钦聪促
 (see ../graph.txt 曼炼).
利绢档 窍唱狼 器飘 畴靛啊 鞘夸钦聪促.

Example:

	hlcdc: hlcdc@f0030000 {
		compatible = "atmel,sama5d3-hlcdc";
		reg = <0xf0030000 0x2000>;
		interrupts = <36 IRQ_TYPE_LEVEL_HIGH 0>;
		clocks = <&lcdc_clk>, <&lcdck>, <&clk32k>;
		clock-names = "periph_clk","sys_clk", "slow_clk";
		status = "disabled";

		hlcdc-display-controller {
			compatible = "atmel,hlcdc-display-controller";
			pinctrl-names = "default";
			pinctrl-0 = <&pinctrl_lcd_base &pinctrl_lcd_rgb888>;
			#address-cells = <1>;
			#size-cells = <0>;

			port@0 {
				#address-cells = <1>;
				#size-cells = <0>;
				reg = <0>;

				hlcdc_panel_output: endpoint@0 {
					reg = <0>;
					remote-endpoint = <&panel_input>;
				};
			};
		};

		hlcdc_pwm: hlcdc-pwm {
			compatible = "atmel,hlcdc-pwm";
			pinctrl-names = "default";
			pinctrl-0 = <&pinctrl_lcd_pwm>;
			#pwm-cells = <3>;
		};
	};

*/
```
