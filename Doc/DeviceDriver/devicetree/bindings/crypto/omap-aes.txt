## Doc/DeviceDriver/devicetree/bindings/display/connector/vga-connector.txt
```
VGA Connector
=============

Required properties:

- compatible: "vga-connector"

Optional properties:

- label: a symbolic name for the connector corresponding to a hardware label
- ddc-i2c-bus: phandle to the I2C bus that is connected to VGA DDC

Required nodes:

The VGA connector internal connections are modeled using the OF graph bindings
specified in Documentation/devicetree/bindings/graph.txt.

The VGA connector has a single port that must be connected to a video source
port.


Example
-------

vga0: connector@0 {
	compatible = "vga-connector";
	label = "vga";

	ddc-i2c-bus = <&i2c3>;

	port {
		vga_connector_in: endpoint {
			remote-endpoint = <&adv7123_out>;
		};
	};
};

/*
VGA 目池磐
=============

鞘荐 加己 :

- 龋券 : "vga-connector"

急琶利 加己 :

- label : 窍靛傀绢 饭捞喉俊 秦寸窍绰 目池磐狼 扁龋 捞抚
- ddc-i2c-bus : VGA DDC俊 楷搬等 I2C 滚胶肺 楷搬钦聪促.

鞘荐 畴靛 :

VGA 目池磐 郴何 楷搬篮 OF 弊贰橇 官牢爹阑 荤侩窍咯 葛胆傅邓聪促.
Documentation / devicetree / bindings / graph.txt俊 瘤沥登绢 乐嚼聪促.

VGA 目池磐俊绰 厚叼坷 家胶 器飘俊 楷搬秦具窍绰 窜老 器飘啊 乐嚼聪促.

Example
-------

vga0: connector@0 {
	compatible = "vga-connector";
	label = "vga";

	ddc-i2c-bus = <&i2c3>;

	port {
		vga_connector_in: endpoint {
			remote-endpoint = <&adv7123_out>;
		};
	};
};

*/
```

## Doc/DeviceDriver/devicetree/bindings/display/exynos/exynos-mic.txt
```
Device-Tree bindings for Samsung Exynos SoC mobile image compressor (MIC)

MIC (mobile image compressor) resides between decon and mipi dsi. Mipi dsi is
not capable to transfer high resoltuion frame data as decon can send. MIC
solves this problem by compressing the frame data by 1/2 before it is
transferred through mipi dsi. The compressed frame data must be uncompressed in
the panel PCB.

Required properties:
- compatible: value should be "samsung,exynos5433-mic".
- reg: physical base address and length of the MIC registers set and system
       register of mic.
- clocks: must include clock specifiers corresponding to entries in the
	  clock-names property.
- clock-names: list of clock names sorted in the same order as the clocks
	       property. Must contain "pclk_mic0", "sclk_rgb_vclk_to_mic0".
- samsung,disp-syscon: the reference node for syscon for DISP block.
- ports: contains a port which is connected to decon node and dsi node.
	 address-cells and size-cells must 1 and 0, respectively.
- port: contains an endpoint node which is connected to the endpoint in the
	decon node or dsi node. The reg value must be 0 and 1 respectively.

Example:
SoC specific DT entry:
mic: mic@13930000 {
	compatible = "samsung,exynos5433-mic";
	reg = <0x13930000 0x48>;
	clocks = <&cmu_disp CLK_PCLK_MIC0>,
	       <&cmu_disp CLK_SCLK_RGB_VCLK_TO_MIC0>;
	clock-names = "pclk_mic0", "sclk_rgb_vclk_to_mic0";
	samsung,disp-syscon = <&syscon_disp>;

	ports {
		#address-cells = <1>;
		#size-cells = <0>;

		port@0 {
			reg = <0>;
			mic_to_decon: endpoint {
				remote-endpoint = <&decon_to_mic>;
			};
		};

		port@1 {
			reg = <1>;
			mic_to_dsi: endpoint {
				remote-endpoint = <&dsi_to_mic>;
			};
		};
	};
};


/*
/*
伙己 Exynos SoC 葛官老 捞固瘤 拘绵扁 (MIC)狼 厘摹 飘府 官牢爹

MIC (葛官老 捞固瘤 拘绵扁)绰 decon苞 mipi dsi 荤捞俊 乐嚼聪促. 

Mipi dsi绰 单能捞 焊尘 荐乐绰 绊盒秦瓷 橇饭烙 单捞磐甫 傈价且 荐 绝嚼聪促.

 MIC绰 mipi dsi甫 烹秦 傈价登扁 傈俊 橇饭烙 单捞磐甫 1/2肺 拘绵窍咯捞 巩力甫 秦搬钦聪促. 

拘绵 等 橇饭烙 单捞磐绰 菩澄 PCB俊辑 拘绵 秦力登绢具钦聪促.

鞘荐 加己 :

- 龋券 : 蔼篮 "samsung, exynos5433-mic"咯具钦聪促.

- reg : mic 饭瘤胶磐 技飘狼 拱府利 扁夯 林家客 辨捞 棺 mic狼 矫胶袍 饭瘤胶磐.

- clocks : clock-names 加己狼 亲格俊 秦寸窍绰 努钒 瘤沥磊甫 器窃秦具钦聪促.

- clock-names : 努钒 捞抚苞 鞍篮 鉴辑肺 沥纺 等 努钒 捞抚 格废. 

"pclk_mic0", "sclk_rgb_vclk_to_mic0"阑 器窃秦具钦聪促.

- samsung, disp-syscon : DISP 喉废阑困茄 syscon狼 曼炼 畴靛.

- ports : 单能 畴靛客 dsi 畴靛俊 楷搬等 器飘甫 器窃钦聪促.

林家 伎苞 农扁 伎篮 阿阿 1苞 0捞绢具钦聪促.

- 器飘 : decon 畴靛 肚绰 dsi 畴靛狼 场痢俊 楷搬等 场痢 畴靛甫 器窃钦聪促.

 reg 蔼篮 阿阿 0苞 1捞绢具钦聪促.

Example:
SoC specific DT entry:
mic: mic@13930000 {
	compatible = "samsung,exynos5433-mic";
	reg = <0x13930000 0x48>;
	clocks = <&cmu_disp CLK_PCLK_MIC0>,
	       <&cmu_disp CLK_SCLK_RGB_VCLK_TO_MIC0>;
	clock-names = "pclk_mic0", "sclk_rgb_vclk_to_mic0";
	samsung,disp-syscon = <&syscon_disp>;

	ports {
		#address-cells = <1>;
		#size-cells = <0>;

		port@0 {
			reg = <0>;
			mic_to_decon: endpoint {
				remote-endpoint = <&decon_to_mic>;
			};
		};

		port@1 {
			reg = <1>;
			mic_to_dsi: endpoint {
				remote-endpoint = <&dsi_to_mic>;
			};
		};
	};
};

*/
```

## Doc/DeviceDriver/devicetree/bindings/display/exynos/exynos5433-decon.txt
```
Device-Tree bindings for Samsung Exynos SoC display controller (DECON)

DECON (Display and Enhancement Controller) is the Display Controller for the
Exynos series of SoCs which transfers the image data from a video memory
buffer to an external LCD interface.

Required properties:
- compatible: value should be "samsung,exynos5433-decon";
- reg: physical base address and length of the DECON registers set.
- interrupts: should contain a list of all DECON IP block interrupts in the
	      order: VSYNC, LCD_SYSTEM. The interrupt specifier format
	      depends on the interrupt controller used.
- interrupt-names: should contain the interrupt names: "vsync", "lcd_sys"
		   in the same order as they were listed in the interrupts
		   property.
- clocks: must include clock specifiers corresponding to entries in the
	  clock-names property.
- clock-names: list of clock names sorted in the same order as the clocks
	       property. Must contain "aclk_decon", "aclk_smmu_decon0x",
	       "aclk_xiu_decon0x", "pclk_smmu_decon0x", clk_decon_vclk",
	       "sclk_decon_eclk"
- ports: contains a port which is connected to mic node. address-cells and
	 size-cells must 1 and 0, respectively.
- port: contains an endpoint node which is connected to the endpoint in the mic
	node. The reg value muset be 0.
- i80-if-timings: specify whether the panel which is connected to decon uses
		  i80 lcd interface or mipi video interface. This node contains
		  no timing information as that of fimd does. Because there is
		  no register in decon to specify i80 interface timing value,
		  it is not needed, but make it remain to use same kind of node
		  in fimd and exynos7 decon.

Example:
SoC specific DT entry:
decon: decon@13800000 {
	compatible = "samsung,exynos5433-decon";
	reg = <0x13800000 0x2104>;
	clocks = <&cmu_disp CLK_ACLK_DECON>, <&cmu_disp CLK_ACLK_SMMU_DECON0X>,
		<&cmu_disp CLK_ACLK_XIU_DECON0X>,
		<&cmu_disp CLK_PCLK_SMMU_DECON0X>,
		<&cmu_disp CLK_SCLK_DECON_VCLK>,
		<&cmu_disp CLK_SCLK_DECON_ECLK>;
	clock-names = "aclk_decon", "aclk_smmu_decon0x", "aclk_xiu_decon0x",
		"pclk_smmu_decon0x", "sclk_decon_vclk", "sclk_decon_eclk";
	interrupt-names = "vsync", "lcd_sys";
	interrupts = <0 202 0>, <0 203 0>;

	ports {
		#address-cells = <1>;
		#size-cells = <0>;

		port@0 {
			reg = <0>;
			decon_to_mic: endpoint {
				remote-endpoint = <&mic_to_decon>;
			};
		};
	};
};

Board specific DT entry:
&decon {
	i80-if-timings {
	};
};



/*
伙己 Exynos SoC 叼胶敲饭捞 牧飘费矾 (DECON) 侩 厘摹 飘府 官牢爹

DECON (叼胶敲饭捞 棺 氢惑 牧飘费矾)篮 捞固瘤 单捞磐甫 厚叼坷 皋葛府 滚欺俊辑 寇何 LCD 牢磐其捞胶肺 傈价窍绰 Exynos SoC 矫府令 侩 叼胶敲饭捞 牧飘费矾涝聪促.

鞘荐 加己 :

- 龋券 : 蔼篮 "samsung, exynos5433-decon"捞绢具钦聪促.

- reg : 拱府利 牢 扁夯 林家客 DECON 饭瘤胶磐 技飘狼 辨捞.

- 牢磐反飘 : 葛电 DECON IP 喉废 牢磐反飘 格废阑 VSYNC, LCD_SYSTEM 鉴辑肺 器窃秦具钦聪促. 

牢磐反飘 瘤沥磊 屈侥篮 荤侩 等 牢磐反飘 牧飘费矾俊 蝶扼 促辅聪促.

- interrupt-names : 牢磐反飘 捞抚俊 "vsync", "lcd_sys"客 鞍篮 鉴辑肺 牢磐反飘 加己阑 器窃秦具钦聪促.

- clocks : clock-names 加己狼 亲格俊 秦寸窍绰 努钒 瘤沥磊甫 器窃秦具钦聪促.

- clock-names : 努钒 捞抚苞 鞍篮 鉴辑肺 沥纺 等 努钒 捞抚 格废. 

"aclk_decon","aclk_smmu_decon0x","aclk_xiu_decon0x", "pclk_smmu_decon0x", clk_decon_vclk ","sclk_decon_eclk "

- ports : mic 畴靛俊 楷搬等 器飘甫 器窃钦聪促. 林家 伎苞 农扁 伎篮 阿阿 1苞 0捞绢具钦聪促.

- port : mic 畴靛狼 浚靛 器牢飘俊 楷搬等 浚靛 器牢飘 畴靛甫 器窃钦聪促. reg 蔼篮 0涝聪促.

- i80-if-timing : i80 lcd 牢磐其捞胶 肚绰 mipi 厚叼坷 牢磐其捞胶甫 荤侩且瘤 咯何甫 瘤沥钦聪促. 

捞 畴靛俊绰 fimd狼 鸥捞怪 沥焊啊 器窃登绢 乐瘤 臼嚼聪促. 

单阁俊 i80 牢磐其捞胶 鸥捞怪 蔼阑 瘤沥窍绰 饭瘤胶磐啊 绝栏骨肺 鞘夸窍瘤 臼瘤父 

fimd 棺 exynos7 单阁俊辑 鞍篮 辆幅狼 畴靛甫 荤侩秦具钦聪促.

Example:
SoC specific DT entry:
decon: decon@13800000 {
	compatible = "samsung,exynos5433-decon";
	reg = <0x13800000 0x2104>;
	clocks = <&cmu_disp CLK_ACLK_DECON>, <&cmu_disp CLK_ACLK_SMMU_DECON0X>,
		<&cmu_disp CLK_ACLK_XIU_DECON0X>,
		<&cmu_disp CLK_PCLK_SMMU_DECON0X>,
		<&cmu_disp CLK_SCLK_DECON_VCLK>,
		<&cmu_disp CLK_SCLK_DECON_ECLK>;
	clock-names = "aclk_decon", "aclk_smmu_decon0x", "aclk_xiu_decon0x",
		"pclk_smmu_decon0x", "sclk_decon_vclk", "sclk_decon_eclk";
	interrupt-names = "vsync", "lcd_sys";
	interrupts = <0 202 0>, <0 203 0>;

	ports {
		#address-cells = <1>;
		#size-cells = <0>;

		port@0 {
			reg = <0>;
			decon_to_mic: endpoint {
				remote-endpoint = <&mic_to_decon>;
			};
		};
	};
};

Board specific DT entry:
&decon {
	i80-if-timings {
	};
};

*/
```

## Doc/DeviceDriver/devicetree/bindings/display/exynos/exynos7-decon.txt
```
Device-Tree bindings for Samsung Exynos7 SoC display controller (DECON)

DECON (Display and Enhancement Controller) is the Display Controller for the
Exynos7 series of SoCs which transfers the image data from a video memory
buffer to an external LCD interface.

Required properties:
- compatible: value should be "samsung,exynos7-decon";

- reg: physical base address and length of the DECON registers set.

- interrupt-parent: should be the phandle of the decon controller's
		parent interrupt controller.

- interrupts: should contain a list of all DECON IP block interrupts in the
		 order: FIFO Level, VSYNC, LCD_SYSTEM. The interrupt specifier
		 format depends on the interrupt controller used.

- interrupt-names: should contain the interrupt names: "fifo", "vsync",
	"lcd_sys", in the same order as they were listed in the interrupts
        property.

- pinctrl-0: pin control group to be used for this controller.

- pinctrl-names: must contain a "default" entry.

- clocks: must include clock specifiers corresponding to entries in the
         clock-names property.

- clock-names: list of clock names sorted in the same order as the clocks
               property. Must contain "pclk_decon0", "aclk_decon0",
	       "decon0_eclk", "decon0_vclk".
- i80-if-timings: timing configuration for lcd i80 interface support.

Optional Properties:
- samsung,power-domain: a phandle to DECON power domain node.
- display-timings: timing settings for DECON, as described in document [1].
		Can be used in case timings cannot be provided otherwise
		or to override timings provided by the panel.

[1]: Documentation/devicetree/bindings/display/display-timing.txt

Example:

SoC specific DT entry:

	decon@13930000 {
		compatible = "samsung,exynos7-decon";
		interrupt-parent = <&combiner>;
		reg = <0x13930000 0x1000>;
		interrupt-names = "lcd_sys", "vsync", "fifo";
		interrupts = <0 188 0>, <0 189 0>, <0 190 0>;
		clocks = <&clock_disp PCLK_DECON_INT>,
			 <&clock_disp ACLK_DECON_INT>,
			 <&clock_disp SCLK_DECON_INT_ECLK>,
			 <&clock_disp SCLK_DECON_INT_EXTCLKPLL>;
		clock-names = "pclk_decon0", "aclk_decon0", "decon0_eclk",
				"decon0_vclk";
		status = "disabled";
	};

Board specific DT entry:

	decon@13930000 {
		pinctrl-0 = <&lcd_clk &pwm1_out>;
		pinctrl-names = "default";
		status = "okay";
	};

/*
伙己 Exynos7 SoC 叼胶敲饭捞 牧飘费矾 (DECON) 侩 厘摹 飘府 官牢爹

DECON (叼胶敲饭捞 棺 氢惑 牧飘费矾)篮
厚叼坷 皋葛府俊辑 捞固瘤 单捞磐甫 傈价窍绰 SoC狼 Exynos7 矫府令
滚欺甫 寇何 LCD 牢磐其捞胶俊 楷搬钦聪促.

鞘荐 加己 :
- compatible : 蔼篮 "samsung, exynos7-decon"捞绢具钦聪促.

- reg : 拱府利 牢 扁夯 林家客 DECON 饭瘤胶磐 技飘狼 辨捞.

- interrupt-parent : 叼能 牧飘费矾狼 phandle捞绢具钦聪促.
何葛 牢磐反飘 牧飘费矾.

- 牢磐反飘 : 葛电 DECON IP 喉废 牢磐反飘 格废阑 FIFO 饭骇, VSYNC, LCD_SYSTEM 鉴辑肺 器窃秦具钦聪促. 

牢磐反飘 瘤沥磊 屈侥篮 荤侩 等 牢磐反飘 牧飘费矾俊 蝶扼 促辅聪促.

- interrupt-names : interrupts 加己俊 唱凯等 鉴辑措肺 "fifo", "vsync", "lcd_sys"客 鞍篮 

牢磐反飘 捞抚阑 器窃秦具钦聪促.

- pinctrl-0 :捞 牧飘费矾俊 荤侩且 巧 牧飘费 弊缝.

- pinctrl-names : "扁夯"亲格阑 器窃秦具钦聪促.

- clocks : clock-names 加己狼 亲格俊 秦寸窍绰 clock 瘤沥磊甫 器窃秦具钦聪促.

- clock-names : 努钒 捞抚苞 鞍篮 鉴辑肺 沥纺 等 努钒 捞抚 格废.

 "pclk_decon0", "aclk_decon0", "decon0_eclk", "decon0_vclk"阑 器窃秦具钦聪促.

- i80-if-timing : lcd i80 牢磐其捞胶 瘤盔阑困茄 鸥捞怪 备己.

急琶利 加己 :
- samsung, power-domain : DECON 傈仿 档皋牢 畴靛俊 措茄 phandle.
- 叼胶敲饭捞 鸥捞怪 : DECON俊 措茄 鸥捞怪 汲沥. 巩辑 [1]俊 汲疙登绢 乐嚼聪促.
鸥捞怪阑 崔府 力傍 且 荐绝绰 版快 荤侩且 荐 乐嚼聪促.
肚绰 菩澄捞 力傍 茄 鸥捞怪阑 公矫且 荐 乐嚼聪促.

[1] : 巩辑 / devicetree / bindings / display / display-timing.txt

Example:

SoC specific DT entry:

	decon@13930000 {
		compatible = "samsung,exynos7-decon";
		interrupt-parent = <&combiner>;
		reg = <0x13930000 0x1000>;
		interrupt-names = "lcd_sys", "vsync", "fifo";
		interrupts = <0 188 0>, <0 189 0>, <0 190 0>;
		clocks = <&clock_disp PCLK_DECON_INT>,
			 <&clock_disp ACLK_DECON_INT>,
			 <&clock_disp SCLK_DECON_INT_ECLK>,
			 <&clock_disp SCLK_DECON_INT_EXTCLKPLL>;
		clock-names = "pclk_decon0", "aclk_decon0", "decon0_eclk",
				"decon0_vclk";
		status = "disabled";
	};

Board specific DT entry:

	decon@13930000 {
		pinctrl-0 = <&lcd_clk &pwm1_out>;
		pinctrl-names = "default";
		status = "okay";
	};


*/
```

## Doc/DeviceDriver/devicetree/bindings/display/exynos/exynos_hdmiddc.txt
```
Device-Tree bindings for hdmiddc driver

Required properties:
- compatible: value should be one of the following
	1) "samsung,exynos5-hdmiddc" <DEPRECATED>
	2) "samsung,exynos4210-hdmiddc"

- reg: I2C address of the hdmiddc device.

Example:

	hdmiddc {
		compatible = "samsung,exynos4210-hdmiddc";
		reg = <0x50>;
	};

/*
hdmiddc 靛扼捞滚俊 措茄 厘摹 飘府 官牢爹

鞘荐 加己 :
- compatible : value绰 促澜 吝 窍唱 咯具钦聪促.
1) "samsung, exynos5-hdmiddc"<DEPRECATED>
2) "samsung, exynos4210-hdmiddc"

- reg : hdmiddc 厘摹狼 I2C 林家涝聪促.

Example:

	hdmiddc {
		compatible = "samsung,exynos4210-hdmiddc";
		reg = <0x50>;
	};


*/
```

## Doc/DeviceDriver/devicetree/bindings/display/exynos/exynos_mixer.txt
```
Device-Tree bindings for mixer driver

Required properties:
- compatible: value should be one of the following:
	1) "samsung,exynos5-mixer" <DEPRECATED>
	2) "samsung,exynos4210-mixer"
	3) "samsung,exynos4212-mixer"
	4) "samsung,exynos5250-mixer"
	5) "samsung,exynos5420-mixer"

- reg: physical base address of the mixer and length of memory mapped
	region.
- interrupts: interrupt number to the cpu.
- clocks: list of clock IDs from SoC clock driver.
	a) mixer: Gate of Mixer IP bus clock.
	b) sclk_hdmi: HDMI Special clock, one of the two possible inputs of
               mixer mux.
	c) hdmi: Gate of HDMI IP bus clock, needed together with sclk_hdmi.

Example:

	mixer {
		compatible = "samsung,exynos5250-mixer";
		reg = <0x14450000 0x10000>;
		interrupts = <0 94 0>;
	};

/*
雇辑 靛扼捞滚狼 厘摹 飘府 官牢爹

鞘荐 加己 :
- compatible : value绰 促澜 吝 窍唱 咯具钦聪促.
1) "samsung, exynos5-mixer"<荤侩阑 鼻厘窍瘤 臼澜>
2) "伙己, exynos4210- 雇辑"
3) "伙己, exynos4212- 雇辑"
4) "samsung, exynos5250- 雇辑"
5) "samsung, exynos5420-mixer"

- reg : 雇辑狼 拱府利 海捞胶 林家客 皋葛府 概俏 等 康开狼 辨捞.
- interrupts : CPU俊 措茄 牢磐反飘 锅龋.
- clocks : SoC 努钒 靛扼捞滚狼 努废 ID 格废.
a) 雇辑 : 雇辑 IP 滚胶 努废狼 霸捞飘.
b) sclk_hdmi : HDMI 漂荐 矫拌, 雇辑 钢萍敲泛辑狼 滴 啊瘤 啊瓷茄 涝仿 吝 窍唱涝聪促.
c) hdmi : sclk_hdmi客 窃膊 鞘夸茄 HDMI IP 滚胶 努钒狼 霸捞飘涝聪促.

Example:

	mixer {
		compatible = "samsung,exynos5250-mixer";
		reg = <0x14450000 0x10000>;
		interrupts = <0 94 0>;
	};



*/
```
