## Doc/DeviceDriver/devicetree/bindings/iio/adc/qcom,spmi-vadc.txt
```
Qualcomm's SPMI PMIC voltage ADC

// Qualcomm의 SPMI PMIC 전압 ADC

SPMI PMIC voltage ADC (VADC) provides interface to clients to read
voltage. The VADC is a 15-bit sigma-delta ADC.

VADC node:

- compatible:
    Usage: required
    Value type: <string>
    Definition: Should contain "qcom,spmi-vadc".

- reg:
    Usage: required
    Value type: <prop-encoded-array>
    Definition: VADC base address and length in the SPMI PMIC register map.

- #address-cells:
    Usage: required
    Value type: <u32>
    Definition: Must be one. Child node 'reg' property should define ADC
            channel number.

- #size-cells:
    Usage: required
    Value type: <u32>
    Definition: Must be zero.

- #io-channel-cells:
    Usage: required
    Value type: <u32>
    Definition: Must be one. For details about IIO bindings see:
            Documentation/devicetree/bindings/iio/iio-bindings.txt

- interrupts:
    Usage: optional
    Value type: <prop-encoded-array>
    Definition: End of conversion interrupt.

Channel node properties:

- reg:
    Usage: required
    Value type: <u32>
    Definition: ADC channel number.
            See include/dt-bindings/iio/qcom,spmi-vadc.h

- qcom,decimation:
    Usage: optional
    Value type: <u32>
    Definition: This parameter is used to decrease ADC sampling rate.
            Quicker measurements can be made by reducing decimation ratio.
            Valid values are 512, 1024, 2048, 4096.
            If property is not found, default value of 512 will be used.

- qcom,pre-scaling:
    Usage: optional
    Value type: <u32 array>
    Definition: Used for scaling the channel input signal before the signal is
            fed to VADC. The configuration for this node is to know the
            pre-determined ratio and use it for post scaling. Select one from
            the following options.
            <1 1>, <1 3>, <1 4>, <1 6>, <1 20>, <1 8>, <10 81>, <1 10>
            If property is not found default value depending on chip will be used.

- qcom,ratiometric:
    Usage: optional
    Value type: <empty>
    Definition: Channel calibration type. If this property is specified
            VADC will use the VDD reference (1.8V) and GND for channel
            calibration. If property is not found, channel will be
            calibrated with 0.625V and 1.25V reference channels, also
            known as absolute calibration.

- qcom,hw-settle-time:
    Usage: optional
    Value type: <u32>
    Definition: Time between AMUX getting configured and the ADC starting
            conversion. Delay = 100us * (value) for value < 11, and
            2ms * (value - 10) otherwise.
            Valid values are: 0, 100, 200, 300, 400, 500, 600, 700, 800,
            900 us and 1, 2, 4, 6, 8, 10 ms
            If property is not found, channel will use 0us.

- qcom,avg-samples:
    Usage: optional
    Value type: <u32>
    Definition: Number of samples to be used for measurement.
            Averaging provides the option to obtain a single measurement
            from the ADC that is an average of multiple samples. The value
            selected is 2^(value).
            Valid values are: 1, 2, 4, 8, 16, 32, 64, 128, 256, 512
            If property is not found, 1 sample will be used.

NOTE:

Following channels, also known as reference point channels, are used for
result calibration and their channel configuration nodes should be defined:
VADC_REF_625MV and/or VADC_SPARE1(based on PMIC version) VADC_REF_1250MV,
VADC_GND_REF and VADC_VDD_VADC.

Example:

	/* VADC node */
	pmic_vadc: vadc@3100 {
		compatible = "qcom,spmi-vadc";
		reg = <0x3100 0x100>;
		interrupts = <0x0 0x31 0x0 IRQ_TYPE_EDGE_RISING>;
		#address-cells = <1>;
		#size-cells = <0>;
		#io-channel-cells = <1>;
		io-channel-ranges;

		/* Channel node */
		usb_id_nopull {
			reg = <VADC_LR_MUX10_USB_ID>;
			qcom,decimation = <512>;
			qcom,ratiometric;
			qcom,hw-settle-time = <200>;
			qcom,avg-samples = <1>;
			qcom,pre-scaling = <1 3>;
		};
	};

	/* IIO client node */
	usb {
		io-channels = <&pmic_vadc VADC_LR_MUX10_USB_ID>;
		io-channel-names = "vadc";
	};



/*

Qualcomm의 SPMI PMIC 전압 ADC

SPMI PMIC 전압 ADC (VADC)는 클라이언트에게 읽기 전압 인터페이스를 제공합니다. 

VADC는 15 비트 시그마 - 델타 ADC입니다.

VADC 노드 :

- 호환 가능 :
    사용법 : 필수
    값 유형 : <문자열>
    정의 : "qcom, spmi-vadc"를 포함해야합니다.

- reg :
    사용법 : 필수
    값 유형 : <prop-encoded-array>
    정의 : SPAD PMIC 레지스터 맵의 VADC 기본 주소 및 길이

- # address-cells :
    사용법 : 필수
    값 유형 : <u32>
    정의 : 하나 여야합니다. 자식 노드 'reg'속성은 ADC 채널 번호를 정의해야합니다.

- # 크기 셀 :
    사용법 : 필수
    값 유형 : <u32>
    정의 : 0이어야합니다.

- # io-channel-cells :
    사용법 : 필수
    값 유형 : <u32>
    정의 : 하나 여야합니다. IIO 바인딩에 대한 자세한 내용은 다음을 참조하십시오.
            문서 / devicetree / bindings / iio / iio-bindings.txt

- 인터럽트 :
    사용법 : 선택 사항
    값 유형 : <prop-encoded-array>
    정의 : 변환 종료 인터럽트.

채널 노드 속성 :

- reg :
    사용법 : 필수
    값 유형 : <u32>
    정의 : ADC 채널 번호.
            include / dt-bindings / iio / qcom, spmi-vadc.h를 참조하십시오.

- qcom, decimation :

    사용법 : 선택 사항

    값 유형 : <u32>

    정의 :이 매개 변수는 ADC 샘플링 속도를 줄이기 위해 사용됩니다.

            데시 메이션 비율을 줄이면 더 빨리 측정 할 수 있습니다.

            유효한 값은 512, 1024, 2048, 4096입니다.

            속성을 찾을 수 없으면 기본값 인 512가 사용됩니다.

- qcom, prescaling :
    사용법 : 선택 사항
    값 유형 : <u32 array>

    정의 : 신호가 VADC로 공급되기 전에 채널 입력 신호를 스케일링하는 데 사용됩니다. 

    이 노드의 구성은 사전 결정된 비율을 알고 사후 배율에 사용하는 것입니다. 다음 옵션 중 하나를 선택하십시오.

            <1 1>, <3 3, <4>, <6>, <1 20>, <8>, <10 81>, <110>

            속성이 발견되지 않으면 칩에 따라 기본값이 사용됩니다.

- qcom, ratiometric :

    사용법 : 선택 사항

    값 유형 : <empty>

    정의 : 채널 교정 유형. 이 속성을 지정하면 VADC는 채널 조정에 VDD 참조 (1.8V) 및 GND를 사용합니다. 

	속성이 발견되지 않으면 채널은 절대 교정이라고도하는 0.625V 및 1.25V 기준 채널로 교정됩니다.

- qcom, hw-settle-time :
    사용법 : 선택 사항
    값 유형 : <u32>
    정의 : AMUX가 구성되고 ADC가 변환을 시작하는 시간. 그렇지 않으면 값이 11 미만인 경우 지연 = 100us * (값)이고 그렇지 않은 경우 2ms * (값 - 10)입니다.

  유효한 값은 0, 100, 200, 300, 400, 500, 600, 700, 800,900 us 및 1, 2, 4, 6, 8, 10 ms입니다. 

  속성을 찾을 수없는 경우 채널은 0us를 사용합니다.

- qcom, 평균 - 샘플 :
    사용법 : 선택 사항
    값 유형 : <u32>
    정의 : 측정에 사용되는 샘플 수.
    평균화는 여러 샘플의 평균 인 ADC에서 단일 측정치를 얻는 옵션을 제공합니다. 선택된 값은 2 ^ (값)입니다.

	유효한 값은 다음과 같습니다. 1, 2, 4, 8, 16, 32, 64, 128, 256, 512 특성이 없으면 1 샘플이 사용됩니다.

Note:

참조 지점 채널이라고도하는 다음 채널은
결과 교정 및 채널 구성 노드를 정의해야합니다.
VADC_REF_625MV 및 / 또는 VADC_SPARE1 (PMIC 버전 기준) VADC_REF_1250MV,
VADC_GND_REF 및 VADC_VDD_VADC.

*/
```

## Doc/DeviceDriver/devicetree/bindings/iio/adc/rockchip-saradc.txt
```
Rockchip Successive Approximation Register (SAR) A/D Converter bindings

Required properties:
- compatible: Should be "rockchip,saradc" or "rockchip,rk3066-tsadc"
- reg: physical base address of the controller and length of memory mapped
       region.
- interrupts: The interrupt number to the cpu. The interrupt specifier format
              depends on the interrupt controller.
- clocks: Must contain an entry for each entry in clock-names.
- clock-names: Shall be "saradc" for the converter-clock, and "apb_pclk" for
               the peripheral clock.
- vref-supply: The regulator supply ADC reference voltage.
- #io-channel-cells: Should be 1, see ../iio-bindings.txt

Optional properties:
- resets: Must contain an entry for each entry in reset-names if need support
	  this option. See ../reset/reset.txt for details.
- reset-names: Must include the name "saradc-apb".

Example:
	saradc: saradc@2006c000 {
		compatible = "rockchip,saradc";
		reg = <0x2006c000 0x100>;
		interrupts = <GIC_SPI 26 IRQ_TYPE_LEVEL_HIGH>;
		clocks = <&cru SCLK_SARADC>, <&cru PCLK_SARADC>;
		clock-names = "saradc", "apb_pclk";
		resets = <&cru SRST_SARADC>;
		reset-names = "saradc-apb";
		#io-channel-cells = <1>;
		vref-supply = <&vcc18>;
	};


/*

Rockchip SAR (successive approximation register) A / D 변환기 바인딩

필수 속성 :
- compatible : "rockchip, saradc"또는 "rockchip, rk3066-tsadc"이어야합니다.
- reg : 컨트롤러의 물리적 인 기본 주소와 메모리 매핑 된 영역의 길이.
- interrupts : CPU에 대한 인터럽트 번호. 인터럽트 지정자 형식은 인터럽트 컨트롤러에 따라 다릅니다.
- clocks : clock-name의 각 항목에 대한 항목을 포함해야합니다.
- clock-names : 컨버터 클럭의 경우 "saradc"이고 주변 장치 클럭의 경우 "apb_pclk"여야합니다.
- vref-supply : 레귤레이터는 ADC 기준 전압을 공급한다.
- # io-channel-cells : 1이어야하며 ../iio-bindings.txt를 참조하십시오.

선택 속성 :
- reset :이 옵션을 지원해야하는 경우 reset-names에 각 항목에 대한 항목을 포함해야합니다. 자세한 내용은 ../reset/reset.txt를 참조하십시오.
- reset-names : "saradc-apb"라는 이름을 포함해야합니다.

Example:
	saradc: saradc@2006c000 {
		compatible = "rockchip,saradc";
		reg = <0x2006c000 0x100>;
		interrupts = <GIC_SPI 26 IRQ_TYPE_LEVEL_HIGH>;
		clocks = <&cru SCLK_SARADC>, <&cru PCLK_SARADC>;
		clock-names = "saradc", "apb_pclk";
		resets = <&cru SRST_SARADC>;
		reset-names = "saradc-apb";
		#io-channel-cells = <1>;
		vref-supply = <&vcc18>;
	};



*/
```

## Doc/DeviceDriver/devicetree/bindings/iio/adc/ti-adc128s052.txt
```
* Texas Instruments' ADC128S052 and ADC122S021 ADC chip

Required properties:
 - compatible: Should be "ti,adc128s052" or "ti,adc122s021"
 - reg: spi chip select number for the device
 - vref-supply: The regulator supply for ADC reference voltage

Recommended properties:
 - spi-max-frequency: Definition as per
		Documentation/devicetree/bindings/spi/spi-bus.txt

Example:
adc@0 {
	compatible = "ti,adc128s052";
	reg = <0>;
	vref-supply = <&vdd_supply>;
	spi-max-frequency = <1000000>;
};


/*
* Texas Instruments의 ADC128S052 및 ADC122S021 ADC 칩

필수 속성 :
  - 호환 가능 : "ti, adc128s052"또는 "ti, adc122s021"이어야합니다.
  - reg : 장치의 SPI 칩 선택 번호
  - vref-supply : ADC 기준 전압을위한 레귤레이터 전원

권장 속성 :
  - spi-max-frequency : 정의대로
		Documentation/devicetree/bindings/spi/spi-bus.txt

Example:
adc@0 {
	compatible = "ti,adc128s052";
	reg = <0>;
	vref-supply = <&vdd_supply>;
	spi-max-frequency = <1000000>;
};


*/
```

## Doc/DeviceDriver/devicetree/bindings/iio/adc/twl4030-madc.txt
```
* TWL4030 Monitoring Analog to Digital Converter (MADC)

The MADC subsystem in the TWL4030 consists of a 10-bit ADC
combined with a 16-input analog multiplexer.

Required properties:
  - compatible: Should contain "ti,twl4030-madc".
  - interrupts: IRQ line for the MADC submodule.
  - #io-channel-cells: Should be set to <1>.

Optional properties:
  - ti,system-uses-second-madc-irq: boolean, set if the second madc irq register
				    should be used, which is intended to be used
				    by Co-Processors (e.g. a modem).

Example:

&twl {
	madc {
		compatible = "ti,twl4030-madc";
		interrupts = <3>;
		#io-channel-cells = <1>;
	};
};


/*
* TWL4030 아날로그 - 디지털 변환기 (MADC) 모니터링

TWL4030의 MADC 서브 시스템은 16 비트 아날로그 멀티플렉서와 결합 된 10 비트 ADC로 구성됩니다.

필수 속성 :
   - compatible : "ti, twl4030-madc"을 포함해야합니다.
   - interrupts : MADC 서브 모듈의 IRQ 라인.
   - # io-channel-cells : <1>로 설정해야합니다.

선택 속성 :
- ti, system-uses-second-madc-irq : 부울. 코 프로세서 (예 : 모뎀)에서 사용할 두 번째 madc irq 레지스터를 사용해야하는지 설정합니다.


Example:

&twl {
	madc {
		compatible = "ti,twl4030-madc";
		interrupts = <3>;
		#io-channel-cells = <1>;
	};
};
*/
```

## Doc/DeviceDriver/devicetree/bindings/iio/adc/vf610-adc.txt
```
Freescale vf610 Analog to Digital Converter bindings

The devicetree bindings are for the new ADC driver written for
vf610/i.MX6slx and upward SoCs from Freescale.

Required properties:
- compatible: Should contain "fsl,vf610-adc"
- reg: Offset and length of the register set for the device
- interrupts: Should contain the interrupt for the device
- clocks: The clock is needed by the ADC controller, ADC clock source is ipg clock.
- clock-names: Must contain "adc", matching entry in the clocks property.
- vref-supply: The regulator supply ADC reference voltage.

Recommended properties:
- fsl,adck-max-frequency: Maximum frequencies according to datasheets operating
  requirements. Three values are required, depending on conversion mode:
  - Frequency in normal mode (ADLPC=0, ADHSC=0)
  - Frequency in high-speed mode (ADLPC=0, ADHSC=1)
  - Frequency in low-power mode (ADLPC=1, ADHSC=0)
- min-sample-time: Minimum sampling time in nanoseconds. This value has
  to be chosen according to the conversion mode and the connected analog
  source resistance (R_as) and capacitance (C_as). Refer the datasheet's
  operating requirements. A safe default across a wide range of R_as and
  C_as as well as conversion modes is 1000ns.

Example:
adc0: adc@4003b000 {
	compatible = "fsl,vf610-adc";
	reg = <0x4003b000 0x1000>;
	interrupts = <0 53 0x04>;
	clocks = <&clks VF610_CLK_ADC0>;
	clock-names = "adc";
	fsl,adck-max-frequency = <30000000>, <40000000>,
				<20000000>;
	vref-supply = <&reg_vcc_3v3_mcu>;
};



/*

프리 스케일 vf610 아날로그 - 디지털 컨버터 바인딩

devicetree 바인딩은 Freescale의 vf610 / i.MX6slx 및 상위 SoC 용으로 작성된 새로운 ADC 드라이버다.

필수 속성 :
- 호환 가능 : "fsl, vf610-adc"
- reg : 장치에 설정된 레지스터 오프셋 및 길이
- 인터럽트 : 장치에 대한 인터럽트를 포함해야합니다.
- 클럭 : ADC 컨트롤러가 클럭을 필요로하고, ADC 클럭 소스는 ipg 클럭입니다.
- clock-names : clock 속성에 일치하는 항목이 "adc"이어야합니다.
- vref-supply : 레귤레이터는 ADC 기준 전압을 공급한다.

권장 속성 :
- fsl, adck-max-frequency : 데이터 시트 작동 요구 사항에 따른 최대 주파수. 변환 모드에 따라 다음 세 가지 값이 필요합니다.
  - 정상 모드에서의 주파수 (ADLPC = 0, ADHSC = 0)
  - 고속 모드에서의 주파수 (ADLPC = 0, ADHSC = 1)
  - 저전력 모드에서의 주파수 (ADLPC = 1, ADHSC = 0)
- min-sample-time : 최소 샘플링 시간 (나노초 단위). 이 값은 변환 모드와 연결된 아날로그 소스 저항 (R_as) 및 커패시턴스 (C_as)에 따라 선택되어야합니다. 데이터 시트의 작동 요구 사항을 참조하십시오. 넓은 범위의 R_as 및 C_as 및 변환 모드에서 안전한 기본값은 1000ns입니다.

Example:
adc0: adc@4003b000 {
	compatible = "fsl,vf610-adc";
	reg = <0x4003b000 0x1000>;
	interrupts = <0 53 0x04>;
	clocks = <&clks VF610_CLK_ADC0>;
	clock-names = "adc";
	fsl,adck-max-frequency = <30000000>, <40000000>,
				<20000000>;
	vref-supply = <&reg_vcc_3v3_mcu>;
};



*/
```
