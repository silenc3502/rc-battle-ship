## Doc/DeviceDriver/devicetree/bindings/iio/adc/at91_adc.txt
```
* AT91's Analog to Digital Converter (ADC)

Required properties:
  - compatible: Should be "atmel,<chip>-adc"
    <chip> can be "at91sam9260", "at91sam9g45" or "at91sam9x5"
  - reg: Should contain ADC registers location and length
  - interrupts: Should contain the IRQ line for the ADC
  - clock-names: tuple listing input clock names.
	Required elements: "adc_clk", "adc_op_clk".
  - clocks: phandles to input clocks.
  - atmel,adc-channels-used: Bitmask of the channels muxed and enabled for this
    device
  - atmel,adc-startup-time: Startup Time of the ADC in microseconds as
    defined in the datasheet
  - atmel,adc-vref: Reference voltage in millivolts for the conversions
  - atmel,adc-res: List of resolutions in bits supported by the ADC. List size
		   must be two at least.
  - atmel,adc-res-names: Contains one identifier string for each resolution
			 in atmel,adc-res property. "lowres" and "highres"
			 identifiers are required.

Optional properties:
  - atmel,adc-use-external-triggers: Boolean to enable the external triggers
  - atmel,adc-use-res: String corresponding to an identifier from
		       atmel,adc-res-names property. If not specified, the highest
		       resolution will be used.
  - atmel,adc-sleep-mode: Boolean to enable sleep mode when no conversion
  - atmel,adc-sample-hold-time: Sample and Hold Time in microseconds
  - atmel,adc-ts-wires: Number of touchscreen wires. Should be 4 or 5. If this
                        value is set, then the adc driver will enable touchscreen
                        support.
    NOTE: when adc touchscreen is enabled, the adc hardware trigger will be
          disabled. Since touchscreen will occupy the trigger register.
  - atmel,adc-ts-pressure-threshold: a pressure threshold for touchscreen. It
                                     makes touch detection more precise.

Optional trigger Nodes:
  - Required properties:
    * trigger-name: Name of the trigger exposed to the user
    * trigger-value: Value to put in the Trigger register
      to activate this trigger
  - Optional properties:
    * trigger-external: Is the trigger an external trigger?

Examples:
adc0: adc@fffb0000 {
	#address-cells = <1>;
	#size-cells = <0>;
	compatible = "atmel,at91sam9260-adc";
	reg = <0xfffb0000 0x100>;
	interrupts = <20 IRQ_TYPE_LEVEL_HIGH 0>;
	clocks = <&adc_clk>, <&adc_op_clk>;
	clock-names = "adc_clk", "adc_op_clk";
	atmel,adc-channels-used = <0xff>;
	atmel,adc-startup-time = <40>;
	atmel,adc-use-external-triggers;
	atmel,adc-vref = <3300>;
	atmel,adc-res = <8 10>;
	atmel,adc-res-names = "lowres", "highres";
	atmel,adc-use-res = "lowres";

	trigger@0 {
		reg = <0>;
		trigger-name = "external-rising";
		trigger-value = <0x1>;
		trigger-external;
	};
	trigger@1 {
		reg = <1>;
		trigger-name = "external-falling";
		trigger-value = <0x2>;
		trigger-external;
	};

	trigger@2 {
		reg = <2>;
		trigger-name = "external-any";
		trigger-value = <0x3>;
		trigger-external;
	};

	trigger@3 {
		reg = <3>;
		trigger-name = "continuous";
		trigger-value = <0x6>;
	};
};



/*

* AT91의 아날로그 - 디지털 변환기 (ADC)

필수 속성 :
  - 호환 : "atmel, <chip> -adc"여야합니다. <chip>은 "at91sam9260", "at91sam9g45"또는 "at91sam9x5"일 수 있습니다.
  - reg : ADC 레지스터 위치와 길이를 포함해야한다.
  - 인터럽트 : ADC의 IRQ 라인을 포함해야합니다.
  - clock-names : 튜플에 입력 클럭 이름을 나열합니다.
필수 요소 : "adc_clk", "adc_op_clk".
  - clocks : 입력 클락에 대한 phandles.
  - atmel, adc-channels-used :이 장치에 다중화되고 활성화 된 채널의 비트 마스크
  - atmel, adc-startup-time : 데이터 시트에 정의 된대로 ADC의 시작 시간 (마이크로 초)
  - atmel, adc-vref : 전환 당 밀리 볼트 단위의 기준 전압
  - atmel, adc-res : ADC가 지원하는 비트 단위의 해상도 목록. 목록 크기는 적어도 2 여야합니다.
  - atmel, adc-res-names : atmel의 각 해상도에 대한 하나의 식별자 문자열, adc-res 속성을 포함합니다. "lowres"및 "highres"식별자가 필요합니다.

선택적 속성 :
  - atmel, adc-use-external-triggers : 외부 트리거를 활성화하는 부울
  - atmel, adc-use-res : atmel의 식별자에 해당하는 문자열, ad-res-names 속성. 지정하지 않으면 가장 높은 해상도가 사용됩니다.
  - atmel, adc-sleep-mode : 전환이 없을 때 절전 모드를 활성화하는 부울
  - atmel, adc-sample-hold-time : 샘플 및 대기 시간 (마이크로 초)
  - atmel, adc-ts-wires : 터치 스크린 와이어의 수. 4 또는 5 여야합니다.
	이 값을 설정하면 adc 드라이버가 터치 스크린 지원을 활성화합니다.
    참고 : adc 터치 스크린이 활성화되면 adc 하드웨어 트리거가 활성화됩니다.
          사용할 수 없습니다. 터치 스크린이 트리거 레지스터를 차지할 것이기 때문입니다.
  - atmel, adc-ts-pressure-threshold : 터치 스크린 압력 임계 값. 터치 감지가 더욱 정확합니다.

선택적 트리거 노드 :
  - 필수 속성 :
    * trigger-name : 사용자에게 노출 된 트리거의 이름
    * trigger-value :이 트리거를 활성화하기 위해 Trigger 레지스터에 넣을 값
  - 선택적 속성 :
    * trigger-external : 트리거가 외부 트리거인지 확인


Examples:
adc0: adc@fffb0000 {
	#address-cells = <1>;
	#size-cells = <0>;
	compatible = "atmel,at91sam9260-adc";
	reg = <0xfffb0000 0x100>;
	interrupts = <20 IRQ_TYPE_LEVEL_HIGH 0>;
	clocks = <&adc_clk>, <&adc_op_clk>;
	clock-names = "adc_clk", "adc_op_clk";
	atmel,adc-channels-used = <0xff>;
	atmel,adc-startup-time = <40>;
	atmel,adc-use-external-triggers;
	atmel,adc-vref = <3300>;
	atmel,adc-res = <8 10>;
	atmel,adc-res-names = "lowres", "highres";
	atmel,adc-use-res = "lowres";

	trigger@0 {
		reg = <0>;
		trigger-name = "external-rising";
		trigger-value = <0x1>;
		trigger-external;
	};
	trigger@1 {
		reg = <1>;
		trigger-name = "external-falling";
		trigger-value = <0x2>;
		trigger-external;
	};

	trigger@2 {
		reg = <2>;
		trigger-name = "external-any";
		trigger-value = <0x3>;
		trigger-external;
	};

	trigger@3 {
		reg = <3>;
		trigger-name = "continuous";
		trigger-value = <0x6>;
	};
};


*/
```

## Doc/DeviceDriver/devicetree/bindings/iio/adc/berlin2_adc.txt
```
* Berlin Analog to Digital Converter (ADC)

The Berlin ADC has 8 channels, with one connected to a temperature sensor.
It is part of the system controller register set. The ADC node should be a
sub-node of the system controller node.

Required properties:
- compatible: must be "marvell,berlin2-adc"
- interrupts: the interrupts for the ADC and the temperature sensor
- interrupt-names: should be "adc" and "tsen"

Example:

adc: adc {
	compatible = "marvell,berlin2-adc";
	interrupt-parent = <&sic>;
	interrupts = <12>, <14>;
	interrupt-names = "adc", "tsen";
};


/*

* 베를린 아날로그 - 디지털 변환기 (ADC)

Berlin ADC는 8 개의 채널을 가지고 있으며, 하나는 온도 센서에 연결되어 있습니다.
이것은 시스템 컨트롤러 레지스터 세트의 일부입니다. ADC 노드는 시스템 컨트롤러 노드의 하위 노드 여야합니다.

필수 속성 :
- 호환 가능 : "marvell, berlin2-adc"이어야합니다.
- 인터럽트 : ADC 및 온도 센서에 대한 인터럽트
- interrupt-names : "adc"및 "tsen"이어야합니다.

Example:

adc: adc {
	compatible = "marvell,berlin2-adc";
	interrupt-parent = <&sic>;
	interrupts = <12>, <14>;
	interrupt-names = "adc", "tsen";
};

*/
```

## Doc/DeviceDriver/devicetree/bindings/iio/adc/cc10001_adc.txt
```
* Cosmic Circuits - Analog to Digital Converter (CC-10001-ADC)

Required properties:
  - compatible: Should be "cosmic,10001-adc"
  - reg: Should contain adc registers location and length.
  - clock-names: Should contain "adc".
  - clocks: Should contain a clock specifier for each entry in clock-names
  - vref-supply: The regulator supply ADC reference voltage.

Optional properties:
  - adc-reserved-channels: Bitmask of reserved channels,
    i.e. channels that cannot be used by the OS.

Example:
adc: adc@18101600 {
	compatible = "cosmic,10001-adc";
	reg = <0x18101600 0x24>;
	adc-reserved-channels = <0x2>;
	clocks = <&adc_clk>;
	clock-names = "adc";
	vref-supply = <&reg_1v8>;
};


/*


* Cosmic Circuits - Analog to Digital Converter (CC-10001-ADC)

필수 속성 :
   - 호환 가능 : "cosmic, 10001-adc"여야합니다.
   - reg : adc 레지스터 위치와 길이를 포함해야합니다.
   - clock-names : "adc"를 포함해야합니다.
   - clocks : clock-name의 각 항목에 대한 시계 지정자를 포함해야합니다.
   - vref-supply : 레귤레이터는 ADC 기준 전압을 공급한다.

선택 속성 :
   - adc-reserved-channels : 예약 된 채널, 즉 OS에서 사용할 수없는 채널의 비트 마스크입니다.


Example:
adc: adc@18101600 {
	compatible = "cosmic,10001-adc";
	reg = <0x18101600 0x24>;
	adc-reserved-channels = <0x2>;
	clocks = <&adc_clk>;
	clock-names = "adc";
	vref-supply = <&reg_1v8>;
};


*/
```

## Doc/DeviceDriver/devicetree/bindings/iio/adc/da9150-gpadc.txt
```
Dialog Semiconductor DA9150 IIO GPADC bindings

Required properties:
- compatible: "dlg,da9150-gpadc" for DA9150 IIO GPADC
- #io-channel-cells: Should be set to <1>
  (See Documentation/devicetree/bindings/iio/iio-bindings.txt for further info)

For further information on GPADC channels, see device datasheet.


Example:

	gpadc: da9150-gpadc {
		compatible = "dlg,da9150-gpadc";
		#io-channel-cells = <1>;
	};


/*

Dialog Semiconductor DA9150 IIO GPADC 바인딩

필수 속성 :
- 호환 : DA9150 IIO GPADC 용 "dlg, da9150-gpadc"
- # io-channel-cells : <1> (으)로 설정해야합니다.
   자세한 내용은 Documentation / devicetree / bindings / iio / iio-bindings.txt를 참조하십시오.

GPADC 채널에 대한 자세한 내용은 장치 데이터 시트를 참조하십시오.

Example:

	gpadc: da9150-gpadc {
		compatible = "dlg,da9150-gpadc";
		#io-channel-cells = <1>;
	};


*/
```

## Doc/DeviceDriver/devicetree/bindings/iio/adc/hi8435.txt
```
Holt Integrated Circuits HI-8435 threshold detector bindings

Required properties:
 - compatible: should be "holt,hi8435"
 - reg: spi chip select number for the device

Recommended properties:
 - spi-max-frequency: definition as per
		Documentation/devicetree/bindings/spi/spi-bus.txt

Optional properties:
 - gpios: GPIO used for controlling the reset pin

Example:
sensor@0 {
	compatible = "holt,hi8435";
	reg = <0>;
	gpios = <&gpio6 1 0>;

	spi-max-frequency = <1000000>;
};



/*


Holt Integrated Circuits HI-8435 threshold detector bindings

필수 속성 :
  - 호환 가능 : "holt, hi8435"여야합니다.
  - reg : 장치의 SPI 칩 선택 번호

권장 속성 :
  - spi-max-frequency : 정의대로
Documentaion / devicetree / bindings / spi / spi-bus.txt

선택 속성 :
  - gpios : 재설정 핀 제어에 사용되는 GPIO


Example:
sensor@0 {
	compatible = "holt,hi8435";
	reg = <0>;
	gpios = <&gpio6 1 0>;

	spi-max-frequency = <1000000>;
};


*/
```

## Doc/DeviceDriver/devicetree/bindings/iio/adc/max1027-adc.txt
```
* Maxim 1027/1029/1031 Analog to Digital Converter (ADC)

Required properties:
  - compatible: Should be "maxim,max1027" or "maxim,max1029" or "maxim,max1031"
  - reg: SPI chip select number for the device
  - interrupt-parent: phandle to the parent interrupt controller
  see: Documentation/devicetree/bindings/interrupt-controller/interrupts.txt
  - interrupts: IRQ line for the ADC
  see: Documentation/devicetree/bindings/interrupt-controller/interrupts.txt

Recommended properties:
- spi-max-frequency: Definition as per
                     Documentation/devicetree/bindings/spi/spi-bus.txt

Example:
adc@0 {
	compatible = "maxim,max1027";
	reg = <0>;
	interrupt-parent = <&gpio5>;
	interrupts = <15 IRQ_TYPE_EDGE_RISING>;
	spi-max-frequency = <1000000>;
};


/*

* Maxim 1027/1029/1031 아날로그 - 디지털 컨버터 (ADC)

필수 속성 :
   - compatible : "maxim, max1027"또는 "maxim, max1029"또는 "maxim, max1031"이어야합니다.
   - reg : 장치의 SPI 칩 선택 번호
   --interrupt-parent : 부모 인터럽트 컨트롤러와 연결
   Documentation / devicetree / bindings / interrupt-controller / interrupts.txt를 참조하십시오.
   - 인터럽트 : ADC의 IRQ 라인 참조 : Documentation / devicetree / bindings / interrupt-controller / interrupts.txt

권장 속성 :
- spi-max-frequency : 정의대로
      Documentation/devicetree/bindings/spi/spi-bus.txt

Example:
adc@0 {
	compatible = "maxim,max1027";
	reg = <0>;
	interrupt-parent = <&gpio5>;
	interrupts = <15 IRQ_TYPE_EDGE_RISING>;
	spi-max-frequency = <1000000>;
};


*/
```

## Doc/DeviceDriver/devicetree/bindings/iio/adc/mcp320x.txt
```
* Microchip Analog to Digital Converter (ADC)

The node for this driver must be a child node of a SPI controller, hence
all mandatory properties described in

        Documentation/devicetree/bindings/spi/spi-bus.txt

must be specified.

Required properties:
	- compatible:  	Must be one of the following, depending on the
			model:
				"mcp3001"
				"mcp3002"
				"mcp3004"
				"mcp3008"
				"mcp3201"
				"mcp3202"
				"mcp3204"
				"mcp3208"
				"mcp3301"


Examples:
spi_controller {
	mcp3x0x@0 {
		compatible = "mcp3002";
		reg = <0>;
		spi-max-frequency = <1000000>;
	};
};

/*
* 마이크로 칩 아날로그 - 디지털 컨버터 (ADC)

이 드라이버의 노드는 SPI 컨트롤러의 자식 노드 여야합니다.
모든 필수 속성은

         Documentation / devicetree / bindings / spi / spi-bus.txt

반드시 지정해야합니다.

필수 속성 :
- 호환 : 다음 중 하나 여야합니다.
			model:
				"mcp3001"
				"mcp3002"
				"mcp3004"
				"mcp3008"
				"mcp3201"
				"mcp3202"
				"mcp3204"
				"mcp3208"
				"mcp3301"


Examples:
spi_controller {
	mcp3x0x@0 {
		compatible = "mcp3002";
		reg = <0>;
		spi-max-frequency = <1000000>;
	};
};

*/
```

## Doc/DeviceDriver/devicetree/bindings/iio/adc/nuvoton-nau7802.txt
```
* Nuvoton NAU7802 Analog to Digital Converter (ADC)

Required properties:
  - compatible: Should be "nuvoton,nau7802"
  - reg: Should contain the ADC I2C address

Optional properties:
  - nuvoton,vldo: Internal reference voltage in millivolts to be
    configured valid values are between 2400 mV and 4500 mV.
  - interrupts: IRQ line for the ADC. If not used the driver will use
    polling.

Example:
adc2: nau7802@2a {
	compatible = "nuvoton,nau7802";
	reg = <0x2a>;
	nuvoton,vldo = <3000>;
};

/*

* Nuvoton NAU7802 아날로그 - 디지털 컨버터 (ADC)

필수 속성 :
   - 호환 가능 : "nuvoton, nau7802"여야합니다.
   - reg : ADC I2C 주소를 포함해야한다.

선택 속성 :
   - nuvoton, vldo : 구성 할 내부 기준 전압 (밀리 볼트)은 유효 값이 2400mV와 4500mV 사이입니다.
   - 인터럽트 : ADC의 IRQ 라인. 사용하지 않으면 드라이버가 폴링을 사용합니다.


Example:
adc2: nau7802@2a {
	compatible = "nuvoton,nau7802";
	reg = <0x2a>;
	nuvoton,vldo = <3000>;
};

*/
```

## Doc/DeviceDriver/devicetree/bindings/iio/adc/qcom,spmi-iadc.txt
```
Qualcomm's SPMI PMIC current ADC

QPNP PMIC current ADC (IADC) provides interface to clients to read current.
A 16 bit ADC is used for current measurements. IADC can measure the current
through an external resistor (channel 1) or internal (built-in) resistor
(channel 0). When using an external resistor it is to be described by
qcom,external-resistor-micro-ohms property.

IADC node:

- compatible:
    Usage: required
    Value type: <string>
    Definition: Should contain "qcom,spmi-iadc".

- reg:
    Usage: required
    Value type: <prop-encoded-array>
    Definition: IADC base address and length in the SPMI PMIC register map

- interrupts:
    Usage: optional
    Value type: <prop-encoded-array>
    Definition: End of ADC conversion.

- qcom,external-resistor-micro-ohms:
    Usage: optional
    Value type: <u32>
    Definition: Sense resister value in micro Ohm.
                If not defined value of 10000 micro Ohms will be used.

Example:
	/* IADC node */
	pmic_iadc: iadc@3600 {
		compatible = "qcom,spmi-iadc";
		reg = <0x3600 0x100>;
		interrupts = <0x0 0x36 0x0 IRQ_TYPE_EDGE_RISING>;
		qcom,external-resistor-micro-ohms = <10000>;
		#io-channel-cells  = <1>;
	};

	/* IIO client node */
	bat {
		io-channels = <&pmic_iadc  0>;
		io-channel-names = "iadc";
	};



/*

Qualcomm의 SPMI PMIC 전류 ADC

QPNP PMIC 전류 ADC (IADC)는 클라이언트에게 전류를 판독 할 수있는 인터페이스를 제공한다.
16 비트 ADC는 전류 측정에 사용됩니다. IADC는 전류를 측정 할 수 있습니다.
외부 저항 (채널 1) 또는 내부 (내장형) 저항 (채널 0)을 통해.
외부 저항을 사용할 때는 qcom, 외부 저항 마이크로 옴 특성으로 설명해야한다.

IADC 노드 :

- 호환 가능 :
    사용법 : 필수
    값 유형 : <문자열>
    정의 : "qcom, spmi-iadc"를 포함해야합니다.

- reg :
    사용법 : 필수
    값 유형 : <prop-encoded-array>
    정의 : SPAD PMIC 레지스터 맵의 IADC 기본 주소 및 길이

- 인터럽트 :
    사용법 : 선택 사항
    값 유형 : <prop-encoded-array>
    정의 : ADC 변환의 끝.

- qcom, 외부 저항 - 마이크로 옴 :
    사용법 : 선택 사항
    값 유형 : <u32>
    정의 : 저항 값을 마이크로 옴 단위로 감지합니다.
                10000 마이크로 옴의 정의되지 않은 값이 사용됩니다.

Example:
	/* IADC node */
	pmic_iadc: iadc@3600 {
		compatible = "qcom,spmi-iadc";
		reg = <0x3600 0x100>;
		interrupts = <0x0 0x36 0x0 IRQ_TYPE_EDGE_RISING>;
		qcom,external-resistor-micro-ohms = <10000>;
		#io-channel-cells  = <1>;
	};

	/* IIO client node */
	bat {
		io-channels = <&pmic_iadc  0>;
		io-channel-names = "iadc";
	};


*/
```
