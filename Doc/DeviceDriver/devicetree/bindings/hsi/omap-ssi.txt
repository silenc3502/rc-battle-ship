## Doc/DeviceDriver/devicetree/bindings/iio/adc/xilinx-xadc.txt
```
Xilinx XADC device driver

This binding document describes the bindings for both of them since the
bindings are very similar. The Xilinx XADC is a ADC that can be found in the
series 7 FPGAs from Xilinx. The XADC has a DRP interface for communication.
Currently two different frontends for the DRP interface exist. One that is only
available on the ZYNQ family as a hardmacro in the SoC portion of the ZYNQ. The
other one is available on all series 7 platforms and is a softmacro with a AXI
interface. This binding document describes the bindings for both of them since
the bindings are very similar.

Required properties:
	- compatible: Should be one of
		* "xlnx,zynq-xadc-1.00.a": When using the ZYNQ device
		  configuration interface to interface to the XADC hardmacro.
		* "xlnx,axi-xadc-1.00.a": When using the axi-xadc pcore to
		  interface to the XADC hardmacro.
	- reg: Address and length of the register set for the device
	- interrupts: Interrupt for the XADC control interface.
	- clocks: When using the ZYNQ this must be the ZYNQ PCAP clock,
	  when using the AXI-XADC pcore this must be the clock that provides the
	  clock to the AXI bus interface of the core.

Optional properties:
	- interrupt-parent: phandle to the parent interrupt controller
	- xlnx,external-mux:
		* "none": No external multiplexer is used, this is the default
		  if the property is omitted.
		* "single": External multiplexer mode is used with one
		   multiplexer.
		* "dual": External multiplexer mode is used with two
		  multiplexers for simultaneous sampling.
	- xlnx,external-mux-channel: Configures which pair of pins is used to
	  sample data in external mux mode.
	  Valid values for single external multiplexer mode are:
		0: VP/VN
		1: VAUXP[0]/VAUXN[0]
		2: VAUXP[1]/VAUXN[1]
		...
		16: VAUXP[15]/VAUXN[15]
	  Valid values for dual external multiplexer mode are:
		1: VAUXP[0]/VAUXN[0] - VAUXP[8]/VAUXN[8]
		2: VAUXP[1]/VAUXN[1] - VAUXP[9]/VAUXN[9]
		...
		8: VAUXP[7]/VAUXN[7] - VAUXP[15]/VAUXN[15]

	  This property needs to be present if the device is configured for
	  external multiplexer mode (either single or dual). If the device is
	  not using external multiplexer mode the property is ignored.
	- xnlx,channels: List of external channels that are connected to the ADC
	  Required properties:
		* #address-cells: Should be 1.
		* #size-cells: Should be 0.

	  The child nodes of this node represent the external channels which are
	  connected to the ADC. If the property is no present no external
	  channels will be assumed to be connected.

	  Each child node represents one channel and has the following
	  properties:
		Required properties:
			* reg: Pair of pins the channel is connected to.
				0: VP/VN
				1: VAUXP[0]/VAUXN[0]
				2: VAUXP[1]/VAUXN[1]
				...
				16: VAUXP[15]/VAUXN[15]
			  Note each channel number should only be used at most
			  once.
		Optional properties:
			* xlnx,bipolar: If set the channel is used in bipolar
			  mode.


Examples:
	xadc@f8007100 {
		compatible = "xlnx,zynq-xadc-1.00.a";
		reg = <0xf8007100 0x20>;
		interrupts = <0 7 4>;
		interrupt-parent = <&gic>;
		clocks = <&pcap_clk>;

		xlnx,channels {
			#address-cells = <1>;
			#size-cells = <0>;
			channel@0 {
				reg = <0>;
			};
			channel@1 {
				reg = <1>;
			};
			channel@8 {
				reg = <8>;
			};
		};
	};

	xadc@43200000 {
		compatible = "xlnx,axi-xadc-1.00.a";
		reg = <0x43200000 0x1000>;
		interrupts = <0 53 4>;
		interrupt-parent = <&gic>;
		clocks = <&fpga1_clk>;

		xlnx,channels {
			#address-cells = <1>;
			#size-cells = <0>;
			channel@0 {
				reg = <0>;
				xlnx,bipolar;
			};
		};
	};




/*

자일링스 XADC 장치 드라이버

이 바인딩 문서는 바인딩이 매우 유사하기 때문에 둘 모두에 대한 바인딩을 설명합니다. 자일링스 XADC는 자일링스의 7 시리즈 FPGA에서 볼 수있는 ADC이다. XADC에는 통신을위한 DRP 인터페이스가 있습니다.
현재 DRP 인터페이스에 대한 두 가지 프론트 엔드가 존재합니다. 하나는 ZYNQ SoC 부분의 하드 마크로 ZYNQ 제품군에서만 사용 가능합니다. 다른 하나는 모든 시리즈 7 플랫폼에서 사용할 수 있으며 AXI 인터페이스가있는 소프트 마크로 있습니다.
이 바인딩 문서는 바인딩이 매우 유사하기 때문에 둘 모두에 대한 바인딩을 설명합니다.

필수 속성 :
- 호환 가능 : 다음 중 하나 여야합니다.
* "xlnx, zynq-xadc-1.00.a": ZYNQ 장치 구성 인터페이스를 사용하여 XADC 하드 마크로를 인터페이스 할 때.
* "xlnx, axi-xadc-1.00.a": axi-xadc pcore를 사용하여 XADC 하드 마크로를 인터페이스 할 때.
- reg : 장치에 설정된 레지스터의 주소와 길이
- interrupts : XADC 제어 인터페이스에 대한 인터럽트입니다.
- clocks : ZYNQ를 사용할 때 이것은 ZYNQ PCAP 클럭이어야하며,
AXI-XADC pcore를 사용할 때 코어의 AXI 버스 인터페이스에 클록을 제공하는 클럭이어야합니다.

선택적 속성 :
--interrupt-parent : 부모 인터럽트 컨트롤러와 연결
- xlnx, external-mux :
* "none": 외부 멀티플렉서는 사용되지 않으며 속성이 생략 된 경우 기본값입니다.
* "single": 외부 멀티플렉서 모드는 하나의 멀티플렉서와 ​​함께 사용됩니다.
* "dual": 외부 멀티플렉서 모드는 동시 샘플링을 위해 2 개의 멀티플렉서와 ​​함께 사용됩니다.
- xlnx, external-mux-channel : 외부 mux 모드에서 데이터를 샘플링하는 데 사용되는 핀 쌍을 구성합니다.
단일 외부 멀티플렉서 모드의 유효한 값은 다음과 같습니다.
0 : VP / VN
1 : VAUXP [0] / VAUXN [0]
2 : VAUXP [1] / VAUXN [1]
...
16 : VAUXP [15] / VAUXN [15]
이중 외부 멀티플렉서 모드의 유효한 값은 다음과 같습니다.
1 : VAUXP [0] / VAUXN [0] - VAUXP [8] / VAUXN [8]
2 : VAUXP [1] / VAUXN [1] - VAUXP [9] / VAUXN [9]
...
8 : VAUXP [7] / VAUXN [7] - VAUXP [15] / VAUXN [15]

장치가 외부 멀티플렉서 모드 (단일 또는 이중)로 구성된 경우이 등록 정보가 있어야합니다. 

장치가 외부 멀티플렉서 모드를 사용하지 않는 경우이 속성은 무시됩니다.
- xnlx, channels : ADC에 연결된 외부 채널 목록
필수 속성 :
* # 주소 - 셀 : 1이어야합니다.
* # size-cells : 0이어야합니다.

이 노드의 자식 노드는 ADC에 연결된 외부 채널을 나타냅니다. 

속성이 없으면 외부 채널이 연결되지 않는다고 가정합니다.

각 자식 노드는 하나의 채널을 나타내며 다음을가집니다.
속성 :
필수 속성 :
* reg : 채널이 연결된 핀 쌍.
0 : VP / VN
1 : VAUXP [0] / VAUXN [0]
2 : VAUXP [1] / VAUXN [1]
...
16 : VAUXP [15] / VAUXN [15]
각 채널 번호는 최대 한 번만 사용해야합니다.
선택적 속성 :
* xlnx, bipolar : 설정된 경우 채널이 바이폴라 모드로 사용됩니다.

Examples:
	xadc@f8007100 {
		compatible = "xlnx,zynq-xadc-1.00.a";
		reg = <0xf8007100 0x20>;
		interrupts = <0 7 4>;
		interrupt-parent = <&gic>;
		clocks = <&pcap_clk>;

		xlnx,channels {
			#address-cells = <1>;
			#size-cells = <0>;
			channel@0 {
				reg = <0>;
			};
			channel@1 {
				reg = <1>;
			};
			channel@8 {
				reg = <8>;
			};
		};
	};

	xadc@43200000 {
		compatible = "xlnx,axi-xadc-1.00.a";
		reg = <0x43200000 0x1000>;
		interrupts = <0 53 4>;
		interrupt-parent = <&gic>;
		clocks = <&fpga1_clk>;

		xlnx,channels {
			#address-cells = <1>;
			#size-cells = <0>;
			channel@0 {
				reg = <0>;
				xlnx,bipolar;
			};
		};
	};


*/
```

## Doc/DeviceDriver/devicetree/bindings/iio/dac/ad7303.txt
```
Analog Devices AD7303 DAC device driver

Required properties:
	- compatible: Must be "adi,ad7303"
	- reg: SPI chip select number for the device
	- spi-max-frequency: Max SPI frequency to use (< 30000000)
	- Vdd-supply: Phandle to the Vdd power supply

Optional properties:
	- REF-supply: Phandle to the external reference voltage supply. This should
	  only be set if there is an external reference voltage connected to the REF
	  pin. If the property is not set Vdd/2 is used as the reference voltage.

Example:

		ad7303@4 {
			compatible = "adi,ad7303";
			reg = <4>;
			spi-max-frequency = <10000000>;
			Vdd-supply = <&vdd_supply>;
			adi,use-external-reference;
			REF-supply = <&vref_supply>;
		};


/*
Analog Devices AD7303 DAC 디바이스 드라이버

필수 속성 :
- 호환 : "adi, ad7303"이어야합니다.
- reg : 장치의 SPI 칩 선택 번호
- spi-max-frequency : 사용할 최대 SPI 주파수 (<30000000)
- Vdd 공급 : Vdd 전원 공급 장치에 대한 Phandle

선택 속성 :
- REF 공급 : 외부 기준 전압 공급 장치로 파들 레 (Phandle). REF 핀에 연결된 외부 기준 전압이있는 경우에만 설정해야합니다. 
	특성이 설정되지 않으면 Vdd / 2가 기준 전압으로 사용됩니다.

Example:

		ad7303@4 {
			compatible = "adi,ad7303";
			reg = <4>;
			spi-max-frequency = <10000000>;
			Vdd-supply = <&vdd_supply>;
			adi,use-external-reference;
			REF-supply = <&vref_supply>;
		};

*/
```

## Doc/DeviceDriver/devicetree/bindings/iio/dac/max5821.txt
```
Maxim max5821 DAC device driver

Required properties:
	- compatible: Must be "maxim,max5821"
	- reg: Should contain the DAC I2C address
	- vref-supply: Phandle to the vref power supply

Example:

	max5821@38 {
		compatible = "maxim,max5821";
		reg = <0x38>;
		vref-supply = <&reg_max5821>;
	};


/*

Maxim max5821 DAC 소자 드라이버

필수 속성 :
- 호환 가능 : "maxim, max5821"여야합니다.
- reg : DAC I2C 주소를 포함해야합니다.
- vref-supply : vref 전원 공급 장치에 대한 Phandle

Example:

	max5821@38 {
		compatible = "maxim,max5821";
		reg = <0x38>;
		vref-supply = <&reg_max5821>;
	};

*/
```

## Doc/DeviceDriver/devicetree/bindings/iio/dac/ti,dac7512.txt
```
TI DAC7512 DEVICETREE BINDINGS

Required properties:

	- "compatible"		Must be set to "ti,dac7512"

Property rules described in Documentation/devicetree/bindings/spi/spi-bus.txt
apply. In particular, "reg" and "spi-max-frequency" properties must be given.


Example:

	spi_master {
		dac7512: dac7512@0 {
			compatible = "ti,dac7512";
			reg = <0>; /* CS0 */
			spi-max-frequency = <1000000>;
		};
	};

/*

필수 속성 :

- "compatible" "ti, dac7512"로 설정해야합니다.

Documentation / devicetree / bindings / spi / spi-bus.txt에 설명 된 속성 규칙이 적용됩니다. 

특히 "reg"및 "spi-max-frequency"속성을 지정해야합니다.



Example:

	spi_master {
		dac7512: dac7512@0 {
			compatible = "ti,dac7512";
			reg = <0>; /* CS0 */
			spi-max-frequency = <1000000>;
		};
	};


*/
```

## Doc/DeviceDriver/devicetree/bindings/iio/frequency/adf4350.txt
```
Analog Devices ADF4350/ADF4351 device driver

Required properties:
	- compatible: Should be one of
		* "adi,adf4350": When using the ADF4350 device
		* "adi,adf4351": When using the ADF4351 device
	- reg: SPI chip select numbert for the device
	- spi-max-frequency: Max SPI frequency to use (< 20000000)
	- clocks: From common clock binding. Clock is phandle to clock for
		ADF435x Reference Clock (CLKIN).

Optional properties:
	- gpios:	 GPIO Lock detect - If set with a valid phandle and GPIO number,
			pll lock state is tested upon read.
	- adi,channel-spacing: Channel spacing in Hz (influences MODULUS).
	- adi,power-up-frequency:	If set in Hz the PLL tunes to
			the desired frequency on probe.
	- adi,reference-div-factor: If set the driver skips dynamic calculation
			and uses this default value instead.
	- adi,reference-doubler-enable: Enables reference doubler.
	- adi,reference-div2-enable: Enables reference divider.
	- adi,phase-detector-polarity-positive-enable: Enables positive phase
			detector polarity. Default = negative.
	- adi,lock-detect-precision-6ns-enable: Enables 6ns lock detect precision.
			Default = 10ns.
	- adi,lock-detect-function-integer-n-enable: Enables lock detect
			for integer-N mode. Default = factional-N mode.
	- adi,charge-pump-current: Charge pump current in mA.
			Default = 2500mA.
	- adi,muxout-select: On chip multiplexer output selection.
			Valid values for the multiplexer output are:
			0: Three-State Output (default)
			1: DVDD
			2: DGND
			3: R-Counter output
			4: N-Divider output
			5: Analog lock detect
			6: Digital lock detect
	- adi,low-spur-mode-enable: Enables low spur mode.
			Default = Low noise mode.
	- adi,cycle-slip-reduction-enable: Enables cycle slip reduction.
	- adi,charge-cancellation-enable: Enabled charge pump
			charge cancellation for integer-N modes.
	- adi,anti-backlash-3ns-enable: Enables 3ns antibacklash pulse width
			 for integer-N modes.
	- adi,band-select-clock-mode-high-enable: Enables faster band
			selection logic.
	- adi,12bit-clk-divider: Clock divider value used when
			adi,12bit-clkdiv-mode != 0
	- adi,clk-divider-mode:
			Valid values for the clkdiv mode are:
			0: Clock divider off (default)
			1: Fast lock enable
			2: Phase resync enable
	- adi,aux-output-enable: Enables auxiliary RF output.
	- adi,aux-output-fundamental-enable: Selects fundamental VCO output on
			the auxiliary RF output. Default = Output of RF dividers.
	- adi,mute-till-lock-enable: Enables Mute-Till-Lock-Detect function.
	- adi,output-power: Output power selection.
			Valid values for the power mode are:
			0: -4dBm (default)
			1: -1dBm
			2: +2dBm
			3: +5dBm
	- adi,aux-output-power: Auxiliary output power selection.
			Valid values for the power mode are:
			0: -4dBm (default)
			1: -1dBm
			2: +2dBm
			3: +5dBm


Example:
		lo_pll0_rx_adf4351: adf4351-rx-lpc@4 {
			compatible = "adi,adf4351";
			reg = <4>;
			spi-max-frequency = <10000000>;
			clocks = <&clk0_ad9523 9>;
			clock-names = "clkin";
			adi,channel-spacing = <10000>;
			adi,power-up-frequency = <2400000000>;
			adi,phase-detector-polarity-positive-enable;
			adi,charge-pump-current = <2500>;
			adi,output-power = <3>;
			adi,mute-till-lock-enable;
		};



/*

Analog Devices ADF4350 / ADF4351 장치 드라이버

필수 속성 :
- 호환 가능 : 다음 중 하나 여야합니다.
* "adi, adf4350": ADF4350 장치를 사용할 때
* "adi, adf4351": ADF4351 장치를 사용할 때
- reg : 장치의 SPI 칩 선택 번호
- spi-max-frequency : 사용할 최대 SPI 주파수 (<20000000)
- 클럭 : 공통 클록 바인딩에서. 클럭은 ADF435x 기준 클록 (CLKIN)을위한 클럭 간 페어이다.

선택적 속성 :
- gpios : GPIO 잠금 감지 - 유효한 phandle 및 GPIO 번호로 설정되면, pll 잠금 상태는 읽기시 테스트됩니다.
- adi, 채널 간격 : 채널 간격 (Hz) (MODULUS에 영향).
- adi, power-up-frequency : Hz로 설정하면 PLL은 프로브에서 원하는 주파수로 튜닝됩니다.
- adi, reference-div-factor : 설정된 경우 드라이버가 동적 계산을 건너 뛰고 대신이 기본값을 사용합니다.
- adi, reference-doubler-enable : 참조 doubler를 활성화합니다.
- adi, reference-div2-enable : 기준 디바이더를 사용합니다.
- adi, phase-detector-polarity-positive-enable : 양의 위상 검출기 극성을 활성화합니다. 기본값 = 음수입니다.
- adi, lock-detect-precision-6ns-enable : 6ns의 잠금 감지 정밀도를 사용합니다.
기본값은 10ns입니다.
- adi, lock-detect-function-integer-n-enable : 정수 N 모드에 대한 잠금 검색을 활성화합니다. 기본값은 factional-N 모드입니다.
- adi, 차지 펌프 전류 : mA 단위의 차지 펌프 전류.
기본값 = 2500mA.
- adi, muxout-select : 온칩 멀티플렉서 출력 선택.
멀티플렉서 출력의 유효한 값은 다음과 같습니다.
0 : 3- 상태 출력 (기본값)
1 : DVDD
2 : DGND
3 : R 카운터 출력
4 : N- 분배기 출력
5 : 아날로그 잠금 감지
6 : 디지털 잠금 장치 감지
- adi, 낮은 스퍼 모드 사용 : 낮은 스퍼 모드를 사용합니다.
기본값 = 낮은 노이즈 모드.
- adi, cycle-slip-reduction-enable : 사이클 슬립 감소를 활성화합니다.
- adi, charge-cancellation-enable : 정수 -N 모드의 경우 차지 펌프 충전 취소를 사용할 수 있습니다.
- adi, anti-backlash-3ns-enable : 정수 -N 모드의 경우 3ns의 정전기 방지 펄스 폭을 활성화합니다.
- adi, 대역 선택 - 클럭 모드 - 고지원 : 빠른 대역 선택 논리를 가능하게합니다.
- adi, 12bit-clk-divider : adi, 12bit-clkdiv-mode! = 0 일 때 사용되는 클럭 분배기 값
- adi, clk-divider-mode :
clkdiv 모드의 유효한 값은 다음과 같습니다.
0 : 클럭 분배기 꺼짐 (기본값)
1 : 빠른 잠금 활성화
2 : 위상 재 동기화 활성화
- adi, aux-output-enable : 보조 RF 출력을 활성화합니다.
-adi, aux-output-fundamental-enable : 보조 RF 출력에서 ​​기본적인 VCO 출력을 선택합니다. 기본값 = RF 분배기의 출력.
- adi, mute-till-lock-enable : Mute-Till-Lock-Detect 기능을 사용합니다.
- adi, 출력 전력 : 출력 전력 선택.
전원 모드의 유효한 값은 다음과 같습니다.
0 : -4dBm (기본값)
1 : -1dBm
2 : + 2dBm
3 : + 5dBm
- 보조 출력 전력 : 보조 출력 전원 선택.
전원 모드의 유효한 값은 다음과 같습니다.
0 : -4dBm (기본값)
1 : -1dBm
2 : + 2dBm
3 : + 5dBm


Example:
		lo_pll0_rx_adf4351: adf4351-rx-lpc@4 {
			compatible = "adi,adf4351";
			reg = <4>;
			spi-max-frequency = <10000000>;
			clocks = <&clk0_ad9523 9>;
			clock-names = "clkin";
			adi,channel-spacing = <10000>;
			adi,power-up-frequency = <2400000000>;
			adi,phase-detector-polarity-positive-enable;
			adi,charge-pump-current = <2500>;
			adi,output-power = <3>;
			adi,mute-till-lock-enable;
		};

*/
```
