## Doc/DeviceDriver/devicetree/bindings/hsi/omap-ssi.txt
```
OMAP SSI controller bindings

OMAP Synchronous Serial Interface (SSI) controller implements a legacy
variant of MIPI's High Speed Synchronous Serial Interface (HSI).

Required properties:
- compatible:		Should include "ti,omap3-ssi".
- reg-names:		Contains the values "sys" and "gdd" (in this order).
- reg:			Contains a matching register specifier for each entry
			in reg-names.
- interrupt-names:	Contains the value "gdd_mpu".
- interrupts: 		Contains matching interrupt information for each entry
			in interrupt-names.
- ranges:		Represents the bus address mapping between the main
			controller node and the child nodes below.
- clock-names:		Must include the following entries:
  "ssi_ssr_fck": The OMAP clock of that name
  "ssi_sst_fck": The OMAP clock of that name
  "ssi_ick": The OMAP clock of that name
- clocks:		Contains a matching clock specifier for each entry in
			clock-names.
- #address-cells:	Should be set to <1>
- #size-cells:		Should be set to <1>

Each port is represented as a sub-node of the ti,omap3-ssi device.

Required Port sub-node properties:
- compatible:		Should be set to the following value
			ti,omap3-ssi-port (applicable to OMAP34xx devices)
- reg-names:		Contains the values "tx" and "rx" (in this order).
- reg:			Contains a matching register specifier for each entry
			in reg-names.
- interrupt-parent	Should be a phandle for the interrupt controller
- interrupts:		Should contain interrupt specifiers for mpu interrupts
			0 and 1 (in this order).
- ti,ssi-cawake-gpio:	Defines which GPIO pin is used to signify CAWAKE
			events for the port. This is an optional board-specific
			property. If it's missing the port will not be
			enabled.

OMAP SSI 컨트롤러 바인딩

OMAP 동기식 직렬 인터페이스 (SSI) 컨트롤러는 MIPI의 고속 동기식 직렬 인터페이스 (HSI)의 기존 변형을 구현합니다.

필수 속성 :
- 호환 : "ti, omap3-ssi"를 포함해야합니다.
- reg-names : "sys"및 "gdd"값을이 순서로 포함합니다.
- reg : reg-name의 각 항목에 대해 일치하는 레지스터 specifier를 포함합니다.
- interrupt-names : "gdd_mpu"값을 포함합니다.
- 인터럽트 : 인터럽트 이름의 각 항목에 대해 일치하는 인터럽트 정보를 포함합니다.
- 범위 : 주 컨트롤러 노드와 하위 노드 사이의 버스 주소 매핑을 나타냅니다.
- clock-names : 다음 항목을 포함해야합니다.
   "ssi_ssr_fck": 해당 이름의 OMAP clock
   "ssi_sst_fck": 해당 이름의 OMAP clock
   "ssi_ick": 그 이름의 OMAP clock
- clocks : clock-name의 각 항목에 대해 일치하는 클럭 specifier를 포함합니다.
- # address-cells : <1> (으)로 설정해야합니다.
- # size-cells : <1> (으)로 설정해야합니다.






Example for Nokia N900:

ssi-controller@48058000 {
	compatible = "ti,omap3-ssi";

	/* needed until hwmod is updated to use the compatible string */
	/ * hwmod가 호환되는 문자열을 사용하도록 업데이트 될 때까지 필요 * /

	ti,hwmods = "ssi";

	reg = <0x48058000 0x1000>,
	      <0x48059000 0x1000>;
	reg-names = "sys",
		    "gdd";

	interrupts = <55>;
	interrupt-names = "gdd_mpu";

	clocks = <&ssi_ssr_fck>,
		 <&ssi_sst_fck>,
		 <&ssi_ick>;
	clock-names = "ssi_ssr_fck",
		      "ssi_sst_fck",
		      "ssi_ick";

	#address-cells = <1>;
	#size-cells = <1>;
	ranges;

	ssi-port@4805a000 {
		compatible = "ti,omap3-ssi-port";

		reg = <0x4805a000 0x800>,
		      <0x4805a800 0x800>;
		reg-names = "tx",
			    "rx";

		interrupt-parent = <&intc>;
		interrupts = <67>,
			     <68>;

		ti,ssi-cawake-gpio = <&gpio5 23 GPIO_ACTIVE_HIGH>; /* 151 */
	}

	ssi-port@4805a000 {
		compatible = "ti,omap3-ssi-port";

		reg = <0x4805b000 0x800>,
		      <0x4805b800 0x800>;
		reg-names = "tx",
			    "rx";

		interrupt-parent = <&intc>;
		interrupts = <69>,
			     <70>;

		status = "disabled"; /* second port is not used on N900 */
							 / * 두 번째 포트는 N900에서 사용되지 않습니다 * /	
	}
}
```

## Doc/DeviceDriver/devicetree/bindings/iio/accel/bma180.txt
```
* Bosch BMA180 / BMA250 triaxial acceleration sensor

http://omapworld.com/BMA180_111_1002839.pdf
http://ae-bst.resource.bosch.com/media/products/dokumente/bma250/bst-bma250-ds002-05.pdf

Required properties:

  - compatible : should be "bosch,bma180" or "bosch,bma250"
  - reg : the I2C address of the sensor

Optional properties:

  - interrupt-parent : should be the phandle for the interrupt controller

  - interrupts : interrupt mapping for GPIO IRQ, it should by configured with
		flags IRQ_TYPE_LEVEL_HIGH | IRQ_TYPE_EDGE_RISING
		For the bma250 the first interrupt listed must be the one
		connected to the INT1 pin, the second (optional) interrupt
		listed must be the one connected to the INT2 pin.

Example:

bma180@40 {
	compatible = "bosch,bma180";
	reg = <0x40>;
	interrupt-parent = <&gpio6>;
	interrupts = <18 (IRQ_TYPE_LEVEL_HIGH | IRQ_TYPE_EDGE_RISING)>;
};



/*

* Bosch BMA180 / BMA250 3 축 가속도 센서

http://omapworld.com/BMA180_111_1002839.pdf
http://ae-bst.resource.bosch.com/media/products/dokumente/bma250/bst-bma250-ds002-05.pdf

필수 속성 :

   - 호환 가능 : "bosch, bma180"또는 "bosch, bma250"이어야합니다.
   - reg : 센서의 I2C 주소

선택 속성 :

   - interrupt-parent : 인터럽트 컨트롤러의 phandle이어야합니다.

   - 인터럽트 : GPIO IRQ의 인터럽트 매핑, 플래그 IRQ_TYPE_LEVEL_HIGH로 구성해야합니다. 

	IRQ_TYPE_EDGE_RISING bma250의 경우 나열된 첫 번째 인터럽트는 INT1 핀에 연결된 인터럽트이어야하며 

	두 번째 (선택 사항) 인터럽트는 INT2 핀에 연결된 인터럽트이어야합니다.


Example:

bma180@40 {
	compatible = "bosch,bma180";
	reg = <0x40>;
	interrupt-parent = <&gpio6>;
	interrupts = <18 (IRQ_TYPE_LEVEL_HIGH | IRQ_TYPE_EDGE_RISING)>;
};

*/
```

## Doc/DeviceDriver/devicetree/bindings/iio/accel/lis302.txt
```
LIS302 accelerometer devicetree bindings

This device is matched via its bus drivers, and has a number of properties
that apply in on the generic device (independent from the bus).


Required properties for the SPI bindings:
 - compatible: 		should be set to "st,lis3lv02d_spi"
 - reg:			the chipselect index
 - spi-max-frequency:	maximal bus speed, should be set to 1000000 unless
			constrained by external circuitry
 - interrupts:		the interrupt generated by the device

Required properties for the I2C bindings:
 - compatible:		should be set to "st,lis3lv02d"
 - reg:			i2c slave address
 - Vdd-supply:		The input supply for Vdd
 - Vdd_IO-supply:	The input supply for Vdd_IO


Optional properties for all bus drivers:

 - st,click-single-{x,y,z}:	if present, tells the device to issue an
				interrupt on single click events on the
				x/y/z axis.
 - st,click-double-{x,y,z}:	if present, tells the device to issue an
				interrupt on double click events on the
				x/y/z axis.
 - st,click-thresh-{x,y,z}:	set the x/y/z axis threshold
 - st,click-click-time-limit:	click time limit, from 0 to 127.5msec
				with step of 0.5 msec
 - st,click-latency:		click latency, from 0 to 255 msec with
				step of 1 msec.
 - st,click-window:		click window, from 0 to 255 msec with
				step of 1 msec.
 - st,irq{1,2}-disable:		disable IRQ 1/2
 - st,irq{1,2}-ff-wu-1:		raise IRQ 1/2 on FF_WU_1 condition
 - st,irq{1,2}-ff-wu-2:		raise IRQ 1/2 on FF_WU_2 condition
 - st,irq{1,2}-data-ready:	raise IRQ 1/2 on data ready contition
 - st,irq{1,2}-click:		raise IRQ 1/2 on click condition
 - st,irq-open-drain:		consider IRQ lines open-drain
 - st,irq-active-low:		make IRQ lines active low
 - st,wu-duration-1:		duration register for Free-Fall/Wake-Up
				interrupt 1
 - st,wu-duration-2:		duration register for Free-Fall/Wake-Up
				interrupt 2
 - st,wakeup-{x,y,z}-{lo,hi}:	set wakeup condition on x/y/z axis for
				upper/lower limit
 - st,wakeup-threshold:		set wakeup threshold
 - st,wakeup2-{x,y,z}-{lo,hi}:	set wakeup condition on x/y/z axis for
				upper/lower limit for second wakeup
				engine.
 - st,wakeup2-threshold:	set wakeup threshold for second wakeup
				engine.
 - st,highpass-cutoff-hz=:	1, 2, 4 or 8 for 1Hz, 2Hz, 4Hz or 8Hz of
				highpass cut-off frequency
 - st,hipass{1,2}-disable:	disable highpass 1/2.
 - st,default-rate=:		set the default rate
 - st,axis-{x,y,z}=:		set the axis to map to the three coordinates.
				Negative values can be used for inverted axis.
 - st,{min,max}-limit-{x,y,z}	set the min/max limits for x/y/z axis
				(used by self-test)

/*

LIS302 가속도계 devicetree 바인딩

이 장치는 버스 드라이버를 통해 연결되며 일반 장치 (버스와 별도로)에 적용되는 많은 특성을 가지고 있습니다.


SPI 바인딩에 필요한 속성 :
 - compatible : "st, lis3lv02d_spi"로 설정해야합니다.
 - 등록 : 칩 선택 색인
 - spi-max-frequency : 최대 버스 속도. 외부 회로에 의해 제약받지 않는 한 1000000으로 설정해야합니다.
 - interrupts : 장치에 의해 생성 된 인터럽트

I2C 바인딩에 필요한 속성 :
 - compatible : "st, lis3lv02d"로 설정해야합니다.
 - reg : i2c 슬레이브 주소
 - Vdd 공급 : Vdd의 입력 전원
 - Vdd_IO-supply : Vdd_IO의 입력 전원


모든 버스 드라이버의 선택적 속성 :

 - st, click-single- {x, y, z} : x / y / z 축의 단일 클릭 이벤트에서 인터럽트를 발생 시키도록 장치에 지시합니다.
 - st, click-double- {x, y, z} : x / y / z 축의 두 번 클릭 이벤트에서 인터럽트를 발생하도록 장치에 지시합니다.
 - st, click-thresh- {x, y, z} : x / y / z 축 임계 값 설정
 - st, click-click-time-limit : 클릭 제한 시간, 0에서 127.5msec, 0.5msec 간격
 - 클릭 대기 시간 : 1msec 간격으로 0 ~ 255msec의 대기 시간을 클릭합니다.
 - st 클릭 윈도우 : 1 msec 단위로 0 ~ 255 msec의 창을 클릭합니다.
 - st, irq {1,2} - 사용 안 함 : IRQ 1/2 사용 안 함
 - st, irq {1,2} -ff-wu-1 : FF_WU_1 조건에서 IRQ 1/2를 올린다.
 - st, irq {1,2} -ff-wu-2 : FF_WU_2 조건에서 IRQ 1/2를 올린다.
 - st, irq {1,2} -data-ready : 데이터 준비 컨텍스트에서 IRQ 1/2를 올린다.
 - st, irq {1,2} - 클릭 : 클릭 상태에서 IRQ 1/2 올린다.
 - st, irq-open-drain : IRQ 라인을 오픈 드레인으로 간주
 - st, irq-active-low : IRQ 라인을 액티브 로우로 만든다.
 - st, wu-duration-1 : 자유 낙하 / 깨우기 인터럽트 1 기간 레지스터
 - st, wu-duration-2 : 자유 낙하 / 깨우기 - 업 인터럽트 2 기간 레지스터
 - st, wakeup- {x, y, z} - {lo, hi} : x / y / z 축에서 웨이크 업 조건 설정
상한 / 하한
 - st, wakeup-threshold : 웨이크 업 임계 값 설정
 - st, wakeup2- {x, y, z} - {lo, hi} : 두 번째 웨이크 업 엔진의 상한 / 하한에 대한 웨이크 업 조건을 x / y / z 축에 설정합니다.
 - st, wakeup2-threshold : 두 번째 웨이크 업 엔진의 웨이크 업 임계 값을 설정합니다.
 - st, highpass-cutoff-hz = : 하이 패스 차단 주파수의 1Hz, 2Hz, 4Hz 또는 8Hz에 대해 1, 2, 4 또는 8
 - st, hipass {1,2} -disable : 하이 패스 1/2를 비활성화합니다.
 - st, default-rate = : 기본 속도 설정
 - st, axis- {x, y, z} = : 축을 세 좌표로 매핑하도록 설정합니다.
반전 된 축에는 음수 값을 사용할 수 있습니다.
 - st, {min, max} -limit- {x, y, z} x / y / z 축의 최소 / 최대 한계 설정 (자체 테스트에서 사용)

*/


Example for a SPI device node:

	lis302@0 {
		compatible = "st,lis302dl-spi";
		reg = <0>;
		spi-max-frequency = <1000000>;
		interrupt-parent = <&gpio>;
		interrupts = <104 0>;

		st,click-single-x;
		st,click-single-y;
		st,click-single-z;
		st,click-thresh-x = <10>;
		st,click-thresh-y = <10>;
		st,click-thresh-z = <10>;
		st,irq1-click;
		st,irq2-click;
		st,wakeup-x-lo;
		st,wakeup-x-hi;
		st,wakeup-y-lo;
		st,wakeup-y-hi;
		st,wakeup-z-lo;
		st,wakeup-z-hi;
	};

Example for a I2C device node:

	lis331dlh: lis331dlh@18 {
		compatible = "st,lis331dlh", "st,lis3lv02d";
		reg = <0x18>;
		Vdd-supply = <&lis3_reg>;
		Vdd_IO-supply = <&lis3_reg>;

		st,click-single-x;
		st,click-single-y;
		st,click-single-z;
		st,click-thresh-x = <10>;
		st,click-thresh-y = <10>;
		st,click-thresh-z = <10>;
		st,irq1-click;
		st,irq2-click;
		st,wakeup-x-lo;
		st,wakeup-x-hi;
		st,wakeup-y-lo;
		st,wakeup-y-hi;
		st,wakeup-z-lo;
		st,wakeup-z-hi;
		st,min-limit-x = <120>;
		st,min-limit-y = <120>;
		st,min-limit-z = <140>;
		st,max-limit-x = <550>;
		st,max-limit-y = <550>;
		st,max-limit-z = <750>;
	};
```

## Doc/DeviceDriver/devicetree/bindings/iio/accel/mma8452.txt
```
Freescale MMA8452Q, MMA8453Q, MMA8652FC or MMA8653FC triaxial accelerometer

Required properties:

  - compatible: should contain one of
    * "fsl,mma8452"
    * "fsl,mma8453"
    * "fsl,mma8652"
    * "fsl,mma8653"
  - reg: the I2C address of the chip

Optional properties:

  - interrupt-parent: should be the phandle for the interrupt controller
  - interrupts: interrupt mapping for GPIO IRQ

Example:

	mma8453fc@1d {
		compatible = "fsl,mma8453";
		reg = <0x1d>;
		interrupt-parent = <&gpio1>;
		interrupts = <5 0>;
	};


/*

프리 스케일 MMA8452Q, MMA8453Q, MMA8652FC 또는 MMA8653FC 3 축 가속도계

필수 속성 :

   - compatible : 다음 중 하나를 포함해야합니다.
     * "fsl, mma8452"
     * "fsl, mma8453"
     * "fsl, mma8652"
     * "fsl, mma8653"
   - reg : 칩의 I2C 주소

선택 속성 :

   - interrupt-parent : 인터럽트 컨트롤러의 phandle이어야합니다.
   - 인터럽트 : GPIO IRQ에 대한 인터럽트 매핑

*/
```
